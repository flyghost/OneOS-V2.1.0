## components/ble/mynewt-nimble/nimble/host/services/ans/Kconfig
```kconfig
menu "ans"
		config MYNEWT_VAL_BLE_SVC_ANS_NEW_ALERT_CAT
		    int "Initial supported new alert category bitmask."
		    default 0


		config MYNEWT_VAL_BLE_SVC_ANS_UNR_ALERT_CAT
		    int "Initial supported unread alert category bitmask."
		    default 0


		config MYNEWT_VAL_BLE_SVC_ANS_SYSINIT_STAGE
		    int "Sysinit stage for the alert notification service."
		    default 303
endmenu
```

## components/ble/mynewt-nimble/nimble/host/services/bas/Kconfig
```kconfig
menu "bas"
		config MYNEWT_VAL_BLE_SVC_BAS_BATTERY_LEVEL_READ_PERM
		    int "Defines permissions for reading 'Battery Level' characteristics"
		    default 0

		    help 
				Defines permissions for reading "Battery Level" characteristics. Can be zero to allow read without extra permissions or combination of:     BLE_GATT_CHR_F_READ_ENC     BLE_GATT_CHR_F_READ_AUTHEN     BLE_GATT_CHR_F_READ_AUTHOR

		config MYNEWT_VAL_BLE_SVC_BAS_BATTERY_LEVEL_NOTIFY_ENABLE
		    int "Set to 1 to support notification or 0 to disable it."
		    default 1


		config MYNEWT_VAL_BLE_SVC_BAS_SYSINIT_STAGE
		    int "Sysinit stage for the battery level service."
		    default 303
endmenu
```

## components/ble/mynewt-nimble/nimble/host/services/bleuart/Kconfig
```kconfig
menu "bleuart"
		config MYNEWT_VAL_BLEUART_MAX_INPUT
		    int "The size of the largest line that can be received over the UART service."
		    default 120


		config MYNEWT_VAL_BLEUART_SYSINIT_STAGE
		    int "Sysinit stage for the BLE UART service."
		    default 500
endmenu
```

## components/ble/mynewt-nimble/nimble/host/services/dis/Kconfig
```kconfig
menu "dis"
		config MYNEWT_VAL_BLE_SVC_DIS_DEFAULT_READ_PERM
		    int "Defines default permissions for reading characteristics"
		    default -1

		    help 
				Defines default permissions for reading characteristics. Can be zero to allow read without extra permissions or combination of:     BLE_GATT_CHR_F_READ_ENC     BLE_GATT_CHR_F_READ_AUTHEN     BLE_GATT_CHR_F_READ_AUTHOR Set to '-1' to remove this characteristic.

		config MYNEWT_VAL_BLE_SVC_DIS_MODEL_NUMBER_READ_PERM
		    int "Defines permissions for reading 'Model Number' characteristics"
		    default 0

		    help 
				Defines permissions for reading 'Model number' characteristics. Can be set to BLE_SVC_DIS_DEFAULT_READ_PERM or use any of the possible values defined for that setting.

		config MYNEWT_VAL_BLE_SVC_DIS_MODEL_NUMBER_DEFAULT
		    string "Defines a default value for 'Model number' if not set with 'ble_svc_dis_model_number_set'."
		    default "Apache Mynewt NimBLE"

		config MYNEWT_VAL_BLE_SVC_DIS_SERIAL_NUMBER_READ_PERM
		    int "Defines permissions for reading 'Serial Number' characteristics"
		    default MYNEWT_VAL_BLE_SVC_DIS_DEFAULT_READ_PERM
		    help 
				Defines permissions for reading 'Serial Number' characteristics. Can be set to BLE_SVC_DIS_DEFAULT_READ_PERM or use any of the possible values defined for that setting.

		config MYNEWT_VAL_BLE_SVC_DIS_SERIAL_NUMBER_DEFAULT
		    string "Defines a default value for 'Serial Number' if not set with 'ble_svc_dis_serial_number_set'."
		    default "notset"


		config MYNEWT_VAL_BLE_SVC_DIS_HARDWARE_REVISION_READ_PERM
		    int "Defines permissions for reading 'Hardware Revision' characteristics"
		    default MYNEWT_VAL_BLE_SVC_DIS_DEFAULT_READ_PERM
		    help 
				Defines permissions for reading 'Hardware Revision' characteristics. Can be set to BLE_SVC_DIS_DEFAULT_READ_PERM or use any of the possible values defined for that setting.

		config MYNEWT_VAL_BLE_SVC_DIS_HARDWARE_REVISION_DEFAULT
		    string "Defines a default value for 'Hardware Revision' if not set with 'ble_svc_dis_hardware_revision_set'"
		    default "notset"

		    help 
				Defines a default value for 'Hardware Revision' if not set with 'ble_svc_dis_hardware_revision_set'.

		config MYNEWT_VAL_BLE_SVC_DIS_FIRMWARE_REVISION_READ_PERM
		    int "Defines permissions for reading 'Firmware Revision' characteristics"
		    default MYNEWT_VAL_BLE_SVC_DIS_DEFAULT_READ_PERM
		    help 
				Defines permissions for reading 'Firmware Revision' characteristics. Can be set to BLE_SVC_DIS_DEFAULT_READ_PERM or use any of the possible values defined for that setting.

		config MYNEWT_VAL_BLE_SVC_DIS_FIRMWARE_REVISION_DEFAULT
		    string "Defines a default value for 'Software revision' if not set with 'ble_svc_dis_firmware_revision_set'"
		    default "notset"

		    help 
				Defines a default value for 'Software revision' if not set with 'ble_svc_dis_firmware_revision_set'.

		config MYNEWT_VAL_BLE_SVC_DIS_SOFTWARE_REVISION_READ_PERM
		    int "Defines permissions for reading 'Software revision' characteristics"
		    default MYNEWT_VAL_BLE_SVC_DIS_DEFAULT_READ_PERM
		    help 
				Defines permissions for reading 'Software revision' characteristics. Can be set to BLE_SVC_DIS_DEFAULT_READ_PERM or use any of the possible values defined for that setting.

		config MYNEWT_VAL_BLE_SVC_DIS_SOFTWARE_REVISION_DEFAULT
		    string "Defines a default value for 'Software revision' if not set with 'ble_svc_dis_software_revision_set'"
		    default "notset"

		    help 
				Defines a default value for 'Software revision' if not set with 'ble_svc_dis_software_revision_set'.

		config MYNEWT_VAL_BLE_SVC_DIS_MANUFACTURER_NAME_READ_PERM
		    int "Defines permissions for reading 'Manufacturer name' characteristics"
		    default MYNEWT_VAL_BLE_SVC_DIS_DEFAULT_READ_PERM
		    help 
				Defines permissions for reading 'Manufacturer name' characteristics. Can be set to BLE_SVC_DIS_DEFAULT_READ_PERM or use any of the possible values defined for that setting.

		config MYNEWT_VAL_BLE_SVC_DIS_MANUFACTURER_NAME_DEFAULT
		    string "Defines a default value for 'Manufacturer name' if not set with 'ble_svc_dis_manufacturer_name_set'"
		    default "notset"

		    help 
				Defines a default value for 'Manufacturer name' if not set with 'ble_svc_dis_manufacturer_name_set'.

		config MYNEWT_VAL_BLE_SVC_DIS_SYSTEM_ID_READ_PERM
		    int "Defines permissions for reading 'System ID' characteristics"
		    default MYNEWT_VAL_BLE_SVC_DIS_DEFAULT_READ_PERM
		    help 
				Defines permissions for reading 'System ID' characteristics. Can be set to BLE_SVC_DIS_DEFAULT_READ_PERM or use any of the possible values defined for that setting.

		config MYNEWT_VAL_BLE_SVC_DIS_SYSTEM_ID_DEFAULT
		    string "Defines a default value for 'System ID' if not set with 'ble_svc_dis_manufacturer_name_set'."
		    default "notset"


		config MYNEWT_VAL_BLE_SVC_DIS_SYSINIT_STAGE
		    int "Sysinit stage for the device information BLE service."
		    default 303
endmenu
```

## components/ble/mynewt-nimble/nimble/host/services/gap/Kconfig
```kconfig
menu "gap"
		config MYNEWT_VAL_BLE_SVC_GAP_DEVICE_NAME
		    string "Default value for 'Device Name' characteristics, unless overwritten by application."
		    default "nimble"

		config MYNEWT_VAL_BLE_SVC_GAP_DEVICE_NAME_WRITE_PERM
		    int "Defines permissions for writing 'Device Name' characteristics"
		    default -1

		    help 
				Defines permissions for writing 'Device Name' characteristics. Can be zero to allow write without extra permissions or combination of:     BLE_GATT_CHR_F_WRITE_ENC     BLE_GATT_CHR_F_WRITE_AUTHEN     BLE_GATT_CHR_F_WRITE_AUTHOR Set to '-1' to make characteristic read only.

		config MYNEWT_VAL_BLE_SVC_GAP_DEVICE_NAME_MAX_LENGTH
		    int "Maximum length for 'Device Name' characteristics"
		    default 31


		config MYNEWT_VAL_BLE_SVC_GAP_APPEARANCE
		    int "Device appearance"
		    default 0


		config MYNEWT_VAL_BLE_SVC_GAP_APPEARANCE_WRITE_PERM
		    int "Defines permissions for writing 'Appearance' characteristics"
		    default -1

		    help 
				Defines permissions for writing 'Appearance' characteristics. Can be zero to allow write without extra permissions or combination of:     BLE_GATT_CHR_F_WRITE_ENC     BLE_GATT_CHR_F_WRITE_AUTHEN     BLE_GATT_CHR_F_WRITE_AUTHOR Set to '-1' to make characteristic read only.

		config MYNEWT_VAL_BLE_SVC_GAP_PPCP_MIN_CONN_INTERVAL
		    int "Value of 'minimum connection interval' of PPCP characteristic as defined by Core specification 5"
		    default 0

		    help 
				Value of 'minimum connection interval' of PPCP characteristic as defined by Core specification 5.0, Vol 3, Part C, section 12.3.

		config MYNEWT_VAL_BLE_SVC_GAP_PPCP_MAX_CONN_INTERVAL
		    int "Value of 'maximum connection interval' of PPCP characteristic as defined by Core specification 5"
		    default 0

		    help 
				Value of 'maximum connection interval' of PPCP characteristic as defined by Core specification 5.0, Vol 3, Part C, section 12.3.

		config MYNEWT_VAL_BLE_SVC_GAP_PPCP_SLAVE_LATENCY
		    int "Value of 'slave latency' of PPCP characteristic as  defined by Core specification 5"
		    default 0

		    help 
				Value of 'slave latency' of PPCP characteristic as  defined by Core specification 5.0, Vol 3, Part C, section 12.3.

		config MYNEWT_VAL_BLE_SVC_GAP_PPCP_SUPERVISION_TMO
		    int "Value of 'connection supervision timeout multiplier' of PPCP characteristic as defined by Core specification 5"
		    default 0

		    help 
				Value of 'connection supervision timeout multiplier' of PPCP characteristic as defined by Core specification 5.0, Vol 3, Part C, section 12.3.

		config MYNEWT_VAL_BLE_SVC_GAP_CENTRAL_ADDRESS_RESOLUTION
		    int "Value of 'Central Address Resolution' characteristics, as defined by Core specification 5"
		    default -1

		    help 
				Value of 'Central Address Resolution' characteristics, as defined by Core specification 5.0, Vol 3, Part C, section 12. Set to '-1' to disable.

		config MYNEWT_VAL_BLE_SVC_GAP_SYSINIT_STAGE
		    int "Sysinit stage for the GAP BLE service."
		    default 301
endmenu
```

## components/ble/mynewt-nimble/nimble/host/services/gatt/Kconfig
```kconfig
menu "gatt"
		config MYNEWT_VAL_BLE_SVC_GATT_SYSINIT_STAGE
		    int "Sysinit stage for the GATT BLE service"
		    default 302
endmenu
```

## components/ble/mynewt-nimble/nimble/host/services/ias/Kconfig
```kconfig
menu "ias"
		config MYNEWT_VAL_BLE_SVC_IAS_SYSINIT_STAGE
		    int "Sysinit stage for the immediate alert BLE service."
		    default 303
endmenu
```

## components/ble/mynewt-nimble/nimble/host/services/ipss/Kconfig
```kconfig
menu "ipss"
		config MYNEWT_VAL_BLE_SVC_IPSS_SYSINIT_STAGE
		    int "Sysinit stage for the IPSS BLE service"
		    default 303
endmenu
```
