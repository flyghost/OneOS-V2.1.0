## Kconfig
```kconfig
source "$OS_ROOT/arch/Kconfig"
source "$OS_ROOT/kernel/Kconfig"
source "$OS_ROOT/libc/Kconfig"
source "$OS_ROOT/osal/Kconfig"
source "$OS_ROOT/drivers/Kconfig"
source "$OS_ROOT/components/Kconfig"
source "$OS_ROOT/thirdparty/Kconfig"

menu "Debug"
    config OS_DEBUG
        bool "Enable debug"
        default y
        help
            dlog, assert and kernel log depends on this config option
        if OS_DEBUG
            choice
                prompt "The log buffer size"
                default LOG_BUFF_SIZE_256
                help
                    The temporary log buffer size for dlog, os_kprintf() and os_kernel_log()
                
                config LOG_BUFF_SIZE_128
                    bool "128"
                config LOG_BUFF_SIZE_192
                    bool "192"
                config LOG_BUFF_SIZE_256
                    bool "256"
                config LOG_BUFF_SIZE_384
                    bool "384" 
            endchoice
            config OS_LOG_BUFF_SIZE
                int
                default 128 if LOG_BUFF_SIZE_128
                default 192 if LOG_BUFF_SIZE_192
                default 256 if LOG_BUFF_SIZE_256
                default 384 if LOG_BUFF_SIZE_384
        endif
endmenu


        
```

## arch/Kconfig
```kconfig
source "$OS_ROOT/arch/arm/Kconfig"
source "$OS_ROOT/arch/mips/Kconfig"
source "$OS_ROOT/arch/risc-v/Kconfig"
source "$OS_ROOT/arch/sim/Kconfig"
```

## arch/arm/Kconfig
```kconfig
config ARCH_ARM
    bool

config ARCH_ARM_CORTEX_M
    bool
    select ARCH_ARM

config ARCH_ARM_CORTEX_M0
    bool
    select ARCH_ARM_CORTEX_M

config ARCH_ARM_CORTEX_M0_PLUS
    bool
    select ARCH_ARM_CORTEX_M
    
config ARCH_ARM_CORTEX_M3
    bool
    select ARCH_ARM_CORTEX_M

config ARCH_ARM_CORTEX_M4
    bool
    select ARCH_ARM_CORTEX_M

config ARCH_ARM_CORTEX_M7
    bool
    select ARCH_ARM_CORTEX_M

config ARCH_ARM_CORTEX_M33
    bool
    select ARCH_ARM_CORTEX_M

config ARCH_ARM_CORTEX_M33_TZ
    bool
    select ARCH_ARM_CORTEX_M
	
	
# ARM9 related definition
config ARCH_ARM_ARM9
    bool
    select ARCH_ARM
	
config ARCH_ARM_ARM968
	bool
	select ARCH_ARM_ARM9
	
```

## arch/mips/Kconfig
```kconfig
config ARCH_MIPS
    bool

config ARCH_MIPS_XBURST
    bool
    select ARCH_MIPS

config ARCH_MIPS_SOC_X1000
    bool
    select ARCH_MIPS_XBURST

config ARCH_MIPS_CHIP_X1000
    bool
    select ARCH_MIPS_SOC_X1000

config ARCH_MIPS_CHIP_X1000E
    bool
    select ARCH_MIPS_SOC_X1000

config ARCH_MIPS_CHIP_X1500
    bool
    select ARCH_MIPS_SOC_X1000

config ARCH_MIPS_LOONGSON
    bool
    select ARCH_MIPS

config ARCH_MIPS_SOC_LS1B
    bool
    select ARCH_MIPS_LOONGSON
```

## arch/mips/loongson/common/Kconfig
```kconfig
menu "ONEOS MIPS CPU"

    config OS_USING_FPU
        bool "Using Float Point Unit"
        default n
        help
            Using Float Point Unit in code.

endmenu
```

## arch/risc-v/Kconfig
```kconfig
config ARCH_RISCV
    bool

config ARCH_RISCV_FPU
    bool

config ARCH_RISCV32
    select ARCH_RISCV
    bool

config ARCH_RISCV64
    select ARCH_RISCV
    select ARCH_CPU_64BIT
    bool

config ARCH_RISCV_BUMBLEBEE
    bool
    select ARCH_RISCV32
```

## arch/sim/Kconfig
```kconfig
config ARCH_X86_64
    bool

config ARCH_SIM_POSIX
    bool
    select ARCH_X86_64

config ARCH_SIM_WIN32
    bool
    select ARCH_X86_64
```

## components/ams/Kconfig
```kconfig
menu "AMS"

    config PKG_USING_AMS
        bool "AMS: Application Managment System of High level language."
    default n

    if PKG_USING_AMS
        config AMS_USING_DEBUG_MODE
            bool "Output the debug mode."
        default n
    if 0
        config AMS_FS_DEVICE_NAME
            string "Set file system device(SD,W25Q64, etc)"
            default "sd0"
        choice 
            prompt "Block device type: SD or Flash."
            default AMS_FS_DEVICE_TYPE_CHOICE_FLASH
            config AMS_FS_DEVICE_TYPE_CHOICE_FLASH
                bool "flash"
            config AMS_FS_DEVICE_TYPE_CHOICE_SD
                bool "sd"
        endchoice
    endif
        choice
            prompt "App type: The High level language used to write Application."
            default AMS_APP_TYPE_CHOICE_PY
            config AMS_APP_TYPE_CHOICE_PY
                bool "MicroPython"
                select PKG_USING_MICROPYTHON
            config AMS_APP_TYPE_CHOICE_JS
                bool "Java Script"
                select USING_IOTJS
        endchoice

        config AMS_USING_PLATFORM
            bool "Using APP platform management."
            default y
        if AMS_USING_PLATFORM
            config AMS_PLARFORM_IP_ADDR
                string "Set the IP address of AMS Cloud platform."
                default "111.10.38.128"
            config AMS_DEVICE_IMEI
                string "Set the imei of the module, length: 15."
                default "861390030650363"
            config AMS_DEVICE_IMSI
                string "Set the imsi of the module, length: 15."
                default "460042370500473"
            config AMS_DEVICE_ICCID
                string "Set the iccid of the module, length: 20."
                default "89860403101892378494"
        endif
        config AMS_MAIN_THD_STACK_SIZE
            int "The stack szie of AMS main thread." 
            default 6144
        config AMS_MAIN_THD_PRIOIRTY
            int "The priority of AMS main thread." 
            default 21
        config AMS_RUN_THD_STACK_SIZE
            int "The stack szie of AMS runner thread." 
            default 8192
        config AMS_RUN_THD_PRIOIRTY
            int "The priority of AMS runner thread." 
            default 25
    endif
    
endmenu
```

## components/atest/Kconfig
```kconfig
menu "Atest"
    config OS_USING_ATEST
        bool "Enable atest"
        default y
        select OS_USING_SHELL
        select OS_USING_DLOG

    if OS_USING_ATEST
        config ATEST_TASK_STACK_SIZE
            int "The atest task stack size"
            default 4096
        config ATEST_TASK_PRIORITY
            int "The atest task priority"
            default 5   if OS_TASK_PRIORITY_8
            default 10  if OS_TASK_PRIORITY_16
            default 20  if OS_TASK_PRIORITY_32
            default 40  if OS_TASK_PRIORITY_64
            default 80  if OS_TASK_PRIORITY_128
            default 160 if OS_TASK_PRIORITY_256
    endif
endmenu
```

## components/ble/Kconfig
```kconfig
menu "BLE"

    config OS_USING_BLE
        bool "Enable BLE stack"
        default n
        select OS_USING_TIMER_SOFT

    if OS_USING_BLE
        choice
            prompt "BLE stack choose"
            help
                Select the BLE stack

            config BLE_USING_NIMBLE
                bool "NimBLE"
        endchoice

        if BLE_USING_NIMBLE
            source "$OS_ROOT/components/ble/mynewt-nimble/nimble/Kconfig"
        endif
    endif

endmenu
```

## components/ble/mynewt-nimble/nimble/Kconfig
```kconfig
menu "NimBLE"

    if BLE_USING_NIMBLE
        # config MYNEWT_VAL_BLE_ROLE_BROADCASTER
        #    int "Enables the Broadcaster bluetooth role. (0/1)"
        #    default 1
        config BLE_ROLE_BROADCASTER
            bool "Enables the Broadcaster bluetooth role. (0/1)"
            default y
        config MYNEWT_VAL_BLE_ROLE_BROADCASTER
            int 
            default 0 if !BLE_ROLE_BROADCASTER
            default 1 if BLE_ROLE_BROADCASTER


        # config MYNEWT_VAL_BLE_ROLE_PERIPHERAL
        #    int "Enables the Peripheral bluetooth role. (0/1)"
        #    default 1
        config BLE_ROLE_PERIPHERAL
            bool "Enables the Peripheral bluetooth role. (0/1)"
            default y
        config MYNEWT_VAL_BLE_ROLE_PERIPHERAL
            int 
            default 0 if !BLE_ROLE_PERIPHERAL
            default 1 if BLE_ROLE_PERIPHERAL


        # config MYNEWT_VAL_BLE_ROLE_OBSERVER
        #    int "Enables the Observer bluetooth role. (0/1)"
        #    default 1
        config BLE_ROLE_OBSERVER
            bool "Enables the Observer bluetooth role. (0/1)"
            default y
        config MYNEWT_VAL_BLE_ROLE_OBSERVER
            int 
            default 0 if !BLE_ROLE_OBSERVER
            default 1 if BLE_ROLE_OBSERVER


        # config MYNEWT_VAL_BLE_ROLE_CENTRAL
        #    int "Enables the Central bluetooth role. (0/1)"
        #    default 1
        config BLE_ROLE_CENTRAL
            bool "Enables the Central bluetooth role. (0/1)"
            default y
        config MYNEWT_VAL_BLE_ROLE_CENTRAL
            int 
            default 0 if !BLE_ROLE_CENTRAL
            default 1 if BLE_ROLE_CENTRAL


		config MYNEWT_VAL_BLE_MAX_CONNECTIONS
		    int "The maximum number of concurrent connections."
		    default 1


		config MYNEWT_VAL_BLE_MAX_PERIODIC_SYNCS
		    int "The maximum number of concurrent periodic syncs that can  be created"
		    default 1



        # config MYNEWT_VAL_BLE_WHITELIST
        #    int "Enables the BLE whitelist for controlling who to connect to or accept a connection from. (0/1)"
        #    default 1
        config BLE_WHITELIST
            bool "Enables the BLE whitelist for controlling who to connect to or accept a connection from. (0/1)"
            default y
        config MYNEWT_VAL_BLE_WHITELIST
            int 
            default 0 if !BLE_WHITELIST
            default 1 if BLE_WHITELIST

		config MYNEWT_VAL_BLE_MULTI_ADV_INSTANCES
		    int "This is the number of multi-advertising instances"
		    default 0

		    help 
				This is the number of multi-advertising instances. This is NOT the total number of advertising instances. The total number of advertising instances is this number plus 1 (assuming the device supports advertising).

		# config MYNEWT_VAL_BLE_EXT_ADV
		#     int "This enables extended advertising feature."
		#     default 0
        config BLE_EXT_ADV
            bool "This enables extended advertising feature."
            default n
        config MYNEWT_VAL_BLE_EXT_ADV
            int
            default 0 if !BLE_EXT_ADV
            default 1 if BLE_EXT_ADV


		# config MYNEWT_VAL_BLE_PERIODIC_ADV
		#     int "This enables periodic advertising feature."
		#     default 0
        config BLE_PERIODIC_ADV
            bool "This enables periodic advertising feature."
            default n
        config MYNEWT_VAL_BLE_PERIODIC_ADV
            int
            default 0 if !BLE_PERIODIC_ADV
            default 1 if BLE_PERIODIC_ADV



		# config MYNEWT_VAL_BLE_PERIODIC_ADV_SYNC_TRANSFER
		#     int "This enables Periodic Advertising Sync Transfer Feature."
		#     default 0
        config BLE_PERIODIC_ADV_SYNC_TRANSFER
            bool "This enables Periodic Advertising Sync Transfer Feature."
            default n
        config MYNEWT_VAL_BLE_PERIODIC_ADV_SYNC_TRANSFER
            int
            default 0 if !BLE_PERIODIC_ADV_SYNC_TRANSFER
            default 1 if BLE_PERIODIC_ADV_SYNC_TRANSFER



		config MYNEWT_VAL_BLE_EXT_ADV_MAX_SIZE
		    int "This allows to configure maximum size of advertising data and scan response data used in LE Advertising Extensions"
		    default 31

		    help 
				This allows to configure maximum size of advertising data and scan response data used in LE Advertising Extensions. Valid range 31-1650.

		config MYNEWT_VAL_BLE_VERSION
		    int "This allows to configure supported Bluetooth Core version"
		    default 50

		    help 
				This allows to configure supported Bluetooth Core version. Some features may not be available if version is too low. Version is integer for easy comparison.

		# config MYNEWT_VAL_BLE_ISO
		#     int "This enables LE Isochronous Channels as per Bluetooth v5.2"
		#     default 0
        config BLE_ISO
            bool "This enables LE Isochronous Channels as per Bluetooth v5.2"
            default n
        config MYNEWT_VAL_BLE_ISO
            int
            default 0 if !BLE_ISO
            default 1 if BLE_ISO



        # config MYNEWT_VAL_BLE_ISO_TEST
        #    int "Enables BLE ISO Testing commands"
        #    default 0
        config BLE_ISO_TEST
            bool "Enables BLE ISO Testing commands"
            default n
        config MYNEWT_VAL_BLE_ISO_TEST
            int 
            default 0 if !BLE_ISO_TEST
            default 1 if BLE_ISO_TEST


        config MYNEWT_VAL_MSYS_1_BLOCK_COUNT
            int "Nimble memory system 1 block count."
            default 12
        
        config MYNEWT_VAL_MSYS_1_BLOCK_SIZE
            int "Nimble memory system 1 block size."
            default 292

        config MYNEWT_VAL_MSYS_2_BLOCK_COUNT
            int "Nimble memory system 2 block count."
            default 0
        
        config MYNEWT_VAL_MSYS_2_BLOCK_SIZE
            int "Nimble memory system 2 block size."
            default 0
        

        source "$OS_ROOT/components/ble/mynewt-nimble/nimble/host/Kconfig"
        source "$OS_ROOT/components/ble/mynewt-nimble/nimble/controller/Kconfig"
		source "$OS_ROOT/components/ble/mynewt-nimble/nimble/transport/Kconfig"
        source "$OS_ROOT/components/ble/mynewt-nimble/nimble/drivers/Kconfig"

        config NIMBLE_CFG_TINYCRYPT
		    bool "NimBLE use tinycrypt in SM."
		    default y
    endif
endmenu
```
