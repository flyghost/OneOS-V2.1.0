## components/cloud/aliyun/Kconfig
```kconfig
# Kconfig file for package ali-iotkit
menu "Aliyun"
    config PKG_USING_ALI_IOTKIT
    bool "Ali-iotkit: Aliyun cloud sdk 'iotkit-embedded'"
    select NET_USING_BSD    
    default n

if PKG_USING_ALI_IOTKIT

    choice
        prompt "Version"
        default PKG_USING_ALI_IOTKIT_V30100
        help
            Select the ali-iotkit version

        config PKG_USING_ALI_IOTKIT_V30100
            bool "v3.1.0"
    endchoice
    
    config PKG_USING_ALI_IOTKIT_PRODUCT_KEY
        string "Config Product Key"
        default "a1mFunc9SVl"

    config PKG_USING_ALI_IOTKIT_PRODUCT_SECRET
        string "Config Product Secret"
        default "*******"

    config PKG_USING_ALI_IOTKIT_DEVICE_NAME
        string "Config Device Name"
        default "dev_0"        

    config PKG_USING_ALI_IOTKIT_DEVICE_SECRET
        string "Config Device Secret"
        default "4mevyxGE6CGCGX8kL6dGWIyIj7Gq31tj"

    config PKG_ALI_IOTKIT_SELECT_ITEM
        bool
        select PLATFORM_HAS_OS
        select PLATFORM_HAS_STDINT
        default y
        
    if PKG_USING_ALI_IOTKIT_V30100
        source "$OS_ROOT/components/cloud/aliyun/tools/menu/Config.infra"
        source "$OS_ROOT/components/cloud/aliyun/tools/menu/Config.dev_sign"
        source "$OS_ROOT/components/cloud/aliyun/tools/menu/Config.mqtt"
    #    source "$OS_ROOT/components/cloud/aliyun/tools/menu/Config.dynamic_register"
        source "$OS_ROOT/components/cloud/aliyun/tools/menu/Config.wrappers"
        source "$OS_ROOT/components/cloud/aliyun/tools/menu/Config.ota"
        source "$OS_ROOT/components/cloud/aliyun/tools/menu/Config.coap"
    #    source "$OS_ROOT/components/cloud/aliyun/tools/menu/Config.http"
    endif
    
    config PKG_USING_ALI_IOTKIT_SAMPLES
        bool "Samples"
        default n 

    if PKG_USING_ALI_IOTKIT_SAMPLES
        config PKG_USING_ALI_IOTKIT_MQTT_SAMPLE
            bool "Enable MQTT sample"
            depends on MQTT_COMM_ENABLED
            default y
        config PKG_USING_ALI_IOTKIT_COAP_SAMPLE
            bool "Enable COAP sample"
            depends on COAP_COMM_ENABLED
            default n
        config PKG_USING_ALI_IOTKIT_OTA_SAMPLE
            bool "Enable OTA sample"
            depends on OTA_ENABLED
            default n
    endif


endif
endmenu
```

## components/cloud/aws/Kconfig
```kconfig
# Kconfig file for package amazon-iot

menu "AWS"
    config PKG_USING_AWS_IOT
    bool "Enable AWS-IoT: Amazon cloud iot sdk"
    select OS_USING_RTC
    select BSP_USING_ONCHIP_RTC
    select NET_USING_BSD
    select PKG_USING_NTP
    select OS_USING_TIMER_SOFT
    select SECURITY_USING_MBEDTLS
    select MBEDTLS_THREADING_ALT
    default n

if PKG_USING_AWS_IOT

    choice
        prompt "Select sdk version"
        default PKG_USING_AWS_IOT_V40000
        help
            Select the aws-iot version

        config PKG_USING_AWS_IOT_V40000
            bool "v4.0.0"
    endchoice
    
    #config AWS_IOT_TLS_FORCE_VERIFY
    #bool "TLS enable verify cert"
    #default n

    choice
        prompt "The AWS global output log level."
        default AWS_IOT_LOG_OUTPUT_LVL_I
        help
            When the log level is less than this option and it will stop output.
        
        config AWS_IOT_LOG_OUTPUT_LVL_N
            bool "None"
        config AWS_IOT_LOG_OUTPUT_LVL_E
            bool "Error"
        config AWS_IOT_LOG_OUTPUT_LVL_W
            bool "Warning"
        config AWS_IOT_LOG_OUTPUT_LVL_I
            bool "Information"
        config AWS_IOT_LOG_OUTPUT_LVL_D
            bool "Debug"
    endchoice

    config AWS_IOT_LOG_LEVEL_GLOBAL
        int
        default 0 if AWS_IOT_LOG_OUTPUT_LVL_N
        default 1 if AWS_IOT_LOG_OUTPUT_LVL_E
        default 2 if AWS_IOT_LOG_OUTPUT_LVL_W
        default 3 if AWS_IOT_LOG_OUTPUT_LVL_I
        default 4 if AWS_IOT_LOG_OUTPUT_LVL_D
    
    choice
        prompt "Select test method"
        default AWS_IOT_USING_DEMO
        help
            Select the aws-iot test method
        
        config AWS_IOT_USING_DEMO
            bool "Enable demo"
   
        config AWS_IOT_USING_UNITY_TESTS
            bool "Enable unity tests"
    endchoice
     

    #source "$OS_ROOT/thirdparty/AWSIoT-v4.0.0/tools/menu/Config.demo"
    #source "$OS_ROOT/thirdparty/AWSIoT-v4.0.0/tools/menu/Config.unity_tests"
    
    if AWS_IOT_USING_DEMO
        
        config AWS_IOT_DEMO_SERVER
            string "Config demo host name"
            default ""

        config AWS_IOT_DEMO_PORT
            int "Config demo port"
            default 8883

        config AWS_IOT_DEMO_ROOT_CA
            bool "Enable demo root ca certificate"
            default y        

        config AWS_IOT_DEMO_CLIENT_CERT
            bool "Enable demo client certificate"
            default y
        
        config AWS_IOT_DEMO_PRIVATE_KEY
            bool "Enable demo client key"
            default y

        config AWS_IOT_DEMO_USER_NAME
            string "Config demo user name"
            default ""

        config AWS_IOT_DEMO_PASSWORD
            string "Config demo password"
            default ""

        config AWS_IOT_DEMO_IDENTIFIER
            string "Config demo identifier (thing name)"
            default ""
            
    endif
    
    if AWS_IOT_USING_UNITY_TESTS
    
        config AWS_IOT_TEST_SERVER
        string "Config unity tests host name"
        default ""

        config AWS_IOT_TEST_PORT
            int "Config unity tests port"
            default 8883

        config AWS_IOT_TEST_ROOT_CA
            bool "Enable unity tests root ca certificate"
            default y

        config AWS_IOT_TEST_CLIENT_CERT
            bool "Enable unity tests client certificate"
            default y

        config AWS_IOT_TEST_PRIVATE_KEY
            bool "Enable unity tests client key"
            default y

        config AWS_IOT_TEST_USER_NAME
            string "Config unity tests user name"
            default ""
        
        config AWS_IOT_TEST_PASSWORD
            string "Config unity tests password"
            default ""
            
        config AWS_IOT_TEST_MQTT_CLIENT_IDENTIFIER
            string "Config unity tests mqtt client identifier (thing name)"
            default ""
            
        config AWS_IOT_TEST_SHADOW_THING_NAME
            string "Config unity tests shadow thing name"
            default ""
            
        config AWS_IOT_TEST_JOBS_THING_NAME
            string "Config unity tests jobs thing name"
            default ""
        
        config AWS_IOT_TEST_DEFENDER_THING_NAME
            string "Config unity tests defender thing name"
            default ""

        config AWS_IOT_UNITY_TEST_DEMOS
            bool "Using unity test demos"
            default n
            
    endif
    
endif
endmenu
```

## components/cloud/aws/tools/Config.in
```kconfig
mainmenu "Main Menu"
comment "Configure for demo or unity tests"

source "tools/menu/Config.demo"
source "tools/menu/Config.unity_tests"
```

## components/cloud/baidu/Kconfig
```kconfig
# Kconfig file for Baiduiot
menu "Baidu"

menuconfig BAIDUIOT
    bool "Baidu iotcore"
    select NET_USING_BSD 
    default n
    
if (BAIDUIOT)
    choice
        prompt "Select method"
        config BAIDUIOT_DEMO
        bool "Enable demo"

#        config BAIDU_UNITTEST
#        bool "Enable unit test"
    endchoice
endif

if (BAIDUIOT_DEMO)
    source "$OS_ROOT/components/cloud/baidu/iotcore_client/samples/Kconfig"
endif

if (BAIDU_UNITTEST)
    source "$OS_ROOT/components/cloud/baidu/c-utility/tests/Kconfig"
endif

endmenu
```

## components/cloud/baidu/c-utility/tests/Kconfig
```kconfig
# Kconfig file for Baiduiot unit test
#menu "Unit test"
    comment "Enable Baidu IoT Unit Test"
    choice 
        prompt "Choose unittest"
        config AGENTTIME_UT
        bool "agenttime_ut"

        config BASE64_UT
        bool "base64_ut"

        config BUFFER_UT
        bool "buffer_ut"

        config CONSTBUFFER_UT
        bool "constbuffer_ut"

        config CONSTMAP_UT
        bool "constmap_ut"

        config CRTABSTTRACTIONS_UT
        bool "crtabstractions_ut"

        config DNS_ASYNC_UT
        bool "dns_async_ut"

        config DOUBLYLINKEDLIST_UT
        bool "doublylinkedlist_ut"

        config GBALLOC_UT
        bool "gballoc_ut"

        config GBALLOC_WITHOUT_INIT_UT
        bool "gballoc_without_init_ut"     

        config HMACSHA256_UT
        bool "hmacsha256_ut"           

        config HTTP_PROXY_IO_UT
        bool "http_proxy_io_ut"  

        config LOCK_UT
        bool "lock_ut"    

        config MAP_UT
        bool "map_ut" 

        config OPTIONHANDLER_UT
        bool "optionhandler_ut" 

        config REFCOUNT_UT
        bool "refcount_ut" 

        config SASTOKEN_UT
        bool "sastoken_ut" 

#        config SOCKETIO_BERKELEY_UT
#        bool "socketio_berkeley_ut" 

        config STRING_TOKENIZER_UT
        bool "string_tokenizer_ut" 

        config STRINGS_UT
        bool "strings_ut" 

        config TICKCOUNTER_UT
        bool "tickcounter_ut" 

        config TLSIO_OPTIONS_UT
        bool "tlsio_options_ut" 

        config URLENCODE_UT
        bool "urlencode_ut" 

        config UTF8_CHECKER_UT
        bool "utf8_checker_ut" 

        config UWS_CLIENT_UT
        bool "uws_client_ut" 

        config UWS_FRAME_ENCODER_UT
        bool "uws_frame_encoder_ut" 

        config VECTOR_UT
        bool "vector_ut" 

        config WSIO_UT
        bool "wsio_ut" 

        config XIO_UT
        bool "xio_ut" 

        config UMQTT_CLIENT_UT
        bool "umqttclient_ut" 

        config UMQTT_CODE_UT
        bool "umqttcode_ut" 

        config UMQTT_MESSAGE_UT
        bool "umqttmessage_ut" 

    endchoice

#endmenu
```

## components/cloud/baidu/iotcore_client/samples/Kconfig
```kconfig
# Kconfig file for Baiduiot demos
#menu "Demo"
    comment "Enable Baidu IoT Demo"

    config BAIDUIOT_CLOUD_WITH_TLS
        bool "Enable/Disable TLS"
        select SECURITY_USING_MBEDTLS
        select MBEDTLS_ECP_NIST_OPTIM
        default n

    if (BAIDUIOT_CLOUD_WITH_TLS)
        choice
            prompt "Secret Key Type"
            default BAIDUIOT_PSK

            config BAIDUIOT_PSK
            bool "PSK"

            config BAIDUIOT_CA
            bool "CA"
        endchoice
    endif

    config BAIDUIOT_SERVER_ADDRESS
        string "Config Server Address"
        default "xxx.iot.gz.baidubce.com"
        help 
            Access point returned by IoT platform after creating instance
            
    config BAIDUIOT_IOTCORE_ID
        string "Config IoTCore ID"
        default "iot core id"
        
    config BAIDUIOT_DEVICE_KEY
        string "Config Device Key"
        default "device key"
        
    if BAIDUIOT_PSK || !(BAIDUIOT_CLOUD_WITH_TLS)
        config BAIDUIOT_DEVICE_SECRET
            string "Config Device Secret"
            default "device secret"
    endif

#endmenu
```

## components/cloud/ctwing/mqtt/Kconfig
```kconfig
menu "MQTT"

config OS_USING_CTWING_MQTT
    bool "Enable ctwing mqtt"
    select NET_USING_PAHO_MQTT
    select PKG_USING_CJSON
    select NET_USING_BSD
    default n

if OS_USING_CTWING_MQTT

    config CTIOT_MQTT_USING_TLS
        bool "Enable ctwing mqtt TLS encrypt"
        select SECURITY_USING_MBEDTLS
        default n

    config CTIOT_MQTT_DEVICE_NEED_DN_DATA
        bool "Enable device echo server command"
        default y

    config CTIOT_MQTT_DEVICE_TRANSPARENT
        bool "Enable device transparent transport"
        default n

    choice
        prompt "The ctiot mqtt global output log level"
        default CTIOT_LOG_OUTPUT_LVL_D
        help
            When the log level is less than this option and it will stop output.

        config CTIOT_LOG_OUTPUT_LVL_D
            bool "Debug"
        config CTIOT_LOG_OUTPUT_LVL_I
            bool "Information"
        config CTIOT_LOG_OUTPUT_LVL_W
            bool "Warning"
        config CTIOT_LOG_OUTPUT_LVL_E
            bool "Error"
        config CTIOT_LOG_OUTPUT_LVL_F
            bool "Fatal"
    endchoice

    config CTIOT_LOG_LEVEL_GLOBAL
        int
        default 0 if CTIOT_LOG_OUTPUT_LVL_D
        default 1 if CTIOT_LOG_OUTPUT_LVL_I
        default 2 if CTIOT_LOG_OUTPUT_LVL_W
        default 3 if CTIOT_LOG_OUTPUT_LVL_E
        default 4 if CTIOT_LOG_OUTPUT_LVL_F

    config CTIOT_MQTT_USING_DEMO
            bool "Enable ctiot mqtt demo"
            default y

        if CTIOT_MQTT_USING_DEMO
            config CTIOT_MQTT_DEVICE_NUMBER	
            string "Config demo device number"
                default ""

            config CTIOT_MQTT_DEVICE_ID
            string "Config demo device id"
                default "" 

            config CTIOT_MQTT_DEVICE_TOKEN
            string "Config demo device token"
                default "" 
        endif
    endif
    
endmenu
```

## components/cloud/huawei/Kconfig
```kconfig
menu "Huawei"

config USING_HUAWEI_CLOUD_CONNECT
    bool "Using huawei cloud connect component"
    select NET_USING_BSD
    default n
    
    if USING_HUAWEI_CLOUD_CONNECT
        choice
            prompt "Transport Protocol"
            default HUAWEI_CLOUD_PORTOCOL_LwM2M

            config HUAWEI_CLOUD_PORTOCOL_LwM2M
                bool "LwM2M"

            config HUAWEI_CLOUD_PORTOCOL_MQTT
            select PKG_USING_CJSON
                bool "MQTT"
        endchoice
    endif

    source "$OS_ROOT/components/cloud/huawei/src/security/mbedtls/Kconfig"
    
    if HUAWEI_CLOUD_PORTOCOL_LwM2M
        source "$OS_ROOT/components/cloud/huawei/demos/agenttiny_lwm2m/Kconfig"
    endif
    
    if HUAWEI_CLOUD_PORTOCOL_MQTT
        source "$OS_ROOT/components/cloud/huawei/demos/agenttiny_mqtt/Kconfig"
    endif

endmenu
```

## components/cloud/huawei/demos/agenttiny_lwm2m/Kconfig
```kconfig
config HUAWEI_CLOUD_LwM2M_DEMO
    bool "Enable LwM2M demo program"
    default n
if HUAWEI_CLOUD_LwM2M_DEMO
    config HUAWEI_IOT_LWM2M_SERVER_ADDRESS
        string "LwM2M Server Address"
        default "119.3.250.80"
    config HUAWEI_IOT_DEVICE_LWM2M_ID
        string "Config Device ID Code"
        default "dev_0"
endif
```

## components/cloud/huawei/demos/agenttiny_mqtt/Kconfig
```kconfig
if USING_HUAWEI_CLOUD_CONNECT && HUAWEI_CLOUD_PORTOCOL_MQTT
    config HUAWEI_CLOUD_MQTT_DEMO
        bool "Enable MQTT demo program"
        default n
endif

if HUAWEI_CLOUD_MQTT_DEMO
    config HUAWEI_IOT_MQTT_SERVER_ADDRESS
        string "MQTT Server Address"
        default "121.36.42.100"
    config HUAWEI_IOT_MQTT_PRODUCT_ID
        string "Config Product ID"
        default "123456"
    config HUAWEI_IOT_MQTT_DEVICE_ID
        string "Config Device ID Code"
        default "dev_0"
endif
```
