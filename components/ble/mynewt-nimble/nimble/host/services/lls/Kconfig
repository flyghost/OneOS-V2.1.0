## components/ble/mynewt-nimble/nimble/host/services/lls/Kconfig
```kconfig
menu "lls"
		config MYNEWT_VAL_BLE_SVC_LLS_SYSINIT_STAGE
		    int "Sysinit stage for the link loss BLE service."
		    default 303
endmenu
```

## components/ble/mynewt-nimble/nimble/host/services/tps/Kconfig
```kconfig
menu "tps"
		config MYNEWT_VAL_BLE_SVC_TPS_SYSINIT_STAGE
		    int "Sysinit stage for the transmit power BLE service."
		    default 303
endmenu
```

## components/ble/mynewt-nimble/nimble/host/store/config/Kconfig
```kconfig
menu "config"
		config MYNEWT_VAL_BLE_STORE_CONFIG_PERSIST
		    int "Whether to save data to sys/config, or just keep it in RAM."
		    default 1


		config MYNEWT_VAL_BLE_STORE_SYSINIT_STAGE
		    int "Sysinit stage for BLE host store."
		    default 500
endmenu
```

## components/ble/mynewt-nimble/nimble/host/store/ram/Kconfig
```kconfig
menu "ram"
		config MYNEWT_VAL_BLE_STORE_RAM_SYSINIT_STAGE
		    int "Sysinit stage for the RAM BLE store."
		    default 500


		config MYNEWT_VAL_BLE_STORE_RAM_DEPRECATED_FLAG
		    int "Package store/ram is deprecated and store/config shall be used with BLE_STORE_CONFIG_PERSIST set to 0"
		    default 0

		    help 
				Package store/ram is deprecated and store/config shall be used with BLE_STORE_CONFIG_PERSIST set to 0
endmenu
```

## components/ble/mynewt-nimble/nimble/transport/Kconfig
```kconfig
menu "Transport"
choice
    prompt "HCI transport Select"
    default BLE_USING_RAM
    help
        Selects HCI transport to be included in build. This has virtually the same effect as including package dependency manually, but it allows to easily override HCI transport package in application or target settings.

    config BLE_USING_RAM
        bool "ram"

    config BLE_USING_UART
        bool "uart"

    config BLE_USING_SOCKET
        bool "socket"

    config BLE_USING_USB
        bool "usb"

endchoice

    if SOC_FAMILY_NRF52
        if BLE_USING_RAM
            source "$OS_ROOT/components/ble/mynewt-nimble/nimble/transport/ram/Kconfig"
        endif

        if BLE_USING_UART
            source "$OS_ROOT/components/ble/mynewt-nimble/nimble/transport/uart/Kconfig"
        endif

        if BLE_USING_SOCKET
            source "$OS_ROOT/components/ble/mynewt-nimble/nimble/transport/socket/Kconfig"
        endif

        if BLE_USING_USB
            source "$OS_ROOT/components/ble/mynewt-nimble/nimble/transport/usb/Kconfig"
        endif
    endif

    if (!SOC_FAMILY_NRF52)
        if BLE_USING_UART
            source "$OS_ROOT/components/ble/mynewt-nimble/nimble/transport/uart/Kconfig"
        endif
    endif



endmenu
```

## components/ble/mynewt-nimble/nimble/transport/da1469x/Kconfig
```kconfig
config MYNEWT_VAL_
    int ""
    default 

config MYNEWT_VAL_BLE_HCI_EVT_HI_BUF_COUNT
    int "Number of high-priority event buffers."
    default  2


config MYNEWT_VAL_BLE_HCI_EVT_LO_BUF_COUNT
    int "Number of low-priority event buffers."
    default  8


config MYNEWT_VAL_BLE_HCI_EVT_BUF_SIZE
    int "Size of each event buffer, in bytes."
    default  70


config MYNEWT_VAL_BLE_ACL_BUF_COUNT
    int "The number of ACL data buffers"
    default 4
```

## components/ble/mynewt-nimble/nimble/transport/emspi/Kconfig
```kconfig
config MYNEWT_VAL_
    int ""
    default 

config MYNEWT_VAL_BLE_HCI_EMSPI
    int "Indicates that the emspi host HCI transport is present."
    default 1


config MYNEWT_VAL_    restrictions
    int "Indicates that the emspi host HCI transport is present."
    default 1


config MYNEWT_VAL_BLE_HCI_EVT_HI_BUF_COUNT
    int "Number of high-priority event buffers."
    default  2


config MYNEWT_VAL_BLE_HCI_EVT_LO_BUF_COUNT
    int "Number of low-priority event buffers."
    default  8


config MYNEWT_VAL_BLE_HCI_EVT_BUF_SIZE
    int "Size of each event buffer, in bytes."
    default  70


config MYNEWT_VAL_BLE_ACL_BUF_COUNT
    int "The number of ACL data buffers"
    default 4


config MYNEWT_VAL_BLE_ACL_BUF_SIZE
    int "This is the maximum size of the data portion of HCI ACL datapackets. It does not include the HCI data header (of 4 bytes)."
    default 255


config MYNEWT_VAL_BLE_HCI_ACL_OUT_COUNT
    int "This count is used in creating a pool of elements used by thecode to enqueue various elements. In the case of the controlleronly HCI, this number should be equal to the number of mbufs inthe msys pool. For host only, it is really dependent on thenumber of ACL buffers that the controller tells the host ithas."
    default 12


config MYNEWT_VAL_BLE_HCI_EMSPI_SPI_NUM
    int "This count is used in creating a pool of elements used by thecode to enqueue various elements. In the case of the controlleronly HCI, this number should be equal to the number of mbufs inthe msys pool. For host only, it is really dependent on thenumber of ACL buffers that the controller tells the host ithas."
    default 5


config MYNEWT_VAL_BLE_HCI_EMSPI_BAUD
    int "This count is used in creating a pool of elements used by thecode to enqueue various elements. In the case of the controlleronly HCI, this number should be equal to the number of mbufs inthe msys pool. For host only, it is really dependent on thenumber of ACL buffers that the controller tells the host ithas."
    default 8000000


config MYNEWT_VAL_BLE_HCI_EMSPI_RESET_PIN
    int "This count is used in creating a pool of elements used by thecode to enqueue various elements. In the case of the controlleronly HCI, this number should be equal to the number of mbufs inthe msys pool. For host only, it is really dependent on thenumber of ACL buffers that the controller tells the host ithas."
    default 42


config MYNEWT_VAL_BLE_HCI_EMSPI_SS_PIN
    int "This count is used in creating a pool of elements used by thecode to enqueue various elements. In the case of the controlleronly HCI, this number should be equal to the number of mbufs inthe msys pool. For host only, it is really dependent on thenumber of ACL buffers that the controller tells the host ithas."
    default 45


config MYNEWT_VAL_BLE_HCI_EMSPI_RDY_PIN
    int "The GPIO pin that the EM controller uses to indicate data ready."
    default 26


config MYNEWT_VAL_BLE_HCI_EMSPI_PRIO
    int "The GPIO pin that the EM controller uses to indicate data ready."
    default 5


config MYNEWT_VAL_BLE_HCI_EMSPI_STACK_SIZE
    int "The size of the emspi task (units: 4-byte words)."
    default 256
```

## components/ble/mynewt-nimble/nimble/transport/ram/Kconfig
```kconfig
menu "ram"
		config MYNEWT_VAL_BLE_HCI_EVT_HI_BUF_COUNT
		    int "Number of high-priority event buffers."
		    default  2


		config MYNEWT_VAL_BLE_HCI_EVT_LO_BUF_COUNT
		    int "Number of low-priority event buffers."
		    default  8


		config MYNEWT_VAL_BLE_HCI_EVT_BUF_SIZE
		    int "Size of each event buffer, in bytes."
			default  257 if BLE_EXT_ADV
		    default  70


		config MYNEWT_VAL_BLE_ACL_BUF_COUNT
		    int "The number of ACL data buffers"
		    default 4


		config MYNEWT_VAL_BLE_ACL_BUF_SIZE
		    int "This is the maximum size of the data portion of HCI ACL data packets"
		    default 255

		    help 
				This is the maximum size of the data portion of HCI ACL data packets. It does not include the HCI data header (of 4 bytes).

		config MYNEWT_VAL_BLE_TRANS_RAM_SYSINIT_STAGE
		    int "Sysinit stage for the RAM BLE transport."
		    default 100
endmenu
```

## components/ble/mynewt-nimble/nimble/transport/socket/Kconfig
```kconfig
menu "socket"
		config MYNEWT_VAL_BLE_HCI_EVT_BUF_SIZE
		    int "The size of the allocated event buffers"
			default 257 if BLE_EXT_ADV
		    default 70


		config MYNEWT_VAL_BLE_HCI_EVT_HI_BUF_COUNT
		    int "The number of high priority event buffers"
		    default 8


		config MYNEWT_VAL_BLE_HCI_EVT_LO_BUF_COUNT
		    int "The number of low priority event buffers"
		    default 8


		config MYNEWT_VAL_BLE_ACL_BUF_COUNT
		    int "The number of ACL data buffers"
		    default 24


		config MYNEWT_VAL_BLE_ACL_BUF_SIZE
		    int "This is the maximum size of the data portion of HCI ACL data packets"
		    default 255

		    help 
				This is the maximum size of the data portion of HCI ACL data packets. It does not include the HCI data header (of 4 bytes).

		config MYNEWT_VAL_BLE_HCI_ACL_OUT_COUNT
		    int "This count is used in creating a pool of elements used by the code to enqueue various elements"
		    default 12

		    help 
				This count is used in creating a pool of elements used by the code to enqueue various elements. In the case of the controller only HCI, this number should be equal to the number of mbufs in the msys pool. For host only, it is really dependent on the number of ACL buffers that the controller tells the host it has.

		config MYNEWT_VAL_BLE_SOCK_USE_TCP
		    int "Use TCP socket, connects to BLE_SOCK_TCP_PORT"
		    default 1


		config MYNEWT_VAL_BLE_SOCK_TCP_PORT
		    int "ipv4 tcp port to connect to"
		    default 14433


		config MYNEWT_VAL_BLE_SOCK_USE_LINUX_BLUE
		    int "Use Linux bluetooth raw socket"
		    default 0


		config MYNEWT_VAL_BLE_SOCK_LINUX_DEV
		    int "linux kernel device"
		    default 0


		config MYNEWT_VAL_BLE_SOCK_TASK_PRIO
		    int "Priority of the HCI socket task."
		    default 9


		config MYNEWT_VAL_BLE_SOCK_STACK_SIZE
		    int "Size of the HCI socket stack (units=words)."
		    default 80


		config MYNEWT_VAL_BLE_SOCK_CLI_SYSINIT_STAGE
		    int "Sysinit stage for the socket BLE transport."
		    default 500

endmenu
```

## components/ble/mynewt-nimble/nimble/transport/uart/Kconfig
```kconfig
menu "uart"
		config MYNEWT_VAL_BLE_HCI_EVT_BUF_SIZE
		    int "The size of the allocated event buffers"
			default 257 if BLE_EXT_ADV
		    default 70


		config MYNEWT_VAL_BLE_HCI_EVT_HI_BUF_COUNT
		    int "The number of high priority event buffers"
		    default 8


		config MYNEWT_VAL_BLE_HCI_EVT_LO_BUF_COUNT
		    int "The number of low priority event buffers"
		    default 8


		config MYNEWT_VAL_BLE_ACL_BUF_COUNT
		    int "The number of ACL data buffers"
		    default 12


		config MYNEWT_VAL_BLE_ACL_BUF_SIZE
		    int "This is the maximum size of the data portion of HCI ACL data packets"
		    default 255

		    help 
				This is the maximum size of the data portion of HCI ACL data packets. It does not include the HCI data header (of 4 bytes).

		config MYNEWT_VAL_BLE_HCI_ACL_OUT_COUNT
		    int "This count is used in creating a pool of elements used by the code to enqueue various elements"
		    default 12

		    help 
				This count is used in creating a pool of elements used by the code to enqueue various elements. In the case of the controller only HCI, this number should be equal to the number of mbufs in the msys pool. For host only, it is really dependent on the number of ACL buffers that the controller tells the host it has.

		config MYNEWT_VAL_BLE_HCI_UART_PORT
		    int "The uart to use for the HCI uart interface"
		    default            0


		config MYNEWT_VAL_BLE_HCI_UART_BAUD
		    int "The baud rate of the HCI uart interface"
		    default            1000000


		config MYNEWT_VAL_BLE_HCI_UART_DATA_BITS
		    int "Number of data bits used for HCI uart interface"
		    default       8


		config MYNEWT_VAL_BLE_HCI_UART_STOP_BITS
		    int "Number of stop bits used for HCI uart interface"
		    default       1


		config MYNEWT_VAL_BLE_HCI_UART_PARITY
		    int "Parity used for HCI uart interface. No Parity-0, Odd parity-1, Even parity-2."
		    default       0


		config MYNEWT_VAL_BLE_HCI_UART_FLOW_CTRL
		    int "Flow control used for HCI uart interface. No Flow Control-0, RTS/CTS-1."
		    default       0


		config MYNEWT_VAL_BLE_TRANS_UART_SYSINIT_STAGE
		    int "Sysinit stage for the UART BLE transport."
		    default 500
endmenu
```

## components/ble/mynewt-nimble/nimble/transport/usb/Kconfig
```kconfig
menu "usb"
		config MYNEWT_VAL_BLE_HCI_EVT_BUF_SIZE
		    int "The size of the allocated event buffers"
			default 257 if BLE_EXT_ADV
		    default 70


		config MYNEWT_VAL_BLE_HCI_EVT_HI_BUF_COUNT
		    int "The number of high priority event buffers"
		    default 8


		config MYNEWT_VAL_BLE_HCI_EVT_LO_BUF_COUNT
		    int "The number of low priority event buffers"
		    default 8


		config MYNEWT_VAL_BLE_ACL_BUF_COUNT
		    int "The number of ACL data buffers"
		    default 12


		config MYNEWT_VAL_BLE_ACL_BUF_SIZE
		    int "This is the maximum size of the data portion of HCI ACL data packets"
		    default 255

		    help 
				This is the maximum size of the data portion of HCI ACL data packets. It does not include the HCI data header (of 4 bytes).

		config MYNEWT_VAL_BLE_HCI_ACL_OUT_COUNT
		    int "This count is used in creating a pool of elements used by the code to enqueue various elements"
		    default 12

		    help 
				This count is used in creating a pool of elements used by the code to enqueue various elements. In the case of the controller only HCI, this number should be equal to the number of mbufs in the msys pool. For host only, it is really dependent on the number of ACL buffers that the controller tells the host it has.

		config MYNEWT_VAL_BLE_TRANS_USB_SYSINIT_STAGE
		    int "Sysinit stage for the USB BLE transport."
		    default 500
endmenu
```

## components/cli/Kconfig
```kconfig
menu "CLI"
    config OS_USING_CLI
        bool "Enable command line interface"
        default n
        if OS_USING_CLI
            choice
            prompt "choice cli payload network"
            default CLI_PAYLOAD_BY_CMS 
                    config CLI_PAYLOAD_BY_CMS
                        bool "payload by cms"
                    config CLI_PAYLOAD_BY_LWIP
                        bool "payload by lwip"
                    config CLI_PAYLOAD_BY_MOLINK
                        bool "payload by molink"
            endchoice
            if CLI_PAYLOAD_BY_CMS
                config CLI_DATA_PAYLOAD_SCODE
                    int "cms service code for cli data payload"
                    default 2001
                config CLI_CONTROL_PAYLOAD_SCODE
                    int "cms service code for cli control payload"
                    default 2000
            endif
        endif
endmenu
```
