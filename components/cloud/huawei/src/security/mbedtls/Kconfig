## components/cloud/huawei/src/security/mbedtls/Kconfig
```kconfig
if (USING_HUAWEI_CLOUD_CONNECT)
    config HUAWEI_CLOUD_WITH_TLS
        bool "Enable/Disable (D)TLS"
        default n
endif

if (HUAWEI_CLOUD_WITH_TLS)
    choice
        prompt "Secret Key Type"
        default HUAWEI_PSK

        config HUAWEI_PSK
        bool "PSK"

    if (HUAWEI_CLOUD_PORTOCOL_MQTT)
        config HUAWEI_CA
        bool "CA"
    endif

    endchoice
endif

if (HUAWEI_CLOUD_PORTOCOL_MQTT) && !(HUAWEI_CLOUD_WITH_TLS)
    config HUAWEI_CLOUD_MQTT_PASSWORD
        string "Config Password Value"
        default "12345678"
endif

if HUAWEI_PSK
    config HUAWEI_CLOUD_PSK
        string "Config PSK Value"
        default "12345678"
endif
```

## components/cloud/onenet/Kconfig
```kconfig
menu "OneNET"

source "$OS_ROOT/components/cloud/onenet/mqtt-kit/Kconfig"
source "$OS_ROOT/components/cloud/onenet/nbiot-kit/Kconfig"
source "$OS_ROOT/components/cloud/onenet/edp/Kconfig"

endmenu
```

## components/cloud/onenet/edp/Kconfig
```kconfig
menu "EDP"

config OS_USING_ONENET_EDP
	bool "Enable onenet edp protocal"
    select PKG_USING_CJSON
    select NET_USING_BSD
    select BSP_USING_ONCHIP_RTC
    select OS_USING_RTC
    select PKG_USING_NTP
	default n
    
    if OS_USING_ONENET_EDP
    
        config OS_USING_ONENET_EDP_CRYPT
            bool "Enable edp crypt"
            select SECURITY_USING_MBEDTLS
            default n            
                    
        config OS_USING_ONENET_EDP_SAMPLE
            bool "Enable edp sample"
            default n            
    endif
	
endmenu
```

## components/cloud/onenet/mqtt-kit/Kconfig
```kconfig
menu "MQTT kit"

config OS_USING_ONENET_MQTTS
    bool "Enable onenet mqtt-kit"
    select NET_USING_PAHO_MQTT
    select MQTT_USING_CLIENT
    select PKG_USING_CJSON
    select NET_USING_BSD
    default n

    if OS_USING_ONENET_MQTTS

        config ONENET_MQTTS_PUBLISH_DATA_BUFFER_LENGTH
            int "The publish data buffer length"
            default 128

        config ONENET_MQTTS_USING_TLS
            bool "Enable mqtt-kit TLS encrypt"
            select MQTT_USING_TLS
            default n

        config ONENET_MQTTS_USING_AUTO_REGISTER
            bool "Enable onenet device auto register"
            default n

    endif

endmenu
```

## components/cloud/onenet/nbiot-kit/Kconfig
```kconfig
menu "NB-IoT kit"

config OS_USING_ONENET_NBIOT
	bool "Enable onenet nbiot-kit ( Not open source, contact OneOS Team if necessary )"

	default n

endmenu
```

## components/cms/Kconfig
```kconfig
menu "CMS"
    choice
        prompt "CMS Version"
            default CMS_LITE

        config CMS_LITE
            bool "CMS Lite"

        config CMS_STD
            bool "CMS Standard"
    endchoice
    source "$OS_ROOT/components/cms/*/Kconfig"
endmenu
```

## components/cms/cms_connect/Kconfig
```kconfig
menu "CMS Connect"

config USING_CMS_CONNECT
    bool "Using CMS connect component"
    select NET_USING_BSD
    select CMS_HEARTBEAT_ENABLE
    default n
    
    if USING_CMS_CONNECT
        choice
            prompt "Application Protocol"
            default CMS_CONNECT_MQTT

            config CMS_CONNECT_MQTT
                bool "MQTT"
                select NET_USING_PAHO_MQTT

            config CMS_CONNECT_UDP
                bool "UDP"

            config CMS_CONNECT_TCP
                bool "TCP"
        endchoice
    endif

    if USING_CMS_CONNECT
        choice
            prompt "CMS log print level"
            default CMS_LOG_INFO

            config CMS_LOG_ERROR
                bool "Error"

            config CMS_LOG_WARNING
                bool "Warning"

            config CMS_LOG_INFO
                bool "Info"

            config CMS_LOG_DEBUG
                bool "Debug"

        endchoice
    endif

    source "$OS_ROOT/components/cms/cms_connect/source/connect_manager/Kconfig"
    source "$OS_ROOT/components/cms/cms_connect/source/connect_server/Kconfig"
    
    if CMS_CONNECT_COAP
        source "$OS_ROOT/components/cms/cms_connect/source/coap/Kconfig"
    endif
    
    if CMS_CONNECT_MQTT
        source "$OS_ROOT/components/cms/cms_connect/source/mqtt/Kconfig"
    endif

    if CMS_CONNECT_LWM2M
        source "$OS_ROOT/components/cms/cms_connect/source/lwm2m/Kconfig"
    endif

endmenu
```

## components/cms/cms_connect/source/connect_manager/Kconfig
```kconfig
if USING_CMS_CONNECT
    config CMS_SERVER_ADDRESS
        string "CMS Server Address"
        default "172.16.21.83"
        
    config CMS_SERVER_PORT
        string "CMS Server Port"
        default "6588" if CMS_CONNECT_MQTT
        default "6588" if CMS_CONNECT_TCP
        default "5688" if CMS_CONNECT_UDP
    
    config CMS_SEND_BUFF
        int "Size of send buffer"
        default 1460
    
    config CMS_RECV_BUFF
        int "Size of receive buffer"
        default 1460
endif
```

## components/cms/cms_connect/source/connect_server/Kconfig
```kconfig
if USING_CMS_CONNECT
    config CMS_HEARTBEAT_ENABLE
    bool "Enable/disable CMS heartbeat"
    default y
    if CMS_HEARTBEAT_ENABLE
        if CMS_CONNECT_MQTT || CMS_CONNECT_TCP
            config CMS_HEARTBEAT_INTERVAL
                int "CMS heartbeat interval(s)"
                range 1 1000 
                default 300
        endif
        if CMS_CONNECT_COAP || CMS_CONNECT_UDP || CMS_CONNECT_LWM2M
            config CMS_HEARTBEAT_INTERVAL
                int "CMS heartbeat interval(s)"
                range 1 65535
                default 300
        endif
    endif
endif
```

## components/cms/cms_connect/source/lwm2m/Kconfig
```kconfig
menu "LwM2M Config"

#	config CMS_LWM2M_USING_SECURE
#		bool "CMS LwM2M using DTLS encrypt"
#		select SECURITY_USING_MBEDTLS
#		default n
		
	config CMS_LWM2M_USING_SAMPLE
		bool "Enable CMS LwM2M sample"
		default n
		
#		if CMS_LWM2M_USING_SAMPLE
#		config CMS_LWM2M_SERVER_ADDR
#			   string "CMS LwM2M server address"
#			   default "192.168.1.102"
#		config CMS_LWM2M_SERVER_PORT
#			   string "CMS LwM2M server port"
#			   default "5684"
#		endif
		
	config LWM2M_CLIENT_MODE
		bool "Enable CMS LwM2M client mode"
		default	y

	config CMS_LWM2M_MAX_OBJECT_COUNT
		int "cms lwm2m max object count"
		default	32
	
	config CMS_LWM2M_READ_TIMEOUT_S
		int "cms lwm2m read timeout (s)"
		default	1

    choice 
        prompt "Select log level"		
        default CMS_LWM2M_LOG_DEBUG
		
        config CMS_LWM2M_LOG_ERROR
            bool "Error Log Level"
        config CMS_LWM2M_LOG_WARN
            bool "Warn Log Level"
        config CMS_LWM2M_LOG_INFO
            bool "Info Log Level"
        config CMS_LWM2M_LOG_DEBUG
            bool "Debug Log Level"
        config CMS_LWM2M_LOG_VERBOSE
            bool "Verbose Log Level"
        config CMS_LWM2M_LOG_NONE
            bool "None Log Level"
    endchoice
	
endmenu
```

## components/cms/cms_id/Kconfig
```kconfig
menu "CMS ID"
config CMS_USING_ID
    bool "Enable CMS_ID for register and verification"
#    select SECURITY_USING_MBEDTLS
    default n

    if CMS_USING_ID
        config CMS_ID_SET_PID
            prompt "Pid config"
            help
                config pid
            string
            default "BfGoACQ38Q"

            config CMS_ID_KEY
            prompt "key config"
            help
                config key by hex
            string
            default "E6004E3F46ED3627F7C72E3AE2346FD6"

            choice
                prompt "Auth Mode"
                default UNILATERALISM_AUTH

                config MUTUAL_AUTH
                    bool "Mutual Auth"

                config UNILATERALISM_AUTH
                    bool "Unilateralism Auth"
            endchoice
    endif
    
endmenu
```

## components/diagnose/Kconfig
```kconfig
menu "Diagnose"
	config STACK_TRACE_EN
		bool "Stack back trace enable"
		default n

	if STACK_TRACE_EN
		config EXC_DUMP_STACK
			bool "back trace dump stack"
			default n
		config TASK_STACK_OVERFLOW_STACK_SIZE
			int "The stack overflow back trace size"
			default 256	
			
		config CALL_BACK_TRACE_MAX_DEPTH
			int "The stack back trace max depth"
			default 10				
	endif

    config OS_USING_WIRESHARK_DUMP
        bool "Enable wireshark dump"
        default n

	menu "eCoreDump"
	source "$OS_ROOT/components/diagnose/eCoreDump/Kconfig"
	endmenu
endmenu
```

## components/diagnose/eCoreDump/Kconfig
```kconfig
# menu "eCoreDump"

	config USING_ECORE_DUMP
		bool "Using eCoreDump"
		default n
		select OS_USING_FAL

	if USING_ECORE_DUMP

		choice
			prompt "Select the arch"
			default ECOREDUMP_ARCH_ARMV7M
			help
				Select the arch

			config ECOREDUMP_ARCH_ARMV7M
				bool "armv7m"
		endchoice

		config USING_ECORE_DUMP_EXAMPLE
			bool "Using example"
			default y

	endif

# endmenu
```

## components/dlog/Kconfig
```kconfig
menu "Dlog"
    config OS_USING_DLOG
    bool "Enable dlog"
    default y
    
    if OS_USING_DLOG 
        choice
            prompt "The log global output level."
            default DLOG_PRINT_LVL_W
            help
                When the log level is less than this option and it will stop output.

            config DLOG_PRINT_LVL_E
                bool "Error"
            config DLOG_PRINT_LVL_W
                bool "Warning"
            config DLOG_PRINT_LVL_I
                bool "Information"
            config DLOG_PRINT_LVL_D
                bool "Debug"
        endchoice
        config DLOG_GLOBAL_PRINT_LEVEL
            int
            default 3 if DLOG_PRINT_LVL_E
            default 4 if DLOG_PRINT_LVL_W
            default 6 if DLOG_PRINT_LVL_I
            default 7 if DLOG_PRINT_LVL_D
    
        choice
            prompt "The log compile level."
            default DLOG_COMPILE_LVL_D
            help
                When the log level is less than this option and it will not compile.

            config DLOG_COMPILE_LVL_E
                bool "Error"
            config DLOG_COMPILE_LVL_W
                bool "Warning"
            config DLOG_COMPILE_LVL_I
                bool "Information"
            config DLOG_COMPILE_LVL_D
                bool "Debug"
        endchoice
        config DLOG_COMPILE_LEVEL
            int
            default 3 if DLOG_COMPILE_LVL_E
            default 4 if DLOG_COMPILE_LVL_W
            default 6 if DLOG_COMPILE_LVL_I
            default 7 if DLOG_COMPILE_LVL_D
    
        config DLOG_USING_ISR_LOG
            bool "Enable ISR log."
            default y
            help
                The log output API can be used in ISR (Interrupt Service Routines) also.

        config DLOG_USING_FILTER
            bool "Enable runtime log filter."
            default y
            help
                It will enable the log filter.
                Such as log tag filter, log keyword filter and tag's level filter.

        config DLOG_USING_ASYNC_OUTPUT
            bool "Enable async output mode."
            default y
            help
                When enable asynchronous output mode. The log output is not immediately and the log will stored to buffer.
                The another task will read the buffer and output the log. So it will use more RAM.

            if DLOG_USING_ASYNC_OUTPUT
                config DLOG_ASYNC_OUTPUT_BUF_SIZE
                    int "The async output buffer size."
                    default 2048

                config DLOG_ASYNC_OUTPUT_TASK_STACK_SIZE
                    int "The async output task stack size."
                    default 2048

                config DLOG_ASYNC_OUTPUT_TASK_PRIORITY
                    int "The async output task stack priority."
                    range 0 OS_TASK_PRIORITY_MAX
                    default 5   if OS_TASK_PRIORITY_8
                    default 10  if OS_TASK_PRIORITY_16
                    default 20  if OS_TASK_PRIORITY_32
                    default 40  if OS_TASK_PRIORITY_64
                    default 80  if OS_TASK_PRIORITY_128
                    default 160 if OS_TASK_PRIORITY_256
            endif

        config DLOG_USING_SYSLOG
            bool "Enable syslog"
            default n

        menu "Log format"
            config DLOG_OUTPUT_FLOAT
                bool "Enable float number support. It will use more task stack."
                select OS_USING_LIBC
                default n
                help
                    The default formater is using os_vsnprint and it not supported float number.
                    When enable this option then it will enable libc. The formater will change to vsnprint on libc.

            config DLOG_WITH_FUNC_LINE
                bool "Enable log with function name and line number."
                default y
                help
                    Enable log with function name and line number.

            config DLOG_USING_COLOR
                bool "Enable color log."
                default y
                help
                    The log will has different color by level.

            config DLOG_OUTPUT_TIME_INFO
                bool "Enable time information."
                default y

            config DLOG_TIME_USING_TIMESTAMP
                bool "Enable timestamp format for time."
                default n
                select OS_USING_LIBC
                depends on DLOG_OUTPUT_TIME_INFO
        endmenu
			
		menu "Dlog backend option"
			
			config DLOG_BACKEND_USING_CONSOLE
				bool "Enable console backend."
				default y
				help
					The log is output through console.

			config DLOG_BACKEND_USING_FILESYSTEM
				bool "Enable dlog backend use filesystem to record."
				default n
				select DLOG_USING_ASYNC_OUTPUT
				select DLOG_BACKEND_USING_CONSOLE
				help
					When enable dlog using filesystem mode. The log output will be record in filesystem as file.

				if DLOG_BACKEND_USING_FILESYSTEM											
					config DLOG_FILE_DIR
						string "The record file path."
						default "/dlog/"
						
					config DLOG_FILE_NAME
						string "The record file name."
						default "log.txt"
						
					config DLOG_FILE_SIZE
						int "The record file size."
						default 2048
				
					config DLOG_FILE_NUM
						int "The record file number."
						default 5
					
				endif
		endmenu		
    endif
endmenu
```
