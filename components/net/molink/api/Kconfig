## components/net/molink/module/me3616/Kconfig
```kconfig
menu "ME3616 Config" 

    config ME3616_AUTO_CREATE
        bool "Enable ME3616 Module Object Auto Create"
        default n

    if ME3616_AUTO_CREATE

        config ME3616_DEVICE_NAME
            string "ME3616 Interface Device Name"
            default "uart2"

        config ME3616_DEVICE_RATE
            int "ME3616 Interface Device Rate"
            default 115200

        config ME3616_RECV_BUFF_LEN
            int "The maximum length of AT command data accepted"
            default 512

    endif

    config ME3616_USING_GENERAL_OPS
        bool "Enable ME3616 Module General Operates"
        select MOLINK_USING_GENERAL_OPS
        default y
    
    config ME3616_USING_NETSERV_OPS
        bool "Enable ME3616 Module Network Service Operates"
        select MOLINK_USING_NETSERV_OPS
        default y

    config ME3616_USING_IFCONFIG_OPS
        bool "Enable ME3616 Module Ifconfig Operates"
        select MOLINK_USING_IFCONFIG_OPS
        select ME3616_USING_GENERAL_OPS
        select ME3616_USING_NETSERV_OPS
        default y

    config ME3616_USING_PING_OPS
        bool "Enable Me3616 Module Ping Operates"
        select MOLINK_USING_PING_OPS
        default y

    config ME3616_USING_NETCONN_OPS
        bool "Enable ME3616 Module Network TCP/IP Operates"
        select MOLINK_USING_NETCONN_OPS
        default y

    config ME3616_USING_SOCKETS_OPS
        bool "Enable ME3616 Module BSD Socket Operates"
        select ME3616_USING_NETCONN_OPS
        select MOLINK_USING_SOCKETS_OPS
        default n

endmenu
```
