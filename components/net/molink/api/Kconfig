## components/net/molink/module/esp32/Kconfig
```kconfig
menu "ESP32 Config"

    config ESP32_AUTO_CREATE
        bool "Enable ESP32 Module Object Auto Create"
        default n

    if ESP32_AUTO_CREATE

        config ESP32_DEVICE_NAME
            string "ESP32 Interface Device Name"
            default "uart2"

        config ESP32_DEVICE_RATE
            int "ESP32 Interface Device Rate"
            default 115200

        config ESP32_RECV_BUFF_LEN
            int "The maximum length of AT command data accepted"
            default 2048

        config ESP32_AUTO_CONNECT_AP
            bool "Enable ESP32 Module Auto Connect"
            select ESP32_USING_WIFI_OPS
            default y
    endif

    config ESP32_CONNECT_SSID
        string "ESP32 Connect AP SSID"
        default "ssid"

    config ESP32_CONNECT_PASSWORD
        string "ESP32 Connect AP Password"
        default "password"

    config ESP32_USING_GENERAL_OPS
        bool "Enable ESP32 Module General Operates"
        select MOLINK_USING_GENERAL_OPS
        default y

    config ESP32_USING_WIFI_OPS
        bool "Enable ESP32 Module WiFi Operates"
        select MOLINK_USING_WIFI_OPS
        default y

    config ESP32_USING_PING_OPS
        bool "Enable ESP32 Module Ping Operates"
        select MOLINK_USING_PING_OPS
        default y

    config ESP32_USING_IFCONFIG_OPS
        bool "Enable ESP32 Module Ifconfig Operates"
        select MOLINK_USING_IFCONFIG_OPS
        select ESP32_USING_WIFI_OPS
        default y

    config ESP32_USING_NETCONN_OPS
        bool "Enable ESP32 Module Network TCP/IP Operates"
        select OS_USING_EVENT
        select MOLINK_USING_NETCONN_OPS
        default y

    config ESP32_USING_SOCKETS_OPS
        bool "Enable ESP32 Module BSD Socket Operates"
        select ESP32_USING_NETCONN_OPS
        select MOLINK_USING_SOCKETS_OPS
        default n

endmenu
```

## components/net/molink/module/esp8266/Kconfig
```kconfig
menu "ESP8266 Config" 

    config ESP8266_AUTO_CREATE
        bool "Enable ESP8266 Module Object Auto Create"
        default n

    if ESP8266_AUTO_CREATE

        config ESP8266_DEVICE_NAME
            string "ESP8266 Interface Device Name"
            default "uart2"

        config ESP8266_DEVICE_RATE
            int "ESP8266 Interface Device Rate"
            default 115200

        config ESP8266_RECV_BUFF_LEN
            int "The maximum length of AT command data accepted"
            default 512

        config ESP8266_AUTO_CONNECT_AP
            bool "Enable ESP8266 Module Auto Connect"
            select ESP8266_USING_WIFI_OPS
            default y
    endif

    config ESP8266_CONNECT_SSID
        string "ESP8266 Connect AP SSID"
        default "ssid"

    config ESP8266_CONNECT_PASSWORD
        string "ESP8266 Connect AP Password"
        default "password"

    config ESP8266_USING_GENERAL_OPS
        bool "Enable ESP8266 Module General Operates"
        select MOLINK_USING_GENERAL_OPS
        default y

    config ESP8266_USING_WIFI_OPS
        bool "Enable ESP8266 Module WiFi Operates"
        select MOLINK_USING_WIFI_OPS
        default y

    config ESP8266_USING_PING_OPS
        bool "Enable ESP8266 Module Ping Operates"
        select MOLINK_USING_PING_OPS
        default y

    config ESP8266_USING_IFCONFIG_OPS
        bool "Enable ESP8266 Module Ifconfig Operates"
        select MOLINK_USING_IFCONFIG_OPS
        select ESP8266_USING_WIFI_OPS
        default y

    config ESP8266_USING_NETCONN_OPS
        bool "Enable ESP8266 Module Network TCP/IP Operates"
        select OS_USING_EVENT
        select MOLINK_USING_NETCONN_OPS
        default y
        
        if ESP8266_USING_NETCONN_OPS
            config ESP8266_USING_IPV6
                bool "Enable ESP8266 Module IPV6 Operates"
                default n
           
         endif
            
    config ESP8266_USING_SOCKETS_OPS
        bool "Enable ESP8266 Module BSD Socket Operates"
        select ESP8266_USING_NETCONN_OPS
        select MOLINK_USING_SOCKETS_OPS
        default n

    config ESP8266_USING_HW_CONTROL
        bool "Enable ESP8266 Module Hardware Control Operates"
        select OS_USING_PIN
        default n

        if ESP8266_USING_HW_CONTROL
            config ESP8266_RST_PIN_NUM
                int "The ESP8266 Module Reset Pin Number"
                help 
                    This can be calculated using GET_PIN(PORTx, PIN)
                default -1

        endif
endmenu
```

## components/net/molink/module/gm120/Kconfig
```kconfig
menu "GM120 Config" 

    config GM120_AUTO_CREATE
        bool "Enable GM120 Module Object Auto Create"
        default n

    if GM120_AUTO_CREATE

        config GM120_DEVICE_NAME
            string "GM120 Interface Device Name"
            default "uart2"

        config GM120_DEVICE_RATE
            int "GM120 Interface Device Rate"
            default 115200

        config GM120_RECV_BUFF_LEN
            int "The maximum length of AT command data accepted"
            default 122

    endif

    config GM120_USING_GENERAL_OPS
        bool "Enable GM120 Module General Operates"
        select MOLINK_USING_GENERAL_OPS
        default y

    config GM120_USING_NETSERV_OPS
        bool "Enable GM120 Module Network Service Operates"
        select MOLINK_USING_NETSERV_OPS
        default y
		
    config GM120_USING_PING_OPS
        bool "Enable GM120 Module Ping Operates"
        select MOLINK_USING_PING_OPS
        default y
		
    config GM120_USING_IFCONFIG_OPS
        bool "Enable GM120 Module Ifconfig Operates"
        select MOLINK_USING_IFCONFIG_OPS
        select GM120_USING_GENERAL_OPS
        select GM120_USING_NETSERV_OPS
        default y
		
    config GM120_USING_NETCONN_OPS
        bool "Enable GM120 Module Network TCP/IP Operates"
        select MOLINK_USING_NETCONN_OPS
        default y

    config GM120_USING_SOCKETS_OPS
        bool "Enable GM120 Module BSD Socket Operates"
        select GM120_USING_NETCONN_OPS
        select MOLINK_USING_SOCKETS_OPS
        default n

endmenu
```

## components/net/molink/module/gm190/Kconfig
```kconfig
menu "GM190 Config" 

    config GM190_AUTO_CREATE
        bool "Enable GM190 Module Object Auto Create"
        default n

    if GM190_AUTO_CREATE

        config GM190_DEVICE_NAME
            string "GM190 Interface Device Name"
            default "uart2"

        config GM190_DEVICE_RATE
            int "GM190 Interface Device Rate"
            default 115200

        config GM190_RECV_BUFF_LEN
            int "The maximum length of AT command data accepted"
            default 512

    endif

    config GM190_USING_GENERAL_OPS
        bool "Enable GM190 Module General Operates"
        select MOLINK_USING_GENERAL_OPS
        default y
		
    config GM190_USING_NETSERV_OPS
        bool "Enable GM190 Module Network Service Operates"
        select MOLINK_USING_NETSERV_OPS
        default y

    config GM190_USING_IFCONFIG_OPS
        bool "Enable GM190 Module Ifconfig Operates"
        select MOLINK_USING_IFCONFIG_OPS
        select GM190_USING_GENERAL_OPS
        select GM190_USING_NETSERV_OPS
        default y
		
    config GM190_USING_NETCONN_OPS
        bool "Enable GM190 Module Network TCP/IP Operates"
        select MOLINK_USING_NETCONN_OPS
        default y

    config GM190_USING_SOCKETS_OPS
        bool "Enable GM190 Module BSD Socket Operates"
        select GM190_USING_NETCONN_OPS
        select MOLINK_USING_SOCKETS_OPS
        default n

endmenu
```

## components/net/molink/module/gm510/Kconfig
```kconfig
menu "GM510 Config" 

    config GM510_AUTO_CREATE
        bool "Enable GM510 Module Object Auto Create"
        default n

    if GM510_AUTO_CREATE

        config GM510_DEVICE_NAME
            string "GM510 Interface Device Name"
            default "uart2"

        config GM510_DEVICE_RATE
            int "GM510 Interface Device Rate"
            default 115200

        config GM510_RECV_BUFF_LEN
            int "The maximum length of AT command data accepted"
            default 512

    endif

    config GM510_USING_GENERAL_OPS
        bool "Enable GM510 Module General Operates"
        select MOLINK_USING_GENERAL_OPS
        default y

    config GM510_USING_NETSERV_OPS
        bool "Enable GM510 Module Network Service Operates"
        select MOLINK_USING_NETSERV_OPS
        default y

    config GM510_USING_IFCONFIG_OPS
        bool "Enable GM510 Module Ifconfig Operates"
        select MOLINK_USING_IFCONFIG_OPS
        select GM510_USING_GENERAL_OPS
        select GM510_USING_NETSERV_OPS
        default y
		
    config GM510_USING_NETCONN_OPS
        bool "Enable GM510 Module Network TCP/IP Operates"
        select MOLINK_USING_NETCONN_OPS
        default y

    config GM510_USING_SOCKETS_OPS
        bool "Enable GM510 Module BSD Socket Operates"
        select GM510_USING_NETCONN_OPS
        select MOLINK_USING_SOCKETS_OPS
        default n

endmenu
```

## components/net/molink/module/l610/Kconfig
```kconfig
menu "L610 Config" 

    config L610_AUTO_CREATE
        bool "Enable L610 Module Object Auto Create"
        default n

    if L610_AUTO_CREATE

        config L610_DEVICE_NAME
            string "L610 Interface Device Name"
            default "uart2"

        config L610_DEVICE_RATE
            int "L610 Interface Device Rate"
            default 115200

        config L610_RECV_BUFF_LEN
            int "The maximum length of AT command data accepted"
            default 512

    endif

    config L610_USING_GENERAL_OPS
        bool "Enable L610 Module General Operates"
        select MOLINK_USING_GENERAL_OPS
        default y
    
    config L610_USING_NETSERV_OPS
        bool "Enable L610 Module Network Service Operates"
        select MOLINK_USING_NETSERV_OPS
        default y

    config L610_USING_PING_OPS
        bool "Enable L610 Module Ping Operates"
        select MOLINK_USING_PING_OPS
        default y

    config L610_USING_IFCONFIG_OPS
        bool "Enable L610 Module Ifconfig Operates"
        select MOLINK_USING_IFCONFIG_OPS
        select L610_USING_GENERAL_OPS
        select L610_USING_NETSERV_OPS
        default y

    config L610_USING_NETCONN_OPS
        bool "Enable L610 Module Network TCP/IP Operates"
        select MOLINK_USING_NETCONN_OPS
        default y

    config L610_USING_SOCKETS_OPS
        bool "Enable L610 Module BSD Socket Operates"
        select L610_USING_NETCONN_OPS
        select MOLINK_USING_SOCKETS_OPS
        default n

endmenu
```

## components/net/molink/module/m5310a/Kconfig
```kconfig
menu "M5310A Config"

    config M5310A_AUTO_CREATE
        bool "Enable M5310A Module Object Auto Create"
        default n

    if M5310A_AUTO_CREATE

        config M5310A_DEVICE_NAME
            string "M5310A Interface Device Name"
            default "uart2"

        config M5310A_DEVICE_RATE
            int "M5310A Interface Device Rate"
            default 9600

        config M5310A_RECV_BUFF_LEN
            int "The maximum length of AT command data accepted"
            default 3072

    endif

    config M5310A_USING_GENERAL_OPS
        bool "Enable M5310A Module General Operates"
        select MOLINK_USING_GENERAL_OPS
        default y

    config M5310A_USING_NETSERV_OPS
        bool "Enable M5310A Module Network Service Operates"
        select MOLINK_USING_NETSERV_OPS
        default y

    config M5310A_USING_PING_OPS
        bool "Enable M5310A Module Ping Operates"
        select MOLINK_USING_PING_OPS
        default y

    config M5310A_USING_IFCONFIG_OPS
        bool "Enable M5310A Module Ifconfig Operates"
        select MOLINK_USING_IFCONFIG_OPS
        select M5310A_USING_GENERAL_OPS
        select M5310A_USING_NETSERV_OPS
        default y
    config M5310A_USING_NETCONN_OPS
        bool "Enable M5310A Module Network TCP/IP Operates"
        select MOLINK_USING_NETCONN_OPS
        default y

    config M5310_USING_SOCKETS_OPS
        bool "Enable M5310A Module BSD Socket Operates"
        select M5310A_USING_NETCONN_OPS
        select MOLINK_USING_SOCKETS_OPS
        default n

#    config M5310A_USING_ONENET_NB_OPS
#        bool "Enable M5310A Module Onenet Nb Operates"
#        select MOLINK_USING_ONENET_NB_OPS
#        select M5310A_USING_GENERAL_OPS
#        default y

endmenu
```

## components/net/molink/module/m5311/Kconfig
```kconfig
menu "M5311 Config" 

    config M5311_AUTO_CREATE
        bool "Enable M5311 Module Object Auto Create"
        default n

    if M5311_AUTO_CREATE

        config M5311_DEVICE_NAME
            string "M5311 Interface Device Name"
            default "uart2"

        config M5311_DEVICE_RATE
            int "M5311 Interface Device Rate"
            default 115200

        config M5311_RECV_BUFF_LEN
            int "The maximum length of AT command data accepted"
            default 1500

    endif

    config M5311_USING_GENERAL_OPS
        bool "Enable M5311 Module General Operates"
        select MOLINK_USING_GENERAL_OPS
        default y
    
    config M5311_USING_NETSERV_OPS
        bool "Enable M5311 Module Network Service Operates"
        select MOLINK_USING_NETSERV_OPS
        default y

    config M5311_USING_PING_OPS
        bool "Enable M5311 Module Ping Operates"
        select MOLINK_USING_PING_OPS
        default y

    config M5311_USING_IFCONFIG_OPS
        bool "Enable M5311 Module Ifconfig Operates"
        select MOLINK_USING_IFCONFIG_OPS
        select M5311_USING_GENERAL_OPS
        select M5311_USING_NETSERV_OPS
        default y

    config M5311_USING_NETCONN_OPS
        bool "Enable M5311 Module Network TCP/IP Operates"
        select MOLINK_USING_NETCONN_OPS
        default y

    config M5311_USING_SOCKETS_OPS
        bool "Enable M5311 Module BSD Socket Operates"
        select M5311_USING_NETCONN_OPS
        select MOLINK_USING_SOCKETS_OPS
        default n

    config M5311_USING_ONENET_NB_OPS
        bool "Enable M5311 Module Onenet Nb Operates"
        select MOLINK_USING_ONENET_NB_OPS
        default y

endmenu
```

## components/net/molink/module/mb26/Kconfig
```kconfig
menu "MB26 Config"

    config MB26_AUTO_CREATE
        bool "Enable MB26 Module Object Auto Create"
        default n

    if MB26_AUTO_CREATE

        config MB26_DEVICE_NAME
            string "MB26 Interface Device Name"
            default "uart2"

        config MB26_DEVICE_RATE
            int "MB26 Interface Device Rate"
            default 9600

        config MB26_RECV_BUFF_LEN
            int "The maximum length of AT command data accepted"
            default 1088

    endif

    config MB26_USING_GENERAL_OPS
        bool "Enable MB26 Module General Operates"
        select MOLINK_USING_GENERAL_OPS
        default y

    config MB26_USING_NETSERV_OPS
        bool "Enable MB26 Module Network Service Operates"
        select MOLINK_USING_NETSERV_OPS
        default y

    config MB26_USING_PING_OPS
        bool "Enable MB26 Module Ping Operates"
        select MOLINK_USING_PING_OPS
        default y

    config MB26_USING_IFCONFIG_OPS
        bool "Enable MB26 Module Ifconfig Operates"
        select MOLINK_USING_IFCONFIG_OPS
        select MB26_USING_GENERAL_OPS
        select MB26_USING_NETSERV_OPS
        default y
    config MB26_USING_NETCONN_OPS
        bool "Enable MB26 Module Network TCP/IP Operates"
        select MOLINK_USING_NETCONN_OPS
        default y

    config MB26_USING_SOCKETS_OPS
        bool "Enable MB26 Module BSD Socket Operates"
        select MB26_USING_NETCONN_OPS
        select MOLINK_USING_SOCKETS_OPS
        default n

    config MB26_USING_CTM2M_OPS
        bool "Enable MB26 Module CTM2M Operates"
        select MOLINK_USING_CTM2M_OPS
        select OS_USING_MESSAGEQUEUE
        default n

endmenu
```
