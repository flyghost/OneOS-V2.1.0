## components/net/molink/module/bc20/Kconfig
```kconfig
menu "BC20 Config" 

    config BC20_AUTO_CREATE
        bool "Enable BC20 Module Object Auto Create"
        select MOLINK_USING_AUTO_CREATE
        default n

    if BC20_AUTO_CREATE

#        config BC20_USING_AUTO_PROBE
#            bool "Enable BC20 Auto probe."
#            select MOLINK_USING_AUTO_PROBE_OPS
#            default n
#
#            if BC20_USING_AUTO_PROBE
#                config BC20_AUTOPROBE_IDENTIFIER
#                    string "autoprobe identifier."
#                    default "BC20"
#            endif

        config BC20_DEVICE_NAME
            string "BC20 Interface Device Name"
            default "uart2"

        config BC20_DEVICE_RATE
            int "BC20 Interface Device Rate"
            default 115200

        config BC20_RECV_BUFF_LEN
            int "The maximum length of AT command data accepted"
            default 1024

    endif

    config BC20_USING_GENERAL_OPS
        bool "Enable BC20 Module General Operates"
        select MOLINK_USING_GENERAL_OPS
        default y
    
    config BC20_USING_NETSERV_OPS
        bool "Enable BC20 Module Network Service Operates"
        select MOLINK_USING_NETSERV_OPS
        default y

    config BC20_USING_PING_OPS
        bool "Enable BC20 Module Ping Operates"
        select MOLINK_USING_NETSERV_OPS
        select MOLINK_USING_PING_OPS
        default y

    config BC20_USING_IFCONFIG_OPS
        bool "Enable BC20 Module Ifconfig Operates"
        select MOLINK_USING_IFCONFIG_OPS
        select BC20_USING_GENERAL_OPS
        select BC20_USING_NETSERV_OPS
        default y

    config BC20_USING_NETCONN_OPS
        bool "Enable BC20 Module Network TCP/IP Operates"
        select MOLINK_USING_NETCONN_OPS
        select BC20_USING_NETSERV_OPS
        default y

    config BC20_USING_SOCKETS_OPS
        bool "Enable BC20 Module BSD Socket Operates"
        select BC20_USING_NETCONN_OPS
        select MOLINK_USING_SOCKETS_OPS
        default n

endmenu
```

## components/net/molink/module/bc26/Kconfig
```kconfig
menu "BC26 Config" 

    config BC26_AUTO_CREATE
        bool "Enable BC26 Module Object Auto Create"
        select MOLINK_USING_AUTO_CREATE
        default n

    if BC26_AUTO_CREATE

#        config BC26_USING_AUTO_PROBE
#            bool "Enable BC26 Auto probe."
#            select MOLINK_USING_AUTO_PROBE_OPS
#            default n
#
#            if BC26_USING_AUTO_PROBE
#                config BC26_AUTOPROBE_IDENTIFIER
#                    string "autoprobe identifier."
#                    default "BC26"
#            endif

        config BC26_DEVICE_NAME
            string "BC26 Interface Device Name"
            default "uart2"

        config BC26_DEVICE_RATE
            int "BC26 Interface Device Rate"
            default 115200

        config BC26_RECV_BUFF_LEN
            int "The maximum length of AT command data accepted"
            default 1024

    endif

    config BC26_USING_GENERAL_OPS
        bool "Enable BC26 Module General Operates"
        select MOLINK_USING_GENERAL_OPS
        default y
    
    config BC26_USING_NETSERV_OPS
        bool "Enable BC26 Module Network Service Operates"
        select MOLINK_USING_NETSERV_OPS
        default y

    config BC26_USING_PING_OPS
        bool "Enable BC26 Module Ping Operates"
        select MOLINK_USING_NETSERV_OPS
        select MOLINK_USING_PING_OPS
        default y

    config BC26_USING_IFCONFIG_OPS
        bool "Enable BC26 Module Ifconfig Operates"
        select MOLINK_USING_IFCONFIG_OPS
        select BC26_USING_GENERAL_OPS
        select BC26_USING_NETSERV_OPS
        default y

    config BC26_USING_NETCONN_OPS
        bool "Enable BC26 Module Network TCP/IP Operates"
        select MOLINK_USING_NETCONN_OPS
        select BC26_USING_NETSERV_OPS
        default y

    config BC26_USING_SOCKETS_OPS
        bool "Enable BC26 Module BSD Socket Operates"
        select BC26_USING_NETCONN_OPS
        select MOLINK_USING_SOCKETS_OPS
        default n

endmenu
```

## components/net/molink/module/bc28/Kconfig
```kconfig
menu "BC28 Config" 

    config BC28_AUTO_CREATE
        bool "Enable BC28 Module Object Auto Create"
        select MOLINK_USING_AUTO_CREATE
        default n

    if BC28_AUTO_CREATE

        config BC28_DEVICE_NAME
            string "BC28 Interface Device Name"
            default "uart2"

        config BC28_DEVICE_RATE
            int "BC28 Interface Device Rate"
            default 9600

        config BC28_RECV_BUFF_LEN
            int "The maximum length of AT command data accepted"
            default 1500

    endif

    config BC28_USING_GENERAL_OPS
        bool "Enable BC28 Module General Operates"
        select MOLINK_USING_GENERAL_OPS
        default y
    
    config BC28_USING_NETSERV_OPS
        bool "Enable BC28 Module Network Service Operates"
        select MOLINK_USING_NETSERV_OPS
        default y

    config BC28_USING_PING_OPS
        bool "Enable BC28 Module Ping Operates"
        select BC28_USING_NETSERV_OPS
        select BC28_USING_NETCONN_OPS
        select MOLINK_USING_PING_OPS
        default y

    config BC28_USING_IFCONFIG_OPS
        bool "Enable BC28 Module Ifconfig Operates"
        select MOLINK_USING_IFCONFIG_OPS
        select BC28_USING_GENERAL_OPS
        select BC28_USING_NETSERV_OPS
        default y

    config BC28_USING_NETCONN_OPS
        bool "Enable BC28 Module Network TCP/IP Operates"
        select BC28_USING_NETSERV_OPS
        select MOLINK_USING_NETCONN_OPS
        default y

    config BC28_USING_SOCKETS_OPS
        bool "Enable BC28 Module BSD Socket Operates"
        select BC28_USING_NETCONN_OPS
        select MOLINK_USING_SOCKETS_OPS
        default n

#    config BC28_USING_ONENET_NB_OPS
#        bool "Enable BC28 Module Onenet Nb Operates"
#        select MOLINK_USING_ONENET_NB_OPS
#        default y
#
#    if BC28_USING_ONENET_NB_OPS
#
#        config BC28_RESP_BUFF_SIZE
#            int "The OneNET AT Parser stack size"
#            default 128
#
#        config BC28_URC_MANAGER_TASK_PRIORITY
#            hex "The URC manager task priority"
#            default 0x10
#
#        config BC28_URC_MANAGER_STACK_SIZE
#            int "The URC manager task stack size"
#            default 2048
#
#    endif

endmenu
```

## components/net/molink/module/bc95/Kconfig
```kconfig
menu "BC95 Config" 

    config BC95_AUTO_CREATE
        bool "Enable BC95 Module Object Auto Create"
        select MOLINK_USING_AUTO_CREATE
        default n

    if BC95_AUTO_CREATE

        config BC95_DEVICE_NAME
            string "BC95 Interface Device Name"
            default "uart2"

        config BC95_DEVICE_RATE
            int "BC95 Interface Device Rate"
            default 9600

        config BC95_RECV_BUFF_LEN
            int "The maximum length of AT command data accepted"
            default 1500

    endif

    config BC95_USING_GENERAL_OPS
        bool "Enable BC95 Module General Operates"
        select MOLINK_USING_GENERAL_OPS
        default y
    
    config BC95_USING_NETSERV_OPS
        bool "Enable BC95 Module Network Service Operates"
        select MOLINK_USING_NETSERV_OPS
        default y

    config BC95_USING_PING_OPS
        bool "Enable BC95 Module Ping Operates"
        select BC95_USING_NETSERV_OPS
        select BC95_USING_NETCONN_OPS
        select MOLINK_USING_PING_OPS
        default y

    config BC95_USING_IFCONFIG_OPS
        bool "Enable BC95 Module Ifconfig Operates"
        select MOLINK_USING_IFCONFIG_OPS
        select BC95_USING_GENERAL_OPS
        select BC95_USING_NETSERV_OPS
        default y

    config BC95_USING_NETCONN_OPS
        bool "Enable BC95 Module Network TCP/IP Operates"
        select BC95_USING_NETSERV_OPS
        select MOLINK_USING_NETCONN_OPS
        default y

    config BC95_USING_SOCKETS_OPS
        bool "Enable BC95 Module BSD Socket Operates"
        select BC95_USING_NETCONN_OPS
        select MOLINK_USING_SOCKETS_OPS
        default n

#    config BC95_USING_ONENET_NB_OPS
#        bool "Enable BC95 Module Onenet Nb Operates"
#        select MOLINK_USING_ONENET_NB_OPS
#        default y
#
#    if BC95_USING_ONENET_NB_OPS
#
#        config BC95_RESP_BUFF_SIZE
#            int "The OneNET AT Parser stack size"
#            default 128
#
#        config BC95_URC_MANAGER_TASK_PRIORITY
#            hex "The URC manager task priority"
#            default 0x10
#
#        config BC95_URC_MANAGER_STACK_SIZE
#            int "The URC manager task stack size"
#            default 2048
#
#    endif

endmenu
```

## components/net/molink/module/clm920rv3/Kconfig
```kconfig
menu "CLM920RV3 Config" 

    config CLM920RV3_AUTO_CREATE
        bool "Enable CLM920RV3 Module Object Auto Create"
        default n

    if CLM920RV3_AUTO_CREATE

        config CLM920RV3_DEVICE_NAME
            string "CLM920RV3 Interface Device Name"
            default "uart2"

        config CLM920RV3_DEVICE_RATE
            int "CLM920RV3 Interface Device Rate"
            default 115200

        config CLM920RV3_RECV_BUFF_LEN
            int "The maximum length of AT command data accepted"
            default 1500

    endif

    config CLM920RV3_USING_GENERAL_OPS
        bool "Enable CLM920RV3 Module General Operates"
        select MOLINK_USING_GENERAL_OPS
        default y
    
    config CLM920RV3_USING_NETSERV_OPS
        bool "Enable CLM920RV3 Module Network Service Operates"
        select MOLINK_USING_NETSERV_OPS
        default y

    config CLM920RV3_USING_PING_OPS
        bool "Enable CLM920RV3 Module test Ping function(Only for test use)"
        select MOLINK_USING_PING_OPS
        default n

    config CLM920RV3_USING_IFCONFIG_OPS
        bool "Enable CLM920RV3 Module Ifconfig Operates"
        select MOLINK_USING_IFCONFIG_OPS
        select CLM920RV3_USING_GENERAL_OPS
        select CLM920RV3_USING_NETSERV_OPS
        select CLM920RV3_USING_NETCONN_OPS
        default y

    config CLM920RV3_USING_NETCONN_OPS
        bool "Enable CLM920RV3 Module Network TCP/IP Operates"
        select OS_USING_EVENT
        select MOLINK_USING_NETCONN_OPS
        default y

    config CLM920RV3_USING_SOCKETS_OPS
        bool "Enable CLM920RV3 Module BSD Socket Operates"
        select CLM920RV3_USING_NETCONN_OPS
        select MOLINK_USING_SOCKETS_OPS
        default n

endmenu
```

## components/net/molink/module/e7025/Kconfig
```kconfig
menu "E7025 Config" 

    config E7025_AUTO_CREATE
        bool "Enable E7025 Module Object Auto Create"
        default n

    if E7025_AUTO_CREATE

        config E7025_DEVICE_NAME
            string "E7025 Interface Device Name"
            default "uart2"

        config E7025_DEVICE_RATE
            int "E7025 Interface Device Rate"
            default 9600

        config E7025_RECV_BUFF_LEN
            int "The maximum length of AT command data accepted"
            default 3072

    endif

    config E7025_USING_GENERAL_OPS
        bool "Enable E7025 Module General Operates"
        select MOLINK_USING_GENERAL_OPS
        default y
    
    config E7025_USING_NETSERV_OPS
        bool "Enable E7025 Module Network Service Operates"
        select MOLINK_USING_NETSERV_OPS
        default y

    config E7025_USING_PING_OPS
        bool "Enable E7025 Module Ping Operates"
        select MOLINK_USING_PING_OPS
        default y

    config E7025_USING_IFCONFIG_OPS
        bool "Enable E7025 Module Ifconfig Operates"
        select MOLINK_USING_IFCONFIG_OPS
        select E7025_USING_GENERAL_OPS
        select E7025_USING_NETSERV_OPS
        default y
    config E7025_USING_NETCONN_OPS
        bool "Enable E7025 Module Network TCP/IP Operates"
        select MOLINK_USING_NETCONN_OPS
        default y

    config E7025_USING_SOCKETS_OPS
        bool "Enable E7025 Module BSD Socket Operates"
        select E7025_USING_NETCONN_OPS
        select MOLINK_USING_SOCKETS_OPS
        default n

endmenu
```

## components/net/molink/module/ec20/Kconfig
```kconfig
menu "EC20 Config" 

    config EC20_AUTO_CREATE
        bool "Enable EC20 Module Object Auto Create"
        default n

    if EC20_AUTO_CREATE

        config EC20_DEVICE_NAME
            string "EC20 Interface Device Name"
            default "uart2"

        config EC20_DEVICE_RATE
            int "EC20 Interface Device Rate"
            default 115200

        config EC20_RECV_BUFF_LEN
            int "The maximum length of AT command data accepted"
            default 512

    endif

    config EC20_USING_GENERAL_OPS
        bool "Enable EC20 Module General Operates"
        select MOLINK_USING_GENERAL_OPS
        default y
    
    config EC20_USING_NETSERV_OPS
        bool "Enable EC20 Module Network Service Operates"
        select MOLINK_USING_NETSERV_OPS
        default y

    config EC20_USING_PING_OPS
        bool "Enable EC20 Module Ping Operates"
        select MOLINK_USING_PING_OPS
        default y

    config EC20_USING_IFCONFIG_OPS
        bool "Enable EC20 Module Ifconfig Operates"
        select MOLINK_USING_IFCONFIG_OPS
        select EC20_USING_GENERAL_OPS
        select EC20_USING_NETSERV_OPS
        select EC20_USING_NETCONN_OPS
        default y

    config EC20_USING_NETCONN_OPS
        bool "Enable EC20 Module Network TCP/IP Operates"
        select OS_USING_EVENT
        select MOLINK_USING_NETCONN_OPS
        default y

    config EC20_USING_SOCKETS_OPS
        bool "Enable EC20 Module BSD Socket Operates"
        select EC20_USING_NETCONN_OPS
        select MOLINK_USING_SOCKETS_OPS
        default n

#   config EC20_USING_PPP_OPS
#        bool "Enable EC20 PPPoS Operates"
#       select MOLINK_USING_PPP_OPS
#       select MOLINK_USING_GENERAL_OPS
#       select MOLINK_USING_NETSERV_OPS
#       select NET_USING_LWIP
#       select LWIP_USING_PPP
#       select LWIP_USING_PPPOS
#       default n

endmenu
```

## components/net/molink/module/ec200x_600s/Kconfig
```kconfig
menu "EC200X_600S Config"

    config EC200X_600S_AUTO_CREATE
        bool "Enable EC200X_600S Module Object Auto Create"
        default n

    if EC200X_600S_AUTO_CREATE

        config EC200X_600S_DEVICE_NAME
            string "EC200X_600S Interface Device Name"
            default "uart2"

        config EC200X_600S_DEVICE_RATE
            int "EC200X_600S Interface Device Rate"
            default 115200

        config EC200X_600S_RECV_BUFF_LEN
            int "The maximum length of AT command data accepted"
            default 512

    endif

    config EC200X_600S_USING_GENERAL_OPS
        bool "Enable EC200X_600S Module General Operates"
        select MOLINK_USING_GENERAL_OPS
        default y

    config EC200X_600S_USING_NETSERV_OPS
        bool "Enable EC200X_600S Module Network Service Operates"
        select MOLINK_USING_NETSERV_OPS
        default y

    config EC200X_600S_USING_PING_OPS
        bool "Enable EC200X_600S Module Ping Operates"
        select MOLINK_USING_NETSERV_OPS
        select MOLINK_USING_PING_OPS
        default y

    config EC200X_600S_USING_IFCONFIG_OPS
        bool "Enable EC200X_600S Module Ifconfig Operates"
        select MOLINK_USING_IFCONFIG_OPS
        select EC200X_600S_USING_GENERAL_OPS
        select EC200X_600S_USING_NETSERV_OPS
        default y

    config EC200X_600S_USING_NETCONN_OPS
        bool "Enable EC200X_600S Module Network TCP/IP Operates"
        select OS_USING_EVENT
        select MOLINK_USING_NETCONN_OPS
        default y

    config EC200X_600S_USING_SOCKETS_OPS
        bool "Enable EC200X_600S Module BSD Socket Operates"
        select EC200X_600S_USING_NETCONN_OPS
        select MOLINK_USING_SOCKETS_OPS
        default n

endmenu
```
