## components/net/molink/module/me3630_w/Kconfig
```kconfig
menu "ME3630_W Config" 

    config ME3630_W_AUTO_CREATE
        bool "Enable ME3630_W Module Object Auto Create"
        default n

    if ME3630_W_AUTO_CREATE

        config ME3630_W_DEVICE_NAME
            string "ME3630_W Interface Device Name"
            default "uart2"

        config ME3630_W_DEVICE_RATE
            int "ME3630_W Interface Device Rate"
            default 115200

        config ME3630_W_RECV_BUFF_LEN
            int "The maximum length of AT command data accepted"
            default 512

    endif

    config ME3630_W_USING_GENERAL_OPS
        bool "Enable ME3630_W Module General Operates"
        select MOLINK_USING_GENERAL_OPS
        default y
    
    config ME3630_W_USING_NETSERV_OPS
        bool "Enable ME3630_W Module Network Service Operates"
        select MOLINK_USING_NETSERV_OPS
        default y

    config ME3630_W_USING_IFCONFIG_OPS
        bool "Enable ME3630_W Module Ifconfig Operates"
        select MOLINK_USING_IFCONFIG_OPS
        select ME3630_W_USING_GENERAL_OPS
        select ME3630_W_USING_NETSERV_OPS
        default y

    config ME3630_W_USING_NETCONN_OPS
        bool "Enable ME3630_W Module Network TCP/IP Operates"
        select MOLINK_USING_NETCONN_OPS
        default y

    config ME3630_W_USING_SOCKETS_OPS
        bool "Enable ME3630_W Module BSD Socket Operates"
        select ME3630_W_USING_NETCONN_OPS
        select MOLINK_USING_SOCKETS_OPS
        default n

endmenu
```

## components/net/molink/module/ml302/Kconfig
```kconfig
menu "ML302 Config" 

    config ML302_AUTO_CREATE
        bool "Enable ML302 Module Object Auto Create"
        default n

    if ML302_AUTO_CREATE

        config ML302_DEVICE_NAME
            string "ML302 Interface Device Name"
            default "uart2"

        config ML302_DEVICE_RATE
            int "ML302 Interface Device Rate"
            default 115200

        config ML302_RECV_BUFF_LEN
            int "The maximum length of AT command data accepted"
            default 512

    endif

    config ML302_USING_GENERAL_OPS
        bool "Enable ML302 Module General Operates"
        select MOLINK_USING_GENERAL_OPS
        default y
    
    config ML302_USING_NETSERV_OPS
        bool "Enable ML302 Module Network Service Operates"
        select MOLINK_USING_NETSERV_OPS
        default y

    config ML302_USING_PING_OPS
        bool "Enable ML302 Module Ping Operates"
        select MOLINK_USING_PING_OPS
        default y

    config ML302_USING_IFCONFIG_OPS
        bool "Enable ML302 Module Ifconfig Operates"
        select MOLINK_USING_IFCONFIG_OPS
        select ML302_USING_GENERAL_OPS
        select ML302_USING_NETSERV_OPS
        default y

    config ML302_USING_NETCONN_OPS
        bool "Enable ML302 Module Network TCP/IP Operates"
        select MOLINK_USING_NETCONN_OPS
        default y

    config ML302_USING_SOCKETS_OPS
        bool "Enable ML302 Module BSD Socket Operates"
        select ML302_USING_NETCONN_OPS
        select MOLINK_USING_SOCKETS_OPS
        default n

#    config ML302_USING_MQTTC_OPS
#        bool "Enable ML302 Module MQTT Client Operates"
#        select MOLINK_USING_MQTTC_OPS
#        default n
#
#    if ML302_USING_MQTTC_OPS
#
#        config ML302_USING_MQTTC_TASK
#        bool "Enable ML302 Module MQTT Client Task"
#        select MOLINK_USING_MQTTC_TASK
#        default n
#    endif

endmenu
```

## components/net/molink/module/n21/Kconfig
```kconfig
menu "N21 Config" 

    config N21_AUTO_CREATE
        bool "Enable N21 Module Object Auto Create"
        default n

    if N21_AUTO_CREATE

        config N21_DEVICE_NAME
            string "N21 Interface Device Name"
            default "uart2"

        config N21_DEVICE_RATE
            int "N21 Interface Device Rate"
            default 57600
            range 0 57600

        config N21_RECV_BUFF_LEN
            int "The maximum length of AT command data accepted"
            default 512

    endif

    config N21_USING_GENERAL_OPS
        bool "Enable N21 Module General Operates"
        select MOLINK_USING_GENERAL_OPS
        default y
    
    config N21_USING_NETSERV_OPS
        bool "Enable N21 Module Network Service Operates"
        select MOLINK_USING_NETSERV_OPS
        default y

    config N21_USING_PING_OPS
        bool "Enable N21 Module Ping Operates"
        select MOLINK_USING_PING_OPS
        default y

    config N21_USING_IFCONFIG_OPS
        bool "Enable N21 Module Ifconfig Operates"
        select MOLINK_USING_IFCONFIG_OPS
        select N21_USING_GENERAL_OPS
        select N21_USING_NETSERV_OPS
        default y

    config N21_USING_NETCONN_OPS
        bool "Enable N21 Module Network TCP/IP Operates"
        select MOLINK_USING_NETCONN_OPS
        default y

    config N21_USING_SOCKETS_OPS
        bool "Enable N21 Module BSD Socket Operates"
        select N21_USING_NETCONN_OPS
        select MOLINK_USING_SOCKETS_OPS
        default n

endmenu
```

## components/net/molink/module/n58/Kconfig
```kconfig
menu "N58 Config" 

    config N58_AUTO_CREATE
        bool "Enable N58 Module Object Auto Create"
        default n

    if N58_AUTO_CREATE

        config N58_DEVICE_NAME
            string "N58 Interface Device Name"
            default "uart2"

        config N58_DEVICE_RATE
            int "N58 Interface Device Rate"
            default 115200

        config N58_RECV_BUFF_LEN
            int "The maximum length of AT command data accepted"
            default 512

    endif

    config N58_USING_GENERAL_OPS
        bool "Enable N58 Module General Operates"
        select MOLINK_USING_GENERAL_OPS
        default y
    
    config N58_USING_NETSERV_OPS
        bool "Enable N58 Module Network Service Operates"
        select MOLINK_USING_NETSERV_OPS
        default y

    config N58_USING_PING_OPS
        bool "Enable N58 Module Ping Operates"
        select MOLINK_USING_PING_OPS
        default y

    config N58_USING_IFCONFIG_OPS
        bool "Enable N58 Module Ifconfig Operates"
        select MOLINK_USING_IFCONFIG_OPS
        select N58_USING_GENERAL_OPS
        select N58_USING_NETSERV_OPS
        default y

    config N58_USING_NETCONN_OPS
        bool "Enable N58 Module Network TCP/IP Operates"
        select MOLINK_USING_NETCONN_OPS
        default y

    config N58_USING_SOCKETS_OPS
        bool "Enable N58 Module BSD Socket Operates"
        select N58_USING_NETCONN_OPS
        select MOLINK_USING_SOCKETS_OPS
        default n

endmenu
```

## components/net/molink/module/rg500q/Kconfig
```kconfig
menu "RG500Q Config"

    config RG500Q_AUTO_CREATE
        bool "Enable RG500Q Module Object Auto Create"
        default n

    if RG500Q_AUTO_CREATE

        config RG500Q_DEVICE_NAME
            string "RG500Q Interface Device Name"
            default "usbh_cdc_hs"

        config RG500Q_RECV_BUFF_LEN
            int "The maximum length of AT command data accepted"
            default 512

    endif

    config RG500Q_USING_GENERAL_OPS
        bool
        select MOLINK_USING_GENERAL_OPS
        default y
    
    config RG500Q_USING_NETSERV_OPS
        bool
        select MOLINK_USING_NETSERV_OPS
        default y

    config RG500Q_USING_PPP_OPS
        bool
        select MOLINK_USING_PPP_OPS
        select MOLINK_USING_PARSER
        select NET_USING_LWIP
        select LWIP_USING_PPP
        select LWIP_USING_PPPOS
        select OS_USING_SYS_HEAP
        select OS_USING_MAILBOX
        default y

    config RG500Q_APN_NAME
        string "Access point name."
        default "APN"

endmenu
```

## components/net/molink/module/sim7020/Kconfig
```kconfig
menu "SIM7020 Config"

    config SIM7020_AUTO_CREATE
        bool "Enable SIM7020 Module Object Auto Create"
        default n

    if SIM7020_AUTO_CREATE

        config SIM7020_DEVICE_NAME
            string "SIM7020 Interface Device Name"
            default "uart2"

        config SIM7020_DEVICE_RATE
            int "SIM7020 Interface Device Rate"
            default 115200

        config SIM7020_RECV_BUFF_LEN
            int "The maximum length of AT command data accepted"
            default 2048

    endif

    config SIM7020_USING_GENERAL_OPS
        bool "Enable SIM7020 Module General Operates"
        select MOLINK_USING_GENERAL_OPS
        default y

    config SIM7020_USING_NETSERV_OPS
        bool "Enable SIM7020 Module Network Service Operates"
        select MOLINK_USING_NETSERV_OPS
        default y

    config SIM7020_USING_PING_OPS
        bool "Enable SIM7020 Module Ping Operates"
        select MOLINK_USING_PING_OPS
        default y

    config SIM7020_USING_IFCONFIG_OPS
        bool "Enable SIM7020 Module Ifconfig Operates"
        select MOLINK_USING_IFCONFIG_OPS
        select SIM7020_USING_GENERAL_OPS
        select SIM7020_USING_NETSERV_OPS
        default y
    config SIM7020_USING_NETCONN_OPS
        bool "Enable SIM7020 Module Network TCP/IP Operates"
        select MOLINK_USING_NETCONN_OPS
        default y

    config SIM7020_USING_SOCKETS_OPS
        bool "Enable SIM7020 Module BSD Socket Operates"
        select SIM7020_USING_NETCONN_OPS
        select MOLINK_USING_SOCKETS_OPS
        default n

endmenu
```

## components/net/molink/module/sim7070x/Kconfig
```kconfig
menu "SIM7070X Config"

    config SIM7070X_AUTO_CREATE
        bool "Enable SIM7070X Module Object Auto Create"
        default n

    if SIM7070X_AUTO_CREATE

        config SIM7070X_DEVICE_NAME
            string "SIM7070X Interface Device Name"
            default "uart2"

        config SIM7070X_DEVICE_RATE
            int "SIM7070X Interface Device Rate"
            default 115200

        config SIM7070X_RECV_BUFF_LEN
            int "The maximum length of AT command data accepted"
            default 1564

    endif

    config SIM7070X_USING_GENERAL_OPS
        bool "Enable SIM7070X Module General Operates"
        select MOLINK_USING_GENERAL_OPS
        default y

    config SIM7070X_USING_NETSERV_OPS
        bool "Enable SIM7070X Module Network Service Operates"
        select MOLINK_USING_NETSERV_OPS
        default y

    config SIM7070X_USING_PING_OPS
        bool "Enable SIM7070X Module Ping Operates"
        select MOLINK_USING_PING_OPS
        default y

    config SIM7070X_USING_IFCONFIG_OPS
        bool "Enable SIM7070X Module Ifconfig Operates"
        select MOLINK_USING_IFCONFIG_OPS
        select SIM7070X_USING_GENERAL_OPS
        select SIM7070X_USING_NETSERV_OPS
        default y
    config SIM7070X_USING_NETCONN_OPS
        bool "Enable SIM7070X Module Network TCP/IP Operates"
        select MOLINK_USING_NETCONN_OPS
        default y

    config SIM7070X_USING_SOCKETS_OPS
        bool "Enable SIM7070X Module BSD Socket Operates"
        select SIM7070X_USING_NETCONN_OPS
        select MOLINK_USING_SOCKETS_OPS
        default n

endmenu
```

## components/net/molink/module/sim7600ce/Kconfig
```kconfig
menu "SIM7600CE Config"

    config SIM7600CE_AUTO_CREATE
        bool "Enable SIM7600CE Module Object Auto Create"
        default n

    if SIM7600CE_AUTO_CREATE

        config SIM7600CE_DEVICE_NAME
            string "SIM7600CE Interface Device Name"
            default "uart2"

        config SIM7600CE_DEVICE_RATE
            int "SIM7600CE Interface Device Rate"
            default 115200

        config SIM7600CE_RECV_BUFF_LEN
            int "The maximum length of AT command data accepted"
            default 1500

    endif

    config SIM7600CE_USING_GENERAL_OPS
        bool "Enable SIM7600CE Module General Operates"
        select MOLINK_USING_GENERAL_OPS
        default y

    config SIM7600CE_USING_NETSERV_OPS
        bool "Enable SIM7600CE Module Network Service Operates"
        select MOLINK_USING_NETSERV_OPS
        default y

    config SIM7600CE_USING_PING_OPS
        bool "Enable SIM7600CE Module Ping Operates"
        select MOLINK_USING_PING_OPS
        default y

    config SIM7600CE_USING_IFCONFIG_OPS
        bool "Enable SIM7600CE Module Ifconfig Operates"
        select MOLINK_USING_IFCONFIG_OPS
        select SIM7600CE_USING_GENERAL_OPS
        select SIM7600CE_USING_NETSERV_OPS
        default y
    config SIM7600CE_USING_NETCONN_OPS
        bool "Enable SIM7600CE Module Network TCP/IP Operates"
        select MOLINK_USING_NETCONN_OPS
        default y

    config SIM7600CE_USING_SOCKETS_OPS
        bool "Enable SIM7600CE Module BSD Socket Operates"
        select SIM7600CE_USING_NETCONN_OPS
        select MOLINK_USING_SOCKETS_OPS
        default n

endmenu
```

## components/net/molink/parser/Kconfig
```kconfig
menu "Parser"

config MOLINK_USING_PARSER
    bool "Enable AT Parser"
    select OS_USING_MESSAGEQUEUE
    select OS_USING_SEMAPHORE
    select OS_USING_EVENT
    select OS_USING_MUTEX
    default n

if MOLINK_USING_PARSER
        config AT_PARSER_TASK_STACK_SIZE
            int "The AT Parser task stack size"
            default 2048

        config AT_PARSER_PRINT_RAW
            bool "Enable print RAW format AT command communication data"
            default n
            select DLOG_USING_ISR_LOG if OS_USING_DLOG 
endif

endmenu
```

## components/net/molink/test/Kconfig
```kconfig
menu "Test"

config MOLINK_USING_TESTCASE
    bool "Enable Molink Test Case"
    select OS_USING_ATEST
    default n

if MOLINK_USING_TESTCASE

    config MOLINK_USING_GENERAL_TC
        bool "Enable Molink General API Test Case"
        depends on MOLINK_USING_GENERAL_OPS
        default n
    
    if MOLINK_USING_GENERAL_TC
    
        config MOLINK_USING_AT_BASIC_TC
            bool "Enable Molink AT BASIC Test FUNC"
            depends on MOLINK_USING_PARSER
            default n
    
    endif

    config MOLINK_USING_NETSERV_TC
        bool "Enable Molink Nerserv API Test Case"
        depends on MOLINK_USING_NETSERV_OPS
        default n

    config MOLINK_USING_NETCONN_TC
        bool "Enable Molink Netconn API Test Case"
        depends on MOLINK_USING_NETCONN_OPS
        default n

    config MOLINK_USING_SOCKET_TC
        bool "Enable Molink Socket API Test Case"
        depends on MOLINK_USING_SOCKETS_OPS
        default n

    config MOLINK_USING_MQTTC_TC
        bool "Enable Molink MQTT Client API Test Case"
        depends on MOLINK_USING_MQTTC_OPS
        default n

    config MOLINK_USING_WIFI_TC
        bool "Enable Molink Wifi API Test Case"
        depends on MOLINK_USING_WIFI_OPS
        default n

    if MOLINK_USING_WIFI_TC

        config WIFI_TC_CONNECT_SSID
            string "Test Connect AP SSID"
            default "ssid"

        config WIFI_TC_CONNECT_PASSWORD
            string "Test Connect AP Password"
            default "password"

    endif

endif

endmenu
```

## components/net/molink/tools/Kconfig
```kconfig
menu "Tools"

config MOLINK_USING_TOOLS
    bool "Enable AT module network debug functions"
    default n
    select NET_USING_IP
    select OS_USING_SHELL

    if MOLINK_USING_TOOLS

        config MOLINK_TOOLS_USING_IFCONFIG
            bool "Enable molink ifconfig features"
            depends on MOLINK_USING_IFCONFIG_OPS
            default y

        config MOLINK_TOOLS_USING_PING
            depends on MOLINK_USING_PING_OPS && MOLINK_USING_IFCONFIG_OPS
            bool "Enable molink ping features"
            default y

        if MOLINK_TOOLS_USING_PING
            config MO_PING_MAX_TIMES_CONFIG
            int "The maximum times of molink ping cmd config"
            default 50
        endif 

        config MOLINK_TOOLS_USING_SOCKETSTAT
            depends on MOLINK_USING_NETCONN_OPS
            bool "Enable molink socket stat features"
            default y

        config MOLINK_TOOLS_USING_IPERF
            depends on MOLINK_USING_SOCKETS_OPS
            bool "Enable molink iperf feature"
            default n

    endif

endmenu
```

## components/net/protocols/Kconfig
```kconfig
menu "Protocols"
    source "$OS_ROOT/components/net/protocols/*/Kconfig"
endmenu
```
