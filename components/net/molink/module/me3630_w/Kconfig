## components/net/protocols/coap/Kconfig
```kconfig
menu "CoAP"
    source "$OS_ROOT/components/net/protocols/coap/*/Kconfig"
endmenu
```

## components/net/protocols/coap/libcoap-v4.2.1/Kconfig
```kconfig
menu "libcoap-v4.2.1"

config NET_USING_COAP
    bool "Enable libCoAP: A C implementation of the CoAP(RFC 7252)"
    select NET_USING_BSD
    select OS_USING_RTC
	select OS_USING_VFS
    default n

	help
		A C implementation of the CoAP(RFC 7252)

if NET_USING_COAP
	config NET_USING_COAP_EXAMPLE
	bool "Enable libCoAP example"
	default y

endif

endmenu 
```

## components/net/protocols/http/Kconfig
```kconfig
menu "HTTP"
    source "$OS_ROOT/components/net/protocols/http/*/Kconfig"
endmenu
```

## components/net/protocols/http/httpclient-v1.1.0/Kconfig
```kconfig
menu "httpclient-v1.1.0"

config NET_USING_HTTPCLIENT
	bool "Enable Httpclient"
	select NET_USING_BSD
	default n
    
    if NET_USING_HTTPCLIENT
		
		config CONFIG_HTTP_SECURE
            bool "Enable Httpclient TLS encrypt"
			select SECURITY_USING_MBEDTLS
            default n

		config HTTPCLIENT_USING_SAMPLE
            bool "Enable HTTPCLIENT sample"
            default n

		config HTTPCLIENT_USING_GETFILE
		    bool "Enable HTTPClient GetFile"
			select OS_USING_VFS
			select OS_USING_VFS_FATFS
            default n

			if HTTPCLIENT_USING_GETFILE
				config HTTP_REQUEST_BLOCK_SIZE
				int "request block size"
				default 1024
				help 
					You'd better set the OS_SERIAL_RX_BUFSZ with the same size when you use the molink.
			endif

		config CONFIG_HTTP_DOWNLOAD
            bool "Enable HTTPCLIENT DOWNLOAD"
            select OS_USING_VFS
            default n 

		config CONFIG_HTTP_RECV_TIMEOUT_MS
			int "HTTP SET RECV TIMEOUT MS"
			default 5000
    endif

endmenu
```

## components/net/protocols/lwm2m/Kconfig
```kconfig
menu "LWM2M"
    source "$OS_ROOT/components/net/protocols/lwm2m/*/Kconfig"
endmenu
```

## components/net/protocols/lwm2m/lwm2m-v1.0.0/Kconfig
```kconfig
menu "LWM2M-v1.0.0"

config NET_USING_LWM2M
	bool "Enable LWM2M"
	select NET_USING_BSD
	default n
    
    if NET_USING_LWM2M
		
		config CONFIG_LWM2M_SECURE
            bool "Enable LWM2M DTLS encrypt"
			select SECURITY_USING_MBEDTLS
            default n
			
		config LWM2M_USING_SAMPLE
            bool "Enable LWM2M sample"
            default n
			
			if LWM2M_USING_SAMPLE
			config LWM2M_SERVER_ADDR_STR
			       string "LWM2M Server Addr String"
				   default "192.168.1.102"
			config LWM2M_SERVER_PORT_STR
				   string "LWM2M Server Port String"
				   default "5684"
			endif
			
		config LWM2M_CLIENT_MODE
			bool "Enable LWM2M client mode"
			default	n
		
			choice 
				prompt "Select log level"		
				default LWM2M_LOG_DEBUG
				config LWM2M_LOG_ERROR
				bool "Error Log Level"
				config LWM2M_LOG_WARN
				bool "Warn Log Level"
				config LWM2M_LOG_INFO
				bool "Info Log Level"
				config LWM2M_LOG_DEBUG
				bool "Debug Log Level"
				config LWM2M_LOG_VERBOSE
				bool "Verbose Log Level"
				config LWM2M_LOG_NONE
				bool "None Log Level"
			endchoice
    endif
	
endmenu
```

## components/net/protocols/mqtt/Kconfig
```kconfig
menu "MQTT"
    source "$OS_ROOT/components/net/protocols/mqtt/*/Kconfig"
endmenu
```

## components/net/protocols/mqtt/pahomqtt-v1.1.0/Kconfig
```kconfig
menu "pahomqtt-v1.1.0"

config NET_USING_PAHO_MQTT
    bool "Enable Paho MQTT"
    select OS_USING_TIMER_SOFT
    default n

    if NET_USING_PAHO_MQTT

        config MQTT_USING_CLIENT
            bool "Enable Paho MQTT Client"
            select NET_USING_BSD
            default n

        if MQTT_USING_CLIENT
            config MQTT_USING_TLS
                bool "Enable Paho MQTT TLS encrypt"
                default n             

            config MQTT_USING_SAMPLE
                bool "Enable Paho MQTT sample"
                default n
		endif

        if MQTT_USING_TLS
            choice
                prompt "Security tls choice"
                default MQTT_USING_TLS_MBEDTLS
                config MQTT_USING_TLS_MBEDTLS
                    bool "MQTT security use MbedTLS"
                    select SECURITY_USING_MBEDTLS
                config MQTT_USING_TLS_ONETLS
                    bool "MQTT security use OneTLS"
                    select SECURITY_USING_ONETLS
            endchoice           
        endif

    endif

endmenu
```

## components/net/socket/Kconfig
```kconfig
menu "Socket"

config NET_USING_BSD
    bool "Enable BSD socket API"
    default n

    if NET_USING_BSD
        if NET_USING_LWIP || NET_USING_MOLINK
        
            choice
            prompt "protocol stack implement"
            default BSD_USING_MOLINK

            config BSD_USING_MOLINK
                bool "Support OneOS modules stack"
                depends on MOLINK_USING_SOCKETS_OPS
            config BSD_USING_LWIP
                bool "Support lwIP stack"
                depends on NET_USING_LWIP
            endchoice

        endif

    endif

endmenu
```

## components/ota/cmiot/Kconfig
```kconfig
menu "Fota by CMIOT"
    
    config FOTA_USING_CMIOT
        bool "Enable fota by cmiot"
        default n
        select NET_USING_BSD
        select OS_USING_FAL
        select OS_USING_LIBC_ADAPTER

    if FOTA_USING_CMIOT
        
        choice
        prompt "The supported network protocol"
        default CMIOT_NETWORKING_MODE_COAP
        help
            Select download protocol
        config CMIOT_NETWORKING_MODE_COAP
            bool "Coap"
            help
                Download differential packets using coap
        config CMIOT_NETWORKING_MODE_HTTP
            bool "Http"
            help
                Download differential packets using http
        endchoice

        config CMIOT_DEFAULT_NETWORK_PROTOCOL
            int
            default 1  if CMIOT_NETWORKING_MODE_COAP
            default 2 if CMIOT_NETWORKING_MODE_HTTP
        
        choice
        prompt "The supported algorithm"
        default CMIOT_ALGORITHM_LUSUN
        help
            Select the differential algorithm
        config CMIOT_ALGORITHM_LUSUN
            bool "Lusun"
            help
                Select lusun as the differential algorithm
        config CMIOT_ALGORITHM_WOSUN
            bool "Wosun low"
            help
                Select wosun low as the differential algorithm
        config CMIOT_ALGORITHM_WOSUN_HIGH
            bool "Wosun high"
            help
                Select wosun high as the difference algorithm
        config CMIOT_ALGORITHM_LUCKSPAR
            bool "LuckSpar"
            help
                Select LuckSpar as the difference algorithm
        endchoice

        config CMIOT_FOTA_ALGORITHM
            int
            default 0  if CMIOT_ALGORITHM_LUSUN
            default 1 if CMIOT_ALGORITHM_WOSUN
            default 2 if CMIOT_ALGORITHM_WOSUN_HIGH
	    default 3 if CMIOT_ALGORITHM_LUCKSPAR

        config CMIOT_DEFAULT_SECTOR_SIZE
            hex
            default 0x800  if SERIES_STM32F0
            default 0x800 if SERIES_STM32F1
            default 0x20000 if SERIES_STM32F2
            default 0x800 if SERIES_STM32F3
            default 0x20000 if SERIES_STM32F4
            default 0x40000 if SERIES_STM32F7
            default 0x20000 if SERIES_STM32H7
            default 0x100 if SERIES_STM32L1
            default 0x800 if SERIES_STM32L4
            default 0x800 if SERIES_STM32G0
            default 0x800 if SERIES_STM32L5

        if CMIOT_ALGORITHM_WOSUN || CMIOT_ALGORITHM_WOSUN_HIGH

            config CMIOT_FLASH_APP_ADDR
                hex "App part addr from fal's OS_APP_PART_ADDR"
                default 0x8010000

            config CMIOT_UPDATE_SIZE
                hex "Download part size from fal's OS_DL_PART_SIZE"
                default 0x30000

        endif

        config CMIOT_FOTA_WOSUN_VERSION
            string
            default "IOT4.0_R42641"
        
        config CMIOT_FOTA_LUSUN_VERSION
            string
            default "IOT5.0_LUSUN11_R50426"
			
        config CMIOT_FOTA_LUCKSPAR_VERSION
            string
            default "IOT6.0_LUCKSPAR_R010100"

        config CMIOT_SEGMENT_SIZE_INDEX_START
            int
            default 0 if CMIOT_NETWORKING_MODE_COAP
            default 3 if CMIOT_NETWORKING_MODE_HTTP

        config CMIOT_DEFAULT_SEGMENT_SIZE_INDEX
            int "Segment size index"
            range CMIOT_SEGMENT_SIZE_INDEX_START 5
            default 3
            help
                Set the size of each download,0 is 16 bytes,1 is 32 bytes,2 is 64 bytes,3 is 128 bytes,4 is 256 bytes,5 is 512 bytes
        
        config CMIOT_FOTA_SERVICE_OEM
            string "Oem"
            default "cmiot_cd"
            help
                Consistent with the OEM of project information in OTA platform
        
        config CMIOT_FOTA_SERVICE_MODEL
            string "Model"
            default "L475RE"
            help
                Consistent with the device model of project information in OTA platform
        
        config CMIOT_FOTA_SERVICE_PRODUCT_ID
            string "Product id"
            default "1571101950"
            help
                Consistent with the product id of project information in OTA platform
        
        config CMIOT_FOTA_SERVICE_PRODUCT_SEC
            string "Product secret"
            default "c36b6a45f78546e1a11390a90ee7f158"
            help
                Consistent with the product secret of project information in OTA platform
        
        config CMIOT_FOTA_SERVICE_DEVICE_TYPE
            string "Device type"
            default "box"
            help
                Consistent with the device type of project information in OTA platform
        
        config CMIOT_FOTA_SERVICE_PLATFORM
            string "Platform"
            default "stm32l4"
            help
                Consistent with the platform of project information in OTA platform
        
        config CMIOT_FIRMWARE_VERSION
            string "Firmware version"
            default "1.0"
        
        config CMIOT_FOTA_OS_VERSION
            string
            default "ONEOS_V1.0"
        
    endif

endmenu
```

## components/position/Kconfig
```kconfig
menu "Position"

	config OS_USING_ONEPOS
    bool "enable position support"
    select OS_USING_SYS_HEAP
    default n
	
	if OS_USING_ONEPOS
		source "$OS_ROOT/components/position/*/Kconfig"
	endif
endmenu
```

## components/position/ble_pos/Kconfig
```kconfig
menu "bluetooth positon"
	
	config ONEPOS_USING_BLE_POS
	bool "enable bluetooth positon"
	select OS_USING_BLE
	default n
	
	if ONEPOS_USING_BLE_POS

		config ONEPOS_BLE_POSITION_INTERVAL
		int "onepos bletooth position time interval(unit : ms)"
		range 500 2000
		default 1000
		
	endif
endmenu
```
