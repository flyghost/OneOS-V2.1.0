## components/position/gnss_pos/Kconfig
```kconfig
menu "gnss positon"
	
	config ONEPOS_USING_GNSS_POS
	bool "enable gnss positon"
	default n
	
	if ONEPOS_USING_GNSS_POS
		source "$OS_ROOT/components/position/gnss_pos/*/Kconfig"
	endif
	
endmenu
```

## components/position/gnss_pos/prot/Kconfig
```kconfig
menu "gnss protocol"

config GNSS_USING_PROT
    bool "enable gnss protocol"
    default n

if GNSS_USING_PROT
	
	config GNSS_NMEA_0183_PROT
    bool "enable nmea 0183 protocol"
    default n
	
	if GNSS_NMEA_0183_PROT
		source "$OS_ROOT/components/position/gnss_pos/prot/nmea/Kconfig"
	endif
	
endif

endmenu 
```

## components/position/gnss_pos/prot/nmea/Kconfig
```kconfig
menu "gnss nmea 0183 protocol"
	
	config GNSS_NMEA_PROT_DEBUG
	bool "enable gnss nmea 0183 protocol debug"
	default n

endmenu
```

## components/position/gnss_pos/prot/rtcm/Kconfig
```kconfig
menu "gnss rtcm protocol"
	
	config GNSS_RTCM_PROT_DEBUG
	bool "enable gnss rtcm protocol debug"
	default n

endmenu
```

## components/position/gnss_pos/rcvr/Kconfig
```kconfig
menu "gnss receiver"
	
	config GNSS_USING_RCVR
	bool "onepos supp gnss receiver"
	default n
	
	if GNSS_USING_RCVR
		source "$OS_ROOT/components/position/gnss_pos/rcvr/interface/Kconfig"
		
		menu "support gnss rcvr list"

			config GNSS_USING_ICOFCHINA
				bool "icofchina"
				default n

				if GNSS_USING_ICOFCHINA
					source "$OS_ROOT/components/position/gnss_pos/rcvr/icofchina/Kconfig"
				endif

			config GNSS_USING_UNICORECOMM
				bool "unicorecomm"
				default n

				if GNSS_USING_UNICORECOMM
					source "$OS_ROOT/components/position/gnss_pos/rcvr/unicorecomm/Kconfig"
				endif

			config GNSS_USING_TECHTOTOP
				bool "techtotop"
				default n

				if GNSS_USING_TECHTOTOP
					source "$OS_ROOT/components/position/gnss_pos/rcvr/techtotop/Kconfig"
				endif
			
			config GNSS_USING_UBLOX
				bool "ublox"
				default n

				if GNSS_USING_UBLOX
					source "$OS_ROOT/components/position/gnss_pos/rcvr/ublox/Kconfig"
				endif

			config GNSS_USING_MX
				bool "mx"
				default n

				if GNSS_USING_MX
					source "$OS_ROOT/components/position/gnss_pos/rcvr/mx/Kconfig"
				endif
		endmenu
		
	endif
	
endmenu
```

## components/position/gnss_pos/rcvr/icofchina/Kconfig
```kconfig
menu "icofchina gnss receiver"

    config ICOFCHINA_DEV_NAME
        string "icofchina gnss receiver using device name"
        default "uart2"

endmenu
```

## components/position/gnss_pos/rcvr/interface/Kconfig
```kconfig
menu "gnss receiver operation"

	if GNSS_USING_RCVR
		config ONEPOS_RCVR_DEBUG
			bool "enable gnss receiver debug"
			default n
	
		config RCVR_SUPP_PROT
			bool "gnss receiver using protocol"
			select GNSS_USING_PROT
			default n

		config RCVR_SUPP_RESET
			bool "gnss receiver support reset operation"
			default n

		config RCVR_SUPP_AGNSS
			select ONEPOS_USING_PROT
			bool "gnss receiver support agnss operation"
			default n

	endif
	
endmenu
	
```

## components/position/gnss_pos/rcvr/mx/Kconfig
```kconfig
menu "mx gnss receiver"

    config MX_DEV_NAME
        string "mx gnss receiver using device name"
        default "uart2"

endmenu
```

## components/position/gnss_pos/rcvr/techtotop/Kconfig
```kconfig
menu "techtotop gnss receiver"

    config TECHTOTOP_DEV_NAME
        string "techtotop gnss receiver using device name"
        default "uart3"

endmenu
```

## components/position/gnss_pos/rcvr/ublox/Kconfig
```kconfig
menu "ublox gnss receiver"

    config UBLOX_DEV_NAME
        string "ublox gnss receiver using device name"
        default "uart2"

endmenu
```

## components/position/gnss_pos/rcvr/unicorecomm/Kconfig
```kconfig
menu "unicorecomm gnss receiver"

    config UNICORECOMM_DEV_NAME
        string "unicorecomm using interface device name"
        default "uart3"
        
endmenu
```

## components/position/net_pos/Kconfig
```kconfig
menu "network positon"
	
	config ONEPOS_USING_NET_POS
	select ONEPOS_USING_PROT
	select PKG_USING_CJSON
	bool "enable network positon"
	default n
	
	if ONEPOS_USING_NET_POS
		source "$OS_ROOT/components/position/net_pos/*/Kconfig"
	endif
	
endmenu
```

## components/position/net_pos/cell/Kconfig
```kconfig
menu "cell positon"
	
	config ONEPOS_CELL_POS
	bool "network positon using cell positon"
	default n
	
	if ONEPOS_CELL_POS
		config ONEPOS_CELL_DEVICE_NAME
		string "device name of cell position using"
		default "ml302"
	endif


endmenu
```

## components/position/net_pos/interface/Kconfig
```kconfig
menu "network positon"
	
	config ONEPOS_NET_POS_DEBUG
		bool "enable network position debug"
		default n
	
	config NET_POS_SUPP_REMOTE_CONF
		bool "enable remote config"
		default n
	
	config NET_POS_DEF_INTERVAL
		int "interval of OnePos(should 3 or over)(s)"
		range 3 65535
		default 3	

	config NET_POS_DEF_SEV_TYPE
		int "default position server run type(0:period ciculation;1:single)"
		range 0 1
		default 0
endmenu
```

## components/position/net_pos/wifi/Kconfig
```kconfig
menu "wifi positon"
	
	config ONEPOS_WIFI_POS
	bool "network positon using wifi positon"
	default n
	
	if ONEPOS_WIFI_POS
		config ONEPOS_WIFI_DEVICE_NAME
		string "Device name of wifi_pos using"
		default "esp8266"
	endif


endmenu
```

## components/position/prot/Kconfig
```kconfig
menu "onepos protocol"

config ONEPOS_USING_PROT
	select USING_CMS_CONNECT
    bool "enable onepos communication protocol"
    default n

if ONEPOS_USING_PROT
	config ONEPOS_PROTO_DEBUG
		bool "enable onepos protocol debug"
		default n
		
	config ONEPOS_COMM_REC_BUFF_LEN
		int "receive buff size of OnePos communication(bytes)"
		default 2048
	
	config ONEPOS_COMM_SEND_BUFF_LEN
		int "send buff size of OnePos communication(bytes)"
		default 2048
	
endif

endmenu 
```

## components/position/sample/Kconfig
```kconfig
	config ONEPOS_CMD
	bool "onepos support command(onepos using sample)"
	default n
	
```

## components/ramdisk/Kconfig
```kconfig
menu "Ramdisk"

config OS_USING_RAMDISK
    bool "Using ramdisk"
    default n
    help
        The ramdisk is a vitural device in RAM.

endmenu
```

## components/security/mbedtls/Kconfig
```kconfig
menuconfig SECURITY_USING_MBEDTLS
    bool "Mbed TLS: a portable, easy to use, readable and flexible SSL/TLS library"
    default n
    select NET_USING_BSD
    select MBEDTLS_TIMING_ALT

if SECURITY_USING_MBEDTLS
    config MBEDTLS_AES_ROM_TABLES
        bool "MBEDTLS_AES_ROM_TABLES: use precomputed AES tables stored in ROM"
        default y

    config MBEDTLS_ECP_WINDOW_SIZE
        int "MBEDTLS_ECP_WINDOW_SIZE: maximum window size used"
        range 2 6
        default 2

    config MBEDTLS_ECP_MAX_BITS
        int "MBEDTLS_ECP_MAX_BITS: maximum bit size of groups"
        default 521

    config MBEDTLS_MPI_WINDOW_SIZE
        int "MBEDTLS_MPI_WINDOW_SIZE: maximum windows size used"
        range 2 6
        default 2

    config MBEDTLS_MPI_MAX_SIZE
        int "MBEDTLS_MPI_MAX_SIZE: maximum number of bytes for usable MPIs"
        default 384

    config MBEDTLS_SSL_MAX_CONTENT_LEN
        int "MBEDTLS_SSL_MAX_CONTENT_LEN: maximum bytes of incoming and outgoing plaintext fragments"
        default 4096

    config MBEDTLS_TIMING_ALT
        bool "MBEDTLS_TIMING_ALT: use platform timing function"
        default y

    config MBEDTLS_HAVE_TIME
        bool "MBEDTLS_HAVE_TIME: comment if your system does not support time functions"
        default n

    if MBEDTLS_HAVE_TIME
        config MBEDTLS_HAVE_TIME_DATE
            bool "MBEDTLS_HAVE_TIME_DATE: used to verify the validity period of X.509 certificates"
            default n

        if MBEDTLS_HAVE_TIME_DATE
            config MBEDTLS_PLATFORM_GMTIME_R_ALT
                bool
                default y
        endif
    endif

    config MBEDTLS_THREADING_ALT
        bool "MBEDTLS_THREADING_ALT: use alternate threading implementation"
        default n

    if MBEDTLS_THREADING_ALT
        config MBEDTLS_THREADING_C
            bool
            default y
    endif

    config MBEDTLS_DEBUG_C
        bool "MBEDTLS_DEBUG_C: enable the debug functions"
        default n
        help
            uncheck it to optimize ROM occupation

    if MBEDTLS_DEBUG_C
        config MBDTLS_DEBUG_LOG_LEVEL
        int "set mbedlts demo (tls_client) log level(0-4)"
        default 0
    endif

    config MBEDTLS_ERROR_C
        bool "MBEDTLS_ERROR_C: enable error code to error string conversion"
        default n
        help
            uncheck it to optimize ROM occupation

    config MBEDTLS_SSL_SRV_C
        bool "MBEDTLS_SSL_SRV_C: enable the SSL/TLS server code"
        default n
        help
            uncheck it to optimize ROM occupation if not use it as a tls server
    
    config MBEDTLS_ECP_NIST_OPTIM
        bool "MBEDTLS_ECP_NIST_OPTIM: enable NIST curves optimisation"
        default n
        help
            uncheck it to optimize ROM occupation
    
    config MBEDTLS_SSL_PROTO_DTLS
        bool "MBEDTLS_SSL_PROTO_DTLS: enable support for DTLS"
        default n
        help
            uncheck it to optimize ROM occupation if not use dtls

        if MBEDTLS_SSL_PROTO_DTLS
            config MBEDTLS_SSL_DTLS_ANTI_REPLAY
                bool "MBEDTLS_SSL_DTLS_ANTI_REPLAY: enable support for the anti-replay mechanism in DTLS"
                default y
                help
                    Enable support for the anti-replay mechanism in DTLS, disabling this is often a security risk!
            
            config MBEDTLS_SSL_DTLS_HELLO_VERIFY
                bool "MBEDTLS_SSL_DTLS_HELLO_VERIFY: enable support for HelloVerifyRequest on DTLS servers"
                default y

            config MBEDTLS_SSL_DTLS_CLIENT_PORT_REUSE
                bool "MBEDTLS_SSL_DTLS_CLIENT_PORT_REUSE: enable server-side support for clients that reconnect from the same port"
                default y
            
            config MBEDTLS_SSL_DTLS_BADMAC_LIMIT
                bool "MBEDTLS_SSL_DTLS_BADMAC_LIMIT: enable support for a limit of records with bad MAC"
                default y
            
            config MBEDTLS_SSL_COOKIE_C
                bool "MBEDTLS_SSL_COOKIE_C: enable basic implementation of DTLS cookies for hello verification"
                default y
        endif

    config SECURITY_USING_TLS_CLIENT_DEMO
        bool "Enable a TLS client DEMO"
        default n

    choice
        prompt "Mbed TLS version"
        help
            Select the mbedtls version

        config SECURITY_USING_MBEDTLS_V2168
            bool "v2.16.8"

    endchoice

endif
```

## components/security/onetls/Kconfig
```kconfig
menu "OneTLS"

    config SECURITY_USING_ONETLS
        bool "Enable onetls"
        default n
        help 
            OneTLS is a lightweight SSL/TLS library, supporting the newest TLS 1.3 industry standards

        if SECURITY_USING_ONETLS
            menu "Select Cipher"
                config ONETLS_CIPHER_AES_128_GCM_SHA256
                bool "AES_128_GCM_SHA256"
                default y
                config ONETLS_CIPHER_CHACHA20_POLY1305_SHA256
                bool "CHACHA20_POLY1305_SHA256"
                config ONETLS_CIPHER_AES_128_CCM_SHA256
                bool "AES_128_CCM_SHA256"
                config ONETLS_CIPHER_AES_128_CCM_8_SHA256
                bool "AES_128_CCM_8_SHA256"
            endmenu

            menu "Select Elliptic Curve Groups"
                config ONETLS_ECP_DP_CURVE25519_ENABLED
                bool "curve25519"
                default y
                config ONETLS_ECP_DP_SECP256R1_ENABLED
                bool "secp256r1"
                config ONETLS_ECP_DP_SECP384R1_ENABLED
                bool "secp384r1"
                config ONETLS_ECP_DP_SECP521R1_ENABLED
                bool "secp521r1"
            endmenu

            config ONETLS_DEBUG
                bool "Enable onetls debug"
                default n
            config ONETLS_MAX_RECORD_PACKET_LEN
                int "The max record packet length"
                range 512 16384
                default 1024
            config ONETLS_SUPPORT_RESUMPTION
                bool "Support resumption"
                default y                
            config ONETLS_SUPPORT_0RTT
                bool "Support 0-RTT"
                default y 
            config ONETLS_TESTS
                bool "Enable tls tests demo"
                default n
        endif
endmenu 
```

## components/shell/Kconfig
```kconfig
menu "Shell"
    config OS_USING_SHELL
        bool "Enable shell"
        default y

    if OS_USING_SHELL
        config SHELL_TASK_NAME
            string "The shell task name"
            default "shell"
        
        config SHELL_TASK_PRIORITY
            int "The priority level value of shell task"
            default 5   if OS_TASK_PRIORITY_8
            default 10  if OS_TASK_PRIORITY_16
            default 20  if OS_TASK_PRIORITY_32
            default 40  if OS_TASK_PRIORITY_64
            default 80  if OS_TASK_PRIORITY_128
            default 160 if OS_TASK_PRIORITY_256

        config SHELL_TASK_STACK_SIZE
            int "The stack size for shell task"
            default 2048
        
        config SHELL_USING_HISTORY
            bool "Enable command history feature"
            default y

        if SHELL_USING_HISTORY
            config SHELL_HISTORY_LINES
                int "The command history line number"
                default 5
        endif

        config SHELL_USING_DESCRIPTION
            bool "Keep description in symbol table"
            default y

        config SHELL_ECHO_DISABLE_DEFAULT
            bool "Disable the echo mode in default"
            default n

        config SHELL_CMD_SIZE
            int "The command line size for shell"
            default 80
        
        config SHELL_PROMPT_SIZE
            int "The prompt line size for shell"
            default 256

        config SHELL_ARG_MAX
            int "The command arg num for shell"
            default 10

        config SHELL_USING_AUTH
            bool "Shell support authentication"
            default n
        if SHELL_USING_AUTH
            config SHELL_PASSWORD_MIN
                int "The password min length"
                default 6
            config SHELL_PASSWORD_MAX
                int "The password max length"
                default OS_NAME_MAX
            config SHELL_DEFAULT_PASSWORD
                string "The default password for shell authentication"
                default ""
        endif  
    endif
endmenu
```

## drivers/Kconfig
```kconfig
menu "Drivers"
    menuconfig OS_USING_DEVICE
        bool "Enable device manager"
        default y
        if OS_USING_DEVICE
            config OS_USING_DEVICE_NOTIFY
            bool "Enable device notify"
            default y
        endif
        
    source "$OS_ROOT/drivers/*/Kconfig"
endmenu
```
