## drivers/boot/cotex-m/Kconfig
```kconfig
menu "CORTEX-M Boot"
    if ARCH_ARM_CORTEX_M
        config BSP_INCLUDE_VECTOR_TABLE
            bool "include vector table"
            default y
            
        menuconfig BSP_BOOT_OPTION
            bool "Board boot configure"
            default n
            
            if BSP_BOOT_OPTION
                config BSP_TEXT_SECTION_ADDR
                    hex "text section addr"
                    default 0x08000000
                    
                config BSP_TEXT_SECTION_SIZE
                    hex "text section size"
                    default 0x00080000
                    
                config BSP_DATA_SECTION_ADDR
                    hex "data section addr"
                    default 0x20000000
                    
                config BSP_DATA_SECTION_SIZE
                    hex "data section size"
                    default 0x00008000
            endif
            
    endif
endmenu
```

## drivers/can/Kconfig
```kconfig
menu "CAN"
    config OS_USING_CAN
        bool "Using CAN drivers"
        default n
endmenu
```

## drivers/console/Kconfig
```kconfig
menu "CONSOLE"
    config OS_USING_CONSOLE
        bool "Enable console"
        depends on OS_USING_DEVICE
        default y

    if OS_USING_CONSOLE
        config OS_CONSOLE_DEVICE_NAME
            string "The device name for console"
            default "uart1"
    endif
endmenu
```

## drivers/dma/Kconfig
```kconfig
menu "DMA"

    config OS_USING_DMA
        bool "Enable DMA"
        default n
        
    if OS_USING_DMA
    
        config OS_USING_DMA_RAM
            bool "Enable DMA RAM"
            default y
        
        config OS_USING_SOFT_DMA
            bool "Enable soft DMA"
            default n
            
            if OS_USING_SOFT_DMA
                config OS_SOFT_DMA_SUPPORT_NORMAL_MODE
                    bool "Soft DMA support normal mode"
                    default y
            
                config OS_SOFT_DMA_SUPPORT_CIRCLE_MODE
                    bool "Soft DMA support circle mode"
                    default y
            
                config OS_SOFT_DMA_SUPPORT_SIMUL_TIMEOUT
                    bool "Soft DMA support simul timeout"
                    default n

            endif
        
    endif
        
endmenu
```

## drivers/fal/Kconfig
```kconfig
menu "FAL"
    config OS_USING_FAL
        bool "Using flash abstraction layer"
        default n
        
    if OS_USING_FAL
        config OS_FAL_RAM
            bool "Support fal ram"
            default n
            
        if OS_FAL_RAM
            config OS_FAL_RAM_SIZE
                hex "Fal ram size(Bytes)"
                default 0x80000
        endif
    endif
endmenu
```

## drivers/graphic/Kconfig
```kconfig
menu "Graphic"
    config OS_USING_GRAPHIC
        bool "Using graphic devices"
        default n

    if OS_USING_GRAPHIC
        config OS_GRAPHIC_WIDTH
            int "Graphic width"
            default 240

        config OS_GRAPHIC_HEIGHT
            int "Graphic height"
            default 240
    
        config OS_USING_DSI
            bool "Use DSI"
            default n
            
            if OS_USING_DSI
                config OS_USING_DSI_RST
                    int "dsi rst io"
                    default 159
            endif
            
        config BSP_USING_OTM8009A
            bool "Use otm8009a"
            default n
            
            if OS_USING_DSI && BSP_USING_OTM8009A
                config BSP_OTM8009A_DSI_CHANNEL
                    int "otm8009a DSI channel id"
                    default 0
            endif

        menuconfig BSP_USING_ILI9341
            bool "Enable ili9341"
            default n

            if BSP_USING_ILI9341
                config BSP_ILI9341_SPI_BUS_NAME
                    string "ili9341 spi bus name"
                    default "spi5"

                config BSP_ILI9341_SPI_CS
                    int "ili9341 spi cs io"
                    default 34

                config BSP_ILI9341_WRX
                    int "ili9341 wrx io"
                    default 61
            endif

        menuconfig OS_USING_ST7789VW
            bool "Use st7789vw"
            select OS_USING_SPI
            select BSP_USING_SPI
            default n

            if OS_USING_ST7789VW
                config OS_ST7789VW_SPI_BUS_NAME
                    string "st7789vw spi bus name"
                    default "spi1"

                config OS_ST7789VW_SPI_BUS_MODE
                    int "st7789vw spi bus mode"
                    default 0

                config OS_ST7789VW_SPI_CS_PIN
                    int "st7789vw spi cs pin"
                    default 62

                config OS_ST7789VW_PWR_PIN
                    int "st7789vw power pin"
                    default 4

                config OS_ST7789VW_PWR_PIN_ACTIVE
                    int "st7789vw power pin active level"
                    default 1

                config OS_ST7789VW_DC_PIN
                    int "st7789vw dc pin"
                    default 59

                config OS_ST7789VW_RES_PIN
                    int "st7789vw reset pin"
                    default 6
            endif

        menuconfig BSP_USING_ATKTFLCD9341
            bool "Enable atk_tflcd9341"
            default n

            if BSP_USING_ATKTFLCD9341
                config BSP_ATK9341_BL_PIN
                    int "atk_tflcd9341 backlight pin"
                    default "16"
            endif
    endif

endmenu
```

## drivers/hal/apollo/Kconfig
```kconfig
config MANUFACTOR_APOLLO
    bool
    default n

source "$OS_ROOT/drivers/hal/apollo/*/Kconfig"
```

## drivers/hal/apollo/apollo/Kconfig
```kconfig
config SERIES_APOLLO
    bool
    select ARCH_ARM_CORTEX_M4
    default n

config SOC_APOLLO_XXX
    bool
    select MANUFACTOR_APOLLO
    select SERIES_APOLLO
    default n
```

## drivers/hal/apollo/apollo2/Kconfig
```kconfig
config SERIES_APOLLO2
    bool
    select ARCH_ARM_CORTEX_M4
    default n

config SOC_APOLLO2_XXX
    bool
    select MANUFACTOR_APOLLO
    select SERIES_APOLLO2
    default n
```

## drivers/hal/apollo/apollo3/Kconfig
```kconfig
config SERIES_APOLLO3
    bool
    select ARCH_ARM_CORTEX_M4
    default n

config SOC_APOLLO3_XXX
    bool
    select MANUFACTOR_APOLLO
    select SERIES_APOLLO3
    default n
```

## drivers/hal/apollo/drivers/Kconfig
```kconfig
config BSP_USING_GPIO
    bool "Enable GPIO"
    select OS_USING_PIN
    default y

config BSP_USING_LED
    bool "Enable LED"
    select BSP_USING_GPIO
    default y

menuconfig BSP_USING_UART
    bool "Enable UART"
    default y
    select OS_USING_SERIAL
    if BSP_USING_UART
        config BSP_USING_UART0
            bool "Enable UART0"
            default y

        config BSP_USING_UART1
            depends on SERIES_APOLLO2
            bool "Enable UART1"
            default n
    endif

config BSP_USING_ON_CHIP_FLASH
    bool "Enable on-chip FLASH"
    default n

menuconfig BSP_USING_SPI
    bool "Enable SPI BUS"
    default n
    select OS_USING_SPI
    if BSP_USING_SPI
        config BSP_USING_SPI0
            bool "Enable SPI0 BUS"
            default n

        config BSP_USING_SPI1
            bool "Enable SPI1 BUS"
            default n
    endif

menuconfig BSP_USING_I2C
    bool "Enable I2C BUS"
    default n
    select OS_USING_I2C
    select OS_USING_I2C_BITOPS
    select OS_USING_PIN

    menuconfig BSP_USING_I2C0
        depends on BSP_USING_I2C
        bool "Enable I2C0 BUS (software simulation)"
        default n

    menuconfig BSP_USING_I2CBB
        depends on BSP_USING_I2C
        bool "Enable I2CBB (software simulation)"
        default n
        if BSP_USING_I2CBB
            comment "Notice: PC0 --> 32; PC1 --> 33"
            config BSP_I2C2_SCL_PIN
                int "i2c2 scl pin number"
                range 1 176
                default 32
            config BSP_I2C2_SDA_PIN
                int "I2C2 sda pin number"
                range 1 176
                default 33
        endif

menuconfig BSP_USING_TIM
    bool "Enable timer"
    default n
    select OS_USING_HWTIMER
    if BSP_USING_TIM
        config BSP_USING_TIM15
            bool "Enable TIM15"
            default n

        config BSP_USING_TIM16
            bool "Enable TIM16"
            default n

        config BSP_USING_TIM17
            bool "Enable TIM17"
            default n
    endif

menuconfig BSP_USING_PWM
    bool "Enable pwm"
    default n
    select OS_USING_PWM
    if BSP_USING_PWM
    menuconfig BSP_USING_PWM1
        bool "Enable timer1 output pwm"
        default n
        if BSP_USING_PWM1
            config BSP_USING_PWM1_CH1
                bool "Enable PWM1 channel1"
                default n
        endif
    endif

menuconfig BSP_USING_ADC
    bool "Enable ADC"
    default n
    select OS_USING_ADC
    if BSP_USING_ADC
        config BSP_USING_ADC1
            bool "Enable ADC1"
            default n
    endif

menuconfig BSP_USING_ONCHIP_RTC
    bool "Enable RTC"
    select OS_USING_RTC
    default n
    if BSP_USING_ONCHIP_RTC
        choice
            prompt "Select clock source"
            default BSP_RTC_USING_LSE

            config BSP_RTC_USING_LSE
                bool "RTC USING LSE"

            config BSP_RTC_USING_LSI
                bool "RTC USING LSI"
        endchoice
    endif

config BSP_USING_WDT
    bool "Enable Watchdog Timer"
    select OS_USING_WDT
    default n
```

## drivers/hal/beken/Kconfig
```kconfig
config SOC_FAMILY_BK72XX
    bool
    default n

source "$OS_ROOT/drivers/hal/beken/beken72XX_HAL/Kconfig"
source "$OS_ROOT/drivers/hal/beken/drivers/Kconfig"

#comment "Configure base hal in beken"
```

## drivers/hal/beken/beken72XX_HAL/Kconfig
```kconfig
config SOC_ARM9_BK7231N
    bool
    select ARCH_ARM_ARM968
	select SOC_FAMILY_BK72XX
    default n
```

## drivers/hal/cmiot/CM32M10x_HAL/Kconfig
```kconfig
config SERIES_CM32M10
    bool
	select ARCH_ARM_CORTEX_M4
    default n
	
config SOC_CM32M101A
	bool
	select MANUFACTOR_CM32
	select SERIES_CM32M10
	default n
```

## drivers/hal/cmiot/Kconfig
```kconfig
config MANUFACTOR_CM32
	bool
	default n

source "$OS_ROOT/drivers/hal/cmiot/CM32M10x_HAL/Kconfig"
source "$OS_ROOT/drivers/hal/cmiot/drivers/Kconfig"
```

## drivers/hal/cmiot/drivers/Kconfig
```kconfig
    config BSP_USING_GPIO
        bool "Enable GPIO"
        select OS_USING_PIN
        default y

    menuconfig BSP_USING_UART
        bool "Enable UART"
        default y
        select OS_USING_SERIAL
        if BSP_USING_UART
            config BSP_USING_LPUART0
                bool "Enable LPUART0"
                default n

            config LPUART0_USING_DMA
            depends on BSP_USING_LPUART0
                bool "Lpuart0 using dma"
                default n

            config BSP_USING_UART1
                bool "Enable UART1"
                default y

            config UART1_USING_DMA
            depends on BSP_USING_UART1
                bool "Uart1 using dma"
                default n

            config BSP_USING_UART2
                bool "Enable UART2"
                default n

            config UART2_USING_DMA
            depends on BSP_USING_UART2
                bool "Uart2 using dma"
                default n

            config BSP_USING_UART3
                bool "Enable UART3"
                default n

            config UART3_USING_DMA
            depends on BSP_USING_UART3
                bool "Uart3 using dma"
                default n

            config BSP_USING_UART4
                bool "Enable UART4"
                default n

            config UART4_USING_DMA
            depends on BSP_USING_UART4
                bool "Uart4 using dma"
                default n

            config BSP_USING_UART5
                bool "Enable UART5"
                default n

            config UART5_USING_DMA
            depends on BSP_USING_UART5
                bool "Uart5 using dma"
                default n

        endif
    menu "Select I2C port"
        depends on OS_USING_I2C
        config BSP_USING_I2C1
            bool "Enable I2C1"
            default y

        config BSP_USING_I2C2
            bool "Enable I2C2"
            default n
    endmenu
    menu "Select SPI port"
        depends on OS_USING_SPI
        config BSP_USING_SPI1
            bool "Enable SPI1"
            default y

        config BSP_USING_SPI2
            bool "Enable SPI2"
            default n
    endmenu

    menu "Select WDG port"
        depends on OS_USING_WDG
        config BSP_USING_IWDG
            bool "Enable IWDG"
            default n

        config BSP_USING_WWDG
            bool "Enable WWDG"
            default y
    endmenu

    menu "Select PWM port"
        depends on OS_USING_PWM
        config BSP_USING_PWM1
            bool "Enable PWM1"
            default n

        config BSP_USING_PWM2
            bool "Enable PWM2"
            default n

        config BSP_USING_PWM3
            bool "Enable PWM3"
            default y

        config BSP_USING_PWM4
            bool "Enable PWM4"
            default n
    endmenu

        config BSP_USING_ON_CHIP_FLASH
            bool "Enable on-chip FLASH"
            select OS_USING_FAL
            default y

        config BSP_USING_LCD
            bool "Enable LCD"
            default n

        config BSP_USING_RNG
            bool "Enable RNG"
            default n
	
```

## drivers/hal/fm/FM33G0xx_HAL/Kconfig
```kconfig
config SERIES_FM33G0
    bool
    select ARCH_ARM_CORTEX_M0
    default n

config SOC_FM33G0XX
    bool
    select MANUFACTOR_FM33
    select SERIES_FM33G0
    default n
```

## drivers/hal/fm/FM33LC0xx_HAL/Kconfig
```kconfig
config SERIES_FM33LC0
    bool
    select ARCH_ARM_CORTEX_M0
    default n

config SOC_FM33LC0XX
    bool
    select MANUFACTOR_FM33
    select SERIES_FM33LC0
    default n
```

## drivers/hal/fm/FM33LG0xx_HAL/Kconfig
```kconfig
config SERIES_FM33LG0
    bool
    select ARCH_ARM_CORTEX_M0_PLUS
    default n

config SOC_FM33LG0XX
    bool
	select MANUFACTOR_FM33
    select SERIES_FM33LG0
    default n
```

## drivers/hal/fm/Kconfig
```kconfig
config MANUFACTOR_FM33
    bool
    default n

source "$OS_ROOT/drivers/hal/fm/*/Kconfig"
```

## drivers/hal/fm/drivers/Kconfig
```kconfig
if SERIES_FM33LC0
source "$OS_ROOT/drivers/hal/fm/drivers/lc0/Kconfig"
endif

if SERIES_FM33LG0
source "$OS_ROOT/drivers/hal/fm/drivers/lg0/Kconfig"
endif

if SERIES_FM33G0
source "$OS_ROOT/drivers/hal/fm/drivers/g0/Kconfig"
endif
```
