## drivers/hal/gd/GD32E10x_HAL/Kconfig
```kconfig
config SERIES_GD32E10X
    bool
    select ARCH_ARM_CORTEX_M4
    default n

config SOC_GD32E10X
    bool
    select SERIES_GD32E10X
    default n
```

## drivers/hal/gd/GD32E50x_HAL/Kconfig
```kconfig
config SERIES_GD32E50X
    bool
    select ARCH_ARM_CORTEX_M33
    default n

config SOC_GD32E50X_CL
    bool
    select SERIES_GD32E50X
    default n

config SOC_GD32E50X_HD
    bool
    select SERIES_GD32E50X
    default n

config SOC_GD32E50X_XD
    bool
    select SERIES_GD32E50X
    default n
```

## drivers/hal/gd/GD32F10x_HAL/Kconfig
```kconfig
config SERIES_GD32F10X
    bool
    select ARCH_ARM_CORTEX_M3
    default n

config SOC_GD32F10X_MD
    bool
    select SERIES_GD32F10X
    default n

config SOC_GD32F10X_CL
    bool
    select SERIES_GD32F10X
    default n
    
config SOC_GD32F10X_HD
    bool
    select SERIES_GD32F10X
    default n
    
config SOC_GD32F10X_XD
    bool
    select SERIES_GD32F10X
    default n
    
    
```

## drivers/hal/gd/GD32F20x_HAL/Kconfig
```kconfig
config SERIES_GD32F20X
    bool
    select ARCH_ARM_CORTEX_M3
    default n

config SOC_GD32F20X_CL
    bool
    select SERIES_GD32F20X
    default n
```

## drivers/hal/gd/GD32F30x_HAL/Kconfig
```kconfig
config SERIES_GD32F30X
    bool
    select ARCH_ARM_CORTEX_M4
    default n

config SOC_GD32F303RCT6
    bool
    select SERIES_GD32F30X
    default n

config SOC_GD32F30X_CL
    bool
    select SERIES_GD32F30X
    default n
    
config SOC_GD32F30X_HD
    bool
    select SERIES_GD32F30X
    default n
    
config SOC_GD32F30X_XD
    bool
    select SERIES_GD32F30X
    default n
    
    
```

## drivers/hal/gd/GD32F3x0_HAL/Kconfig
```kconfig
config SERIES_GD32F3X0
    bool
    select ARCH_ARM_CORTEX_M4
    default n

config SOC_GD32F3X0
    bool
    select SERIES_GD32F3X0
    default n
    
```

## drivers/hal/gd/GD32F403_HAL/Kconfig
```kconfig
config SERIES_GD32F403
    bool
    select ARCH_ARM_CORTEX_M4
    default n

config SOC_GD32F403
    bool
    select SERIES_GD32F403
    default n
```

## drivers/hal/gd/GD32F4xx_HAL/Kconfig
```kconfig
config SERIES_GD32F4XX
    bool
    select ARCH_ARM_CORTEX_M4
    default n

config SOC_GD32F405RGT6
    bool
    select SERIES_GD32F4XX
    default n

config SOC_GD32F450ZKT6
    bool
    select SERIES_GD32F4XX
    default n

config SOC_GD32F450VIT6
    bool
    select SERIES_GD32F4XX
    default n
    
config SOC_GD32F450
    bool
    select SERIES_GD32F4XX
    default n
    
config SOC_GD32F405
    bool
    select SERIES_GD32F4XX
    default n
    
config SOC_GD32F407
    bool
    select SERIES_GD32F4XX
    default n
```

## drivers/hal/gd/drivers/Kconfig
```kconfig
config BSP_USING_PIN
    bool "pin"
    select OS_USING_PIN
    default n

config BSP_USING_USART
    bool "usart"
    select OS_USING_SERIAL
    default n
    
    if BSP_USING_USART
        config BSP_USING_USART0
            bool "usart0"
            default n
            
        config BSP_USING_USART1
            bool "usart1"
            default n
            
        config BSP_USING_USART2
            bool "usart2"
            default n
            
        config BSP_USING_UART6
            bool "uart6"
            depends on (SERIES_GD32F4XX || SERIES_GD32F403)
            default n
            
        config BSP_USING_UART7
            bool "uart7"
            depends on (SERIES_GD32F4XX || SERIES_GD32F403)
            default n
    endif

config BSP_USING_I2C
    bool "i2c"
    select OS_USING_I2C
    default n
    
    if BSP_USING_I2C
        config BSP_USING_I2C0
            bool "i2c0"
            default n
            
        config BSP_USING_I2C1
            bool "i2c1"
            default n
    endif

config BSP_USING_ADC
    bool "adc"
    select OS_USING_ADC
    default n
    
    if BSP_USING_ADC
        config BSP_USING_ADC0
            bool "adc0"
            default n
            
        config BSP_USING_ADC1
            bool "adc1"
            default n
    endif

config BSP_USING_DAC
    bool "dac"
    select OS_USING_DAC
    default n
    
    if BSP_USING_DAC
        config BSP_USING_DAC0
            bool "dac use dac0"
            default n
            
        config BSP_USING_DAC1
            bool "dac use dac1"
            default n
    endif

config BSP_USING_TIMER
    bool "timer"
    select OS_USING_TIMER
    default n

config BSP_USING_FLASH
    bool "on chip flash"
    select OS_USING_FLASH
    default n

config BSP_USING_RTC
    bool "rtc"
    select OS_USING_RTC
    default n

config BSP_USING_SPI
    bool "spi"
    select OS_USING_SPI
    default n
    
    if BSP_USING_SPI
        config BSP_USING_SPI0
            bool "spi0"
            default n
            
        config BSP_USING_SPI1
            bool "spi1"
            default n
            
        config BSP_USING_SPI2
            bool "spi2"
            default n
            
        config BSP_USING_SPI3
            bool "spi3"
            depends on (SERIES_GD32F4XX || SERIES_GD32F403)
            default n
            
        config BSP_USING_SPI4
            bool "spi4"
            depends on (SERIES_GD32F4XX || SERIES_GD32F403)
            default n
            
        config BSP_USING_SPI5
            bool "spi5"
            depends on (SERIES_GD32F4XX || SERIES_GD32F403)
            default n
    endif

menuconfig BSP_USING_ETH
    depends on (SERIES_GD32F4XX || SERIES_GD32F403)
        bool "Enable Ethernet"
        select OS_USING_LWIP
        default n
        if BSP_USING_ETH
            comment "config eth hw"
            config ETH_RESET_PIN
                int "ETH reset pin number(default:phy_reset pin -->51)"
                default 51
                
            config ETH_RESET_PIN_ACTIVE_HIGH
                bool "ETH reset pin active level is high"
                default n
            
            choice
                prompt "choose eth hardware"
                default PHY_USING_LAN8720A
                help
                    Select the eth hardware

                config PHY_USING_LAN8720A
                    bool "LAN8720A"

                config PHY_USING_DM9161CEP
                    bool "DM9161CEP"

                config PHY_USING_DP83848C
                    bool "DP83848C"
            endchoice
            
            choice
                prompt "choose RMII or MII"
                default PHY_USING_RMII
                help
                    Select the eth RMII or MII

                config PHY_USING_RMII
                    bool "RMII"

                config PHY_USING_MII
                    bool "MII"
            endchoice
        endif
```

## drivers/hal/gd/drivers/usb/Kconfig
```kconfig
config BSP_USING_USB
	bool "usb"
    select OS_USING_FREERTOS_API_V8_2_0
	default n
	
	if BSP_USING_USB
		config BSP_USING_USBH
			bool "usb host"
			default n
            
            if BSP_USING_USBH
                config OS_USING_USBH_CDC
                    bool "usb host cdc class"
                    default n
            endif
			
		config BSP_USING_USBD
			bool "usb device"
			default n
	endif
```

## drivers/hal/gd32v/GD32VF1XX/Kconfig
```kconfig
config SOC_SERIES_GD32VF1XX
    bool
	select ARCH_RISCV_BUMBLEBEE
    default n

config SOC_GD32VF103CBT6
    bool
    select SOC_FAMILY_GD32VF103
    select SOC_SERIES_GD32VF1XX
    default n
```

## drivers/hal/gd32v/Kconfig
```kconfig
config SOC_FAMILY_GD32VF103
    bool
    default n

source "$OS_ROOT/drivers/hal/gd32v/GD32VF1XX/Kconfig"

source "$OS_ROOT/drivers/hal/gd32v/drivers/Kconfig"

#comment "Configure base hal in GD32"
```

## drivers/hal/gd32v/drivers/Kconfig
```kconfig
config BSP_USING_PIN
	bool "pin"
	default n

menuconfig BSP_USING_UART
	bool "Enable UART"
	default y
    select OS_USING_SERIAL
    select BSP_UART_NO_IDLE
	if BSP_USING_UART
		config OS_USING_USART0
			bool "Enable UART0"
			default y
        if OS_USING_USART0
            config OS_USING_USART0_DMA
                bool "UART0 enable dma"
                default y
        endif
		config OS_USING_USART1
			bool "Enable UART1"
			default y
        if OS_USING_USART1
            config OS_USING_USART1_DMA
                bool "UART1 enable dma"
                default y
        endif
        config BSP_UART_NO_IDLE
            bool "Disable UART IDLE"
            default y
            select OS_SERIAL_IDLE_TIMER 
	endif

config BSP_USING_I2C
	bool "i2c"
	default n

if BSP_USING_I2C
	config BSP_USING_I2C0
		bool "i2c0"
		default n

	config BSP_USING_I2C1
		bool "i2c1"
		default n
endif

menu "Select SPI port"
	depends on OS_USING_SPI
	config BSP_USING_SPI0
		bool "Enable SPI0"
		default y

	config BSP_USING_SPI1
		bool "Enable SPI1"
		default n
endmenu

config BSP_USING_FLASH
	bool "on chip flash"
	default n	
```

## drivers/hal/hdsc/HC32F072_HAL/Kconfig
```kconfig
config SERIES_HC32F07
    bool
    select ARCH_ARM_CORTEX_M0_PLUS
    default n

config SOC_HC32F07X
    bool
    select MANUFACTOR_HC32
    select SERIES_HC32F07
    default n
```

## drivers/hal/hdsc/HC32F17x_HAL/Kconfig
```kconfig
config SERIES_HC32F17
    bool
    select ARCH_ARM_CORTEX_M0_PLUS
    default n
	
config SOC_HC32F17X
    bool
    select MANUFACTOR_HC32
    select SERIES_HC32F17
    default n
```

## drivers/hal/hdsc/HC32F19x_HAL/Kconfig
```kconfig
config SERIES_HC32F19
    bool
    select ARCH_ARM_CORTEX_M0_PLUS
    default n
	
config SOC_HC32F19X
    bool
    select MANUFACTOR_HC32
    select SERIES_HC32F19
    default n
```

## drivers/hal/hdsc/HC32F46x_HAL/Kconfig
```kconfig
config SERIES_HC32F46
    bool
    select ARCH_ARM_CORTEX_M4
    default n

config SOC_HC32F46X
    bool
    select MANUFACTOR_HC32
    select SERIES_HC32F46
    default n
```

## drivers/hal/hdsc/HC32F4Ax_HAL/Kconfig
```kconfig
config SERIES_HC32F4A
    bool
    select ARCH_ARM_CORTEX_M4
    default n

config SOC_HC32F4AX
    bool
    select MANUFACTOR_HC32
    select SERIES_HC32F4A
    default n
```

## drivers/hal/hdsc/HC32L07x_HAL/Kconfig
```kconfig
config SERIES_HC32L07
    bool
    select ARCH_ARM_CORTEX_M0_PLUS
    default n

config SOC_HC32L07X
    bool
    select MANUFACTOR_HC32
    select SERIES_HC32L07
    default n
```

## drivers/hal/hdsc/HC32L13x_HAL/Kconfig
```kconfig
config SERIES_HC32L13
    bool
    select ARCH_ARM_CORTEX_M0_PLUS
    default n

config SOC_HC32L136K8TA
    bool
    select MANUFACTOR_HC32
    select SERIES_HC32L13
    default n
```

## drivers/hal/hdsc/HC32L17x_HAL/Kconfig
```kconfig
config SERIES_HC32L17
    bool
    select ARCH_ARM_CORTEX_M0_PLUS
    default n
	
config SOC_HC32L17X
    bool
    select MANUFACTOR_HC32
    select SERIES_HC32L17
    default n
```

## drivers/hal/hdsc/HC32L19x_HAL/Kconfig
```kconfig
config SERIES_HC32L19
    bool
    select ARCH_ARM_CORTEX_M0_PLUS
    default n

config SOC_HC32L19X
    bool
    select MANUFACTOR_HC32
    select SERIES_HC32L19
    default n
```

## drivers/hal/hdsc/Kconfig
```kconfig
config MANUFACTOR_HC32
    bool
    default n

source "$OS_ROOT/drivers/hal/hdsc/*/Kconfig"
```

## drivers/hal/hdsc/drivers/Kconfig
```kconfig
if SERIES_HC32F07
source "$OS_ROOT/drivers/hal/hdsc/drivers/lfxx/Kconfig"
endif

if SERIES_HC32F17
source "$OS_ROOT/drivers/hal/hdsc/drivers/lfxx/Kconfig"
endif

if SERIES_HC32F19
source "$OS_ROOT/drivers/hal/hdsc/drivers/lfxx/Kconfig"
endif

if SERIES_HC32L07
source "$OS_ROOT/drivers/hal/hdsc/drivers/lfxx/Kconfig"
endif

if SERIES_HC32L17
source "$OS_ROOT/drivers/hal/hdsc/drivers/lfxx/Kconfig"
endif

if SERIES_HC32L19
source "$OS_ROOT/drivers/hal/hdsc/drivers/lfxx/Kconfig"
endif

if SERIES_HC32F46
source "$OS_ROOT/drivers/hal/hdsc/drivers/f46x/Kconfig"
endif

if SERIES_HC32F4A
source "$OS_ROOT/drivers/hal/hdsc/drivers/f4Ax/Kconfig"
endif
```
