## drivers/hal/hdsc/drivers/f4ax/Kconfig
```kconfig
config BSP_USING_GPIO
    bool "Enable GPIO"
    select OS_USING_PIN
    default y

menuconfig BSP_USING_UART
    bool "Enable UART"
    default y
    select OS_USING_SERIAL

    if BSP_USING_UART

        config BSP_USING_UART1
            bool "Enable UART1"
            default y

        config UART1_USING_DMA
            depends on BSP_USING_UART1
            bool "Uart1 using dma"
            default n

        config BSP_USING_UART2
            bool "Enable UART2"
            default n

        config UART2_USING_DMA
            depends on BSP_USING_UART2
            bool "Uart2 using dma"
            default n

        config BSP_USING_UART3
            bool "Enable UART3"
            default n

        config UART3_USING_DMA
            depends on BSP_USING_UART3
            bool "Uart3 using dma"
            default n
    endif

config BSP_USING_ON_CHIP_FLASH
    bool "Enable on-chip FLASH"
    select OS_USING_FAL
    default y
```

## drivers/hal/hdsc/drivers/lfxx/Kconfig
```kconfig
config BSP_USING_GPIO
    bool "Enable GPIO"
    select OS_USING_PIN
    default y

menuconfig BSP_USING_LPUART
    bool "Enable LPUART(only can select two DMA ch for all lpuarts and uarts)"
    default n
    select OS_USING_SERIAL

    if BSP_USING_LPUART

        config BSP_USING_LPUART0
            bool "Enable LPUART0"
            default n

        config LPUART0_USING_DMA
            depends on BSP_USING_LPUART0
            bool "Lpuart0 using dma"
            default n

        config BSP_USING_LPUART1
            bool "Enable LPUART1"
            default n

        config LPUART1_USING_DMA
            depends on BSP_USING_LPUART1
            bool "Lpuart1 using dma"
            default n

    endif

menuconfig BSP_USING_UART
    bool "Enable UART  (only can select two DMA ch for all lpuarts and uarts)"
    default y
    select OS_USING_SERIAL

    if BSP_USING_UART

        config BSP_USING_UART0
            bool "Enable UART0"
            default n

        config UART0_USING_DMA
            depends on BSP_USING_UART0
            bool "Uart0 using dma"
            default n

        config BSP_USING_UART1
            bool "Enable UART1"
            default y

        config UART1_USING_DMA
            depends on BSP_USING_UART1
            bool "Uart1 using dma"
            default n

        config BSP_USING_UART2
            bool "Enable UART2"
            default n

        config UART2_USING_DMA
            depends on BSP_USING_UART2
            bool "Uart2 using dma"
            default n

        config BSP_USING_UART3
            bool "Enable UART3"
            default n

        config UART3_USING_DMA
            depends on BSP_USING_UART3
            bool "Uart3 using dma"
            default n
    endif

menuconfig BSP_USING_I2C
    bool "Enable I2C"
    select OS_USING_I2C
    default n

    if BSP_USING_I2C
        config BSP_USING_I2C0
            bool "Enable I2C0"
            default y

        config BSP_USING_I2C1
            bool "Enable I2C1"
            default n
    endif

menuconfig BSP_USING_SPI
    bool "Enable SPI"
    select OS_USING_SPI
    default n

    if BSP_USING_SPI
        config BSP_USING_SPI0
            bool "Enable SPI0"
            default y

        config BSP_USING_SPI1
            bool "Enable SPI1"
            default n
    endif

menuconfig BSP_USING_LPTIM
    bool "Enable LPTIMER"
    select OS_USING_TIMER_DRIVER
    select OS_USING_CLOCKSOURCE
    select OS_USING_CLOCKEVENT
    default n

    if BSP_USING_LPTIM
        config BSP_USING_LPTIM0
            bool "Enable LPTIM0"
            default y

        config BSP_USING_LPTIM1
            bool "Enable LPTIM1"
            default n
    endif

config BSP_USING_TIMER
    bool "Enable TIMER"
    select OS_USING_TIMER_DRIVER
    select OS_USING_CLOCKSOURCE
    select OS_USING_CLOCKEVENT
    default n

config BSP_USING_ON_CHIP_FLASH
    bool "Enable on-chip FLASH"
    select OS_USING_FAL
    default y
```

## drivers/hal/hk32/HK32F0XX/Kconfig
```kconfig
config SERIES_HK32F0
    bool
    select ARCH_ARM_CORTEX_M0
    default n

config SOC_HK32F030RBT6
    bool
    select MANUFACTOR_HK32
    select SERIES_HK32F0
    default n

config SOC_HK32F030CBT6
    bool
    select MANUFACTOR_HK32
    select SERIES_HK32F0
    default n

config SOC_HK32F030KBT6
    bool
    select MANUFACTOR_HK32
    select SERIES_HK32F0
    default n

config SOC_HK32F030FBP6
    bool
    select MANUFACTOR_HK32
    select SERIES_HK32F0
    default n

config SOC_HK32F031CBT6
    bool
    select MANUFACTOR_HK32
    select SERIES_HK32F0
    default n

config SOC_HK32F031KBT6
    bool
    select MANUFACTOR_HK32
    select SERIES_HK32F0
    default n

config SOC_HK32F031KBU6
    bool
    select MANUFACTOR_HK32
    select SERIES_HK32F0
    default n

config SOC_HK32F031GBU6
    bool
    select MANUFACTOR_HK32
    select SERIES_HK32F0
    default n

config SOC_HK32F031FBP6
    bool
    select MANUFACTOR_HK32
    select SERIES_HK32F0
    default n

config SOC_HK32F04ARBT6
    bool
    select MANUFACTOR_HK32
    select SERIES_HK32F0
    default n

config SOC_HK32F04ACBT6
    bool
    select MANUFACTOR_HK32
    select SERIES_HK32F0
    default n

config SOC_HK32F04AKBT6
    bool
    select MANUFACTOR_HK32
    select SERIES_HK32F0
    default n

config SOC_HK32F04AKBU6
    bool
    select MANUFACTOR_HK32
    select SERIES_HK32F0
    default n

config SOC_HK32F04AGBU6
    bool
    select MANUFACTOR_HK32
    select SERIES_HK32F0
    default n

config SOC_HK32F04AFBP6
    bool
    select MANUFACTOR_HK32
    select SERIES_HK32F0
    default n
```

## drivers/hal/hk32/HK32F103/Kconfig
```kconfig
config SERIES_HK32F1
    bool
    select ARCH_ARM_CORTEX_M3
    default n

config SOC_HK32F103RBT6
    bool
    select MANUFACTOR_HK32
    select SERIES_HK32F1
    default n

config SOC_HK32F103R8T6
    bool
    select MANUFACTOR_HK32
    select SERIES_HK32F1
    default n

config SOC_HK32F103CBT6
    bool
    select MANUFACTOR_HK32
    select SERIES_HK32F1
    default n

config SOC_HK32F103C8T6
    bool
    select MANUFACTOR_HK32
    select SERIES_HK32F1
    default n

config SOC_HK32F103VBT6A
    bool
    select MANUFACTOR_HK32
    select SERIES_HK32F1
    default n

config SOC_HK32F103V8T6A
    bool
    select MANUFACTOR_HK32
    select SERIES_HK32F1
    default n

config SOC_HK32F103RBT6A
    bool
    select MANUFACTOR_HK32
    select SERIES_HK32F1
    default n

config SOC_HK32F103R8T6A
    bool
    select MANUFACTOR_HK32
    select SERIES_HK32F1
    default n

config SOC_HK32F103CBT6A
    bool
    select MANUFACTOR_HK32
    select SERIES_HK32F1
    default n

config SOC_HK32F103C8T6A
    bool
    select MANUFACTOR_HK32
    select SERIES_HK32F1
    default n

config SOC_HK32F103VET6
    bool
    select MANUFACTOR_HK32
    select SERIES_HK32F1
    default n

config SOC_HK32F103VDT6
    bool
    select MANUFACTOR_HK32
    select SERIES_HK32F1
    default n

config SOC_HK32F103VCT6
    bool
    select MANUFACTOR_HK32
    select SERIES_HK32F1
    default n

config SOC_HK32F103RET6
    bool
    select MANUFACTOR_HK32
    select SERIES_HK32F1
    default n

config SOC_HK32F103RDT6
    bool
    select MANUFACTOR_HK32
    select SERIES_HK32F1
    default n

config SOC_HK32F103RCT6
    bool
    select MANUFACTOR_HK32
    select SERIES_HK32F1
    default n
```

## drivers/hal/hk32/HK32F39A/Kconfig
```kconfig
config SERIES_HK32F3
    bool
    select ARCH_ARM_CORTEX_M3
    default n

config SOC_HK32F39ARET6
    bool
    select MANUFACTOR_HK32
    select SERIES_HK32F3
    default n
```

## drivers/hal/hk32/Kconfig
```kconfig
config MANUFACTOR_HK32
    bool
    default n

source "$OS_ROOT/drivers/hal/hk32/*/Kconfig"
```

## drivers/hal/hk32/drivers/Kconfig
```kconfig
config BSP_USING_PIN
    bool "pin"
    select OS_USING_PIN
    default n
    
config BSP_USING_USART
    bool "usart"
    select OS_USING_SERIAL
    default n
    
    if BSP_USING_USART
        config BSP_USING_USART1
            bool "usart1"
            default n
            
        config BSP_USING_USART2
            bool "usart2"
            default n
            
        config BSP_USING_USART3
            bool "usart3"
            default n
    endif
    
config BSP_USING_TIMER
    bool "timer"
    select OS_USING_TIMER_DRIVER
    select OS_USING_CLOCKSOURCE
    select OS_USING_CLOCKEVENT
    default n
    
    if BSP_USING_TIMER
        
        config BSP_USING_TIMER1
            bool "timer1"
            depends on SERIES_HK32F3
            default n
        
        config BSP_USING_TIMER2
            bool "timer2"
            depends on (SERIES_HK32F1 || SERIES_HK32F3)
            default n
            
        config BSP_USING_TIMER3
            bool "timer3"
            depends on (SERIES_HK32F0 || SERIES_HK32F1 || SERIES_HK32F3)
            default n
            
        config BSP_USING_TIMER4
            bool "timer4"
            depends on (SERIES_HK32F1 || SERIES_HK32F3)
            default n
            
        config BSP_USING_TIMER5
            bool "timer5"
            depends on SERIES_HK32F3
            default n
            
        config BSP_USING_TIMER6
            bool "timer6"
            depends on (SERIES_HK32F0 || SERIES_HK32F1 || SERIES_HK32F3)
            default n
            
        config BSP_USING_TIMER7
            bool "timer7"
            depends on SERIES_HK32F3
            default n
            
        config BSP_USING_TIMER8
            bool "timer8"
            depends on SERIES_HK32F3
            default n
            
        config BSP_USING_TIMER14
            bool "timer14"
            depends on SERIES_HK32F0
            default n
            
        config BSP_USING_TIMER15
            bool "timer15"
            depends on SERIES_HK32F0
            default n
            
        config BSP_USING_TIMER16
            bool "timer16"
            depends on SERIES_HK32F0
            default n
            
        config BSP_USING_TIMER17
            bool "timer17"
            depends on SERIES_HK32F0
            default n
       
    endif
    
config BSP_USING_FLASH
    bool "on chip flash"
    select OS_USING_FAL
    default n
    
```

## drivers/hal/ingenic/Kconfig
```kconfig
config SOC_FAMILY_INGENIC
    bool
    default n

config SOC_INGENIC_X1000E
    bool
    select SOC_FAMILY_INGENIC
    default n

config SOC_INGENIC_T31X
    bool
    select SOC_FAMILY_INGENIC
    default n
	
source "$OS_ROOT/drivers/hal/ingenic/hal_x1000e/Kconfig"
source "$OS_ROOT/drivers/hal/ingenic/hal_t31x/Kconfig"
source "$OS_ROOT/drivers/hal/ingenic/drivers/Kconfig"
```

## drivers/hal/ingenic/drivers/Kconfig
```kconfig
config BSP_USING_GPIO
    bool "Enable GPIO"
    select OS_USING_PIN
    default y

menuconfig BSP_USING_USART
    bool "Enable UART"
    default y
    select OS_USING_SERIAL
    if BSP_USING_USART

        config BSP_USING_USART2
            bool "Enable UART2"
            default y
    endif

menu "Select I2C port"
    depends on OS_USING_I2C
    config BSP_USING_I2C0
        bool "Enable I2C0"
        default y

    config BSP_USING_I2C1
        bool "Enable I2C1"
        default n
endmenu

menu "Select SPI port"
    depends on OS_USING_SPI
    config BSP_USING_SPI0
        bool "Enable SPI0"
        default y
endmenu
```

## drivers/hal/mm32/Kconfig
```kconfig
config MANUFACTOR_MM32
    bool
    default n

config SERIES_MM32F013XX
    bool
    select MANUFACTOR_MM32
    select ARCH_ARM_CORTEX_M0
    default n

config SERIES_MM32F027XX
    bool
    select MANUFACTOR_MM32
    select ARCH_ARM_CORTEX_M0
    default n
    
config SERIES_MM32F103XX
    bool
    select MANUFACTOR_MM32
    select ARCH_ARM_CORTEX_M3
    default n

config SERIES_MM32F327XX
    bool
    select MANUFACTOR_MM32
    select ARCH_ARM_CORTEX_M3
    default n
    
config SERIES_MM32L3XX
    bool
    select MANUFACTOR_MM32
    select ARCH_ARM_CORTEX_M3
    default n

config SERIES_MM32SPIN0XX
    bool
    select MANUFACTOR_MM32
    select ARCH_ARM_CORTEX_M0
    default n

config SERIES_MM32SPIN2XX
    bool
    select MANUFACTOR_MM32
    select ARCH_ARM_CORTEX_M0
    default n

config SERIES_MM32W3XX
    bool
    select MANUFACTOR_MM32
    select SERIES_MM32L3XX
    select ARCH_ARM_CORTEX_M3
    default n

config OS_USING_SDIO_MM32
    bool "Using MM32 SD/MMC device drivers"
    default n
    
    if OS_USING_SDIO_MM32
        config OS_USING_SDIO_SD
        bool
            default n
        config OS_USING_SDIO_MMC
        bool
            default n
        config OS_USING_SDIO_SDIO
        bool
            default n
    endif
    
source "$OS_ROOT/drivers/hal/mm32/*/Kconfig"
```

## drivers/hal/mm32/drivers/Kconfig
```kconfig
config BSP_USING_GPIO
    bool "Enable GPIO"
    select OS_USING_PIN
    default y

config BSP_USING_LED
    bool "Enable LED"
    select BSP_USING_GPIO
    default y

menuconfig BSP_USING_UART
    bool "Enable UART"
    default y
    select OS_USING_SERIAL
    if BSP_USING_UART
        config BSP_USING_UART1
            bool "UART1 ENABLE"
            default n

        config BSP_USING_UART2
            bool "UART2 ENABLE"
            default n
    endif
    
config BSP_USING_ONCHIP_FLASH
    bool "Enable on-chip FLASH"
    default n

config BSP_USING_SPI
    bool "Enable SPI BUS"
    default n
    select OS_USING_SPI

menuconfig BSP_USING_I2C
    bool "Enable I2C BUS"
    default n
    select OS_USING_I2C
    select OS_USING_PIN
    if BSP_USING_I2C
        config BSP_USING_I2C1
            bool "I2C1 ENABLE"
            default n

        config BSP_USING_I2C2
            bool "I2C2 ENABLE"
            default n
    endif

menuconfig BSP_USING_TIM
    bool "Enable timer"
    default n
    select OS_USING_HWTIMER
    if BSP_USING_TIM
        config BSP_USING_TIM1
            bool "TIM1 ENABLE"
            default n

        config BSP_USING_TIM2
            bool "TIM2 ENABLE"
            default n
    endif
    
config BSP_USING_PWM
    bool "Enable pwm"
    default n
    select OS_USING_PWM

menuconfig BSP_USING_ADC
    bool "Enable ADC"
    default n
    select OS_USING_ADC
    if BSP_USING_ADC
        config BSP_USING_ADC1
            bool "ADC1 ENABLE"
            default n
    endif
    
menuconfig BSP_USING_ONCHIP_RTC
    bool "Enable RTC"
    select OS_USING_RTC
    default n
    if BSP_USING_ONCHIP_RTC
        choice
            prompt "Select clock source"
            default BSP_RTC_USING_LSE

            config BSP_RTC_USING_LSE
                bool "RTC USING LSE"

            config BSP_RTC_USING_LSI
                bool "RTC USING LSI"
        endchoice
    endif
    

config BSP_USING_WDT
    bool "Enable Watchdog Timer"
    select OS_USING_WDT
    default n
    

menuconfig BSP_USING_SDIO
    bool "Enable SDIO"
    select OS_USING_BLOCK
    select OS_USING_SDIO_MM32
    default n
    if BSP_USING_SDIO
        config BSP_USING_SDIO_SD
            bool "mm32 sdio use in sd"
            select OS_USING_SDIO_SD
            default n
        config BSP_USING_SDIO_MMC
            bool "mm32 sdio use in mmc"
            select OS_USING_SDIO_MMC
            default n
        config BSP_USING_SDIO_SDIO
            bool "mm32 sdio use in sdio"
            select OS_USING_SDIO_SDIO
            default n
    endif
    
```

## drivers/hal/nrf/Kconfig
```kconfig
config SOC_FAMILY_NRF52
    bool
    default n

#source "$OS_ROOT/drivers/hal/nrf/NRF5_HAL/components/libraries/Kconfig"
#source "$OS_ROOT/drivers/hal/nrf/NRF5_HAL/integration/nrfx/legacy/Kconfig"
#source "$OS_ROOT/drivers/hal/nrf/NRF5_HAL/modules/nrfx/drivers/src/Kconfig"
#source "$OS_ROOT/drivers/hal/nrf/NRF5_HAL/modules/nrfx/hal/Kconfig"
source "$OS_ROOT/drivers/hal/nrf/NRF5_HAL/Kconfig"

if SOC_FAMILY_NRF52
source "$OS_ROOT/drivers/hal/nrf/drivers/Kconfig"
endif
```
