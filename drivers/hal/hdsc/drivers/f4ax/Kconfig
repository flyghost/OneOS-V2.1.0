## drivers/hal/nrf/NRF5_HAL/Kconfig
```kconfig
config SOC_SERIES_NRF52
    bool
    select ARCH_ARM_CORTEX_M4
    default n



config SOC_NRF52840
    bool
    select SOC_FAMILY_NRF52
    select SOC_SERIES_NRF52
    default n
	
config SOC_NRF52832
    bool
    select SOC_FAMILY_NRF52
    select SOC_SERIES_NRF52
    default n


config  BSP_USING_SOFTDEVICE
    bool "Enable Nordic softdevice"
    default n
```

## drivers/hal/nrf/drivers/Kconfig
```kconfig
config BSP_USING_PIN
    bool "pin"
    default n
    
config BSP_USING_UART
    bool "uart"
    default n
    
    if BSP_USING_UART
        config BSP_USING_UART0
            bool "uart0"
            default n
            
        if SOC_NRF52840
            config BSP_USING_UART1
                bool "uart1"
                default n
        endif
    endif
    
    
config BSP_USING_I2C
    bool "i2c"
    default n
    
    if BSP_USING_I2C
        config BSP_USING_I2C0
            bool "i2c0"
            default n
        config BSP_USING_I2C1
            bool "i2c1"
            default n
    endif

config BSP_USING_ADC
    bool "adc"
    default n   
    
config BSP_USING_PWM
    bool "pwm"
    default n   
    
    if BSP_USING_PWM
        config BSP_USING_PWM0
            bool "pwm0"
            default n
        config BSP_USING_PWM1
            bool "pwm1"
            default n
        config BSP_USING_PWM2
            bool "pwm2"
            default n
    endif

config BSP_USING_TIMER
    bool "timer"
    default n
    if BSP_USING_TIMER
        config BSP_USING_TIMER1
            bool "timer1"
            default n
        config BSP_USING_TIMER2
            bool "timer2"
            default n
        config BSP_USING_TIMER3
            bool "timer3"
            default n
    endif   
    
config BSP_USING_FLASH
    bool "on chip flash"
    default n   
    
config BSP_USING_RTC
    bool "rtc"
    default n   


config BSP_USING_SPI
    bool "spi"
    default n   
    
    if BSP_USING_SPI
        config BSP_USING_SPI0
            bool "spi0"
            default n
        config BSP_USING_SPI1
            bool "spi1"
            default n
    endif
```

## drivers/hal/nxp/Kconfig
```kconfig
config ARCH_ARM_ASM_GNUC
    bool
    default n
    
config SERIES_NXP
    bool
    default n
    
config SERIES_NXP_LPC5500
    bool
    select SERIES_NXP
    select ARCH_ARM_CORTEX_M33
    select ARCH_ARM_ASM_GNUC
    default n

config SERIES_NXP_IMXRT10XX
    bool
    select SERIES_NXP
    default n

config SERIES_NXP_KK
    bool
    select SERIES_NXP
    default n

source "$OS_ROOT/drivers/hal/nxp/*/Kconfig"
```

## drivers/hal/nxp/imxrt10xx/sdk/Kconfig
```kconfig
config BSP_SDIO_DEVICE_SD
    bool
    default n
config BSP_SDIO_DEVICE_MMC
    bool
    default n
config BSP_SDIO_DEVICE_SDIO
    bool
    default n
    
menuconfig BSP_USING_SDIO
    bool "Using NXP SD/MMC device drivers"
    default n

    if BSP_USING_SDIO
        choice
            prompt "nxp sdio transfer mode"
                default BSP_USDHC_MODE_NONBLOCKING
                
                config BSP_USDHC_MODE_BLOCKING
                    bool "nxp usdhc blocking mode"

                config BSP_USDHC_MODE_NONBLOCKING
                    bool "nxp sdio nonblocking mode"
        endchoice
        
        menuconfig BSP_USDHC1_ENABLE
            bool "enable usdhc1"
            default n
            if BSP_USDHC1_ENABLE
                choice
                    prompt "choose usdhc mode"
                        default BSP_USDHC1_MODE_SD

                        config BSP_USDHC1_MODE_SD
                            bool "sd card mode"
                            select BSP_SDIO_DEVICE_SD

                        config BSP_USDHC1_MODE_MMC
                            bool "mmc mode"
                            select BSP_SDIO_DEVICE_MMC

                        config BSP_USDHC1_MODE_SDIO
                            bool "sdio mode"
                            select BSP_SDIO_DEVICE_SDIO
                endchoice
                
                config BSP_USDHC1_PWR_PIN
                    int "usdhc power pin"
                    default 1
                if BSP_USDHC1_PWR_PIN >= 0
                    config BSP_USDHC1_PWR_PIN_LEVEL
                        int "usdhc power pin level to turn on"
                        default 1
                endif
                    
                config BSP_USDHC1_IRQ_PIN
                    int "usdhc irq pin"
                    default 2
                
                if BSP_USDHC1_IRQ_PIN >= 0
                    config BSP_USDHC1_IRQ_PIN_LEVEL
                        int "usdhc irq pin level to detect"
                        default 0
                endif
            endif
        
        menuconfig BSP_USDHC2_ENABLE
            bool "enable usdhc2"
            default n
            if BSP_USDHC2_ENABLE
                choice
                    prompt "choose usdhc mode"
                    default BSP_USDHC2_MODE_SD
                    help
                        Select the eth hardware

                    config BSP_USDHC2_MODE_SD
                        bool "sd card mode"
                        select BSP_SDIO_DEVICE_SD

                    config BSP_USDHC2_MODE_MMC
                        bool "mmc mode"
                        select BSP_SDIO_DEVICE_MMC

                    config BSP_USDHC2_MODE_SDIO
                        bool "sdio mode"
                        select BSP_SDIO_DEVICE_SDIO
                endchoice
                
                config BSP_USDHC2_PWR_PIN
                    int "usdhc power pin"
                    default 1
                if BSP_USDHC2_PWR_PIN >= 0
                    config BSP_USDHC2_PWR_PIN_LEVEL
                        int "usdhc power pin level to turn on"
                        default 1
                endif
                    
                config BSP_USDHC2_IRQ_PIN
                    int "usdhc irq pin"
                    default 2
                
                if BSP_USDHC2_IRQ_PIN >= 0
                    config BSP_USDHC2_IRQ_PIN_LEVEL
                        int "usdhc irq pin level to detect"
                        default 0
                endif
            endif
    endif

config BSP_USING_KSZ8081RNB
bool 
default n
    
menuconfig BSP_USING_ETH
    bool "Enable Ethernet"
    select NET_USING_LWIP
    default n

    if BSP_USING_ETH
        menuconfig BSP_USING_ETH1
            bool "Ethernet1 device"
            default y
            
            if BSP_USING_ETH1
                choice
                    prompt "choose eth hardware"
                    default ETH1_USING_KSZ8081RNB
                    help
                        Select the eth hardware

                    config ETH1_USING_KSZ8081RNB
                        bool "ksz8081rnb"
                        select BSP_USING_KSZ8081RNB
                endchoice
                
                config ETH1_RESET_PIN
                    int "reset pin"
                    default 9
                    
                config ETH1_INT_PIN
                    int "int pin"
                    default 10
                
                config ETH1_RXBUFF_NUM
                    int "rx buffer number"
                    default 4
                    
                config ETH1_TXBUFF_NUM
                    int "tx buffer number"
                    default 4
                    
                config ETH1_PHY_ADDR
                    int "eth chip phy address"
                    default 1
            endif
        
        menuconfig BSP_USING_ETH2
            bool "Ethernet2 device"
            default n
            
            if BSP_USING_ETH2
                choice
                    prompt "choose eth hardware"
                    default ETH2_USING_KSZ8081RNB
                    help
                        Select the eth hardware

                    config ETH2_USING_KSZ8081RNB
                        bool "ksz8081rnb"
                        select BSP_USING_KSZ8081RNB
                endchoice
                
                config ETH2_RESET_PIN
                    int "reset pin"
                    default 9
                    
                config ETH2_INT_PIN
                    int "int pin"
                    default 10
                    
                config ETH2_RXBUFF_NUM
                    int "rx buffer number"
                    default 4
                    
                config ETH2_TXBUFF_NUM
                    int "tx buffer number"
                    default 4
                    
                config ETH2_PHY_ADDR
                    int "eth chip phy address"
                    default 2
            endif
            
    endif
    
if OS_USING_PWM
    config BSP_PWM_MODE
        int "config pwm mode"
        default 0
        comment "0--CenterAligned;1--SignedCenterAligned;2--EdgeAligned;3--SignedEdgeAligned"
endif
    
source "$OS_ROOT/drivers/hal/nxp/imxrt10xx/sdk/*/Kconfig"
```

## drivers/hal/nxp/imxrt10xx/sdk/devices/Kconfig
```kconfig
config SOC_IMXRT1052
    bool
    select SERIES_NXP_IMXRT10XX
    default n
    
config SOC_IMXRT1061
    bool
    select SERIES_NXP_IMXRT10XX
    default n
    
config SOC_IMXRT1064
    bool
    select SERIES_NXP_IMXRT10XX
    default n
    
menuconfig BSP_USING_EXTERN_STORAGE
    bool "condfig board extern storage"
    default y
    
    if BSP_USING_EXTERN_STORAGE
        menuconfig BSP_USING_NOR_FLASH
            bool "nor flash"
            default y
            
            if BSP_USING_NOR_FLASH
                config BSP_NOR_FLASH_SIZE
                    hex "flash size"
                    default 0x4000000
                    
                if SOC_IMXRT1052
                    config BSP_NOR_FLASH_PAGE_SIZE
                        hex "flash page size"
                        default 0x100
                        
                    config BSP_NOR_FLASH_SECTOR_SIZE
                        hex "flash sector size"
                        default 0x1000
                        
                    config BSP_NOR_FLASH_BLOCK_SIZE
                        hex "flash block size"
                        default 0x10000
                endif
            endif
            
        menuconfig BSP_USING_NAND_FLASH
            bool "nand flash in semc"
            default n
            
            if BSP_USING_NAND_FLASH
                config BSP_NAND_FLASH_SIZE
                    hex "flash size"
                    default 0x4000000
                    
                if SOC_IMXRT1052
                    config BSP_NAND_FLASH_PAGE_SIZE
                        hex "flash page size"
                        default 0x100
                        
                    config BSP_NAND_FLASH_SECTOR_SIZE
                        hex "flash sector size"
                        default 0x1000
                        
                    config BSP_NAND_FLASH_BLOCK_SIZE
                        hex "flash block size"
                        default 0x10000
                endif
            endif
    
        choice 
            prompt "select boot up storage"
                default BSP_BOOTUP_NOR_FLASH

                config BSP_BOOTUP_NOR_FLASH
                    bool "boot up for nor flash"

                config BSP_BOOTUP_NAND_FLASH
                    bool "boot up for nand flash use semc"
        endchoice
    endif
    
```

## drivers/hal/nxp/kk/k0x_2x/sdk/devices/Kconfig
```kconfig
config SOC_KK02_100
    bool
    select SERIES_NXP_KK0X_2X
    default n
    
    
```

## drivers/hal/nxp/lpc5500/Kconfig
```kconfig
config SERIES_NXP_LPC55S6X
    bool
    select SERIES_NXP_LPC5500
    default n

config SERIES_NXP_LPC550X_S0X
    bool
    select SERIES_NXP_LPC5500
    default n

config SERIES_NXP_LPC551X_S1X
    bool
    select SERIES_NXP_LPC5500
    default n
    
config SERIES_NXP_LPC552X_S2X
    bool
    select SERIES_NXP_LPC5500
    default n
    
config SERIES_NXP_LPC553X_S3X
    bool
    select SERIES_NXP_LPC5500
    default n
    
source "$OS_ROOT/drivers/hal/nxp/lpc5500/*/Kconfig"
```

## drivers/hal/nxp/lpc5500/lpc550x_s0x/sdk/devices/Kconfig
```kconfig
config SOC_LPC5502
    bool
    select SERIES_NXP_LPC550X_S0X
    default n

config SOC_LPC5504
    bool
    select SERIES_NXP_LPC550X_S0X
    default n
    
config SOC_LPC5506
    bool
    select SERIES_NXP_LPC550X_S0X
    default n
    
config SOC_LPC55S02
    bool
    select SERIES_NXP_LPC550X_S0X
    default n
    
config SOC_LPC55S04
    bool
    select SERIES_NXP_LPC550X_S0X
    default n
    
config SOC_LPC55S06
    bool
    select SERIES_NXP_LPC550X_S0X
    default n
    
```
