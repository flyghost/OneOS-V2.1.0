## drivers/hal/nxp/lpc5500/lpc552x_s2x/sdk/devices/Kconfig
```kconfig
config SOC_LPC5512
    bool
    select SERIES_NXP_LPC551X_S1X
    default n

config SOC_LPC5514
    bool
    select SERIES_NXP_LPC551X_S1X
    default n
    
config SOC_LPC5516
    bool
    select SERIES_NXP_LPC551X_S1X
    default n
    
config SOC_LPC55S14
    bool
    select SERIES_NXP_LPC551X_S1X
    default n
    
config SOC_LPC55S16
    bool
    select SERIES_NXP_LPC551X_S1X
    default n
    
```

## drivers/hal/nxp/lpc5500/lpc55s6x/sdk/Kconfig
```kconfig
if OS_USING_USB_DEVICE
    config BSP_USING_USB
    bool "usb bus config"
    default y
    if BSP_USING_USB
        choice
            prompt "Select usdhc speed"
            default BSP_USB_DEVICE_HS

            config BSP_USB_DEVICE_HS
                bool "Select usdhc high speed"

            config BSP_USB_DEVICE_FS
                bool "Select usdhc fullspeed"
        endchoice
    endif
endif

source "$OS_ROOT/drivers/hal/nxp/lpc5500/lpc55s6x/sdk/*/Kconfig"
```

## drivers/hal/nxp/lpc5500/lpc55s6x/sdk/devices/Kconfig
```kconfig
config SOC_LPC55S69
    bool
    select SERIES_NXP_LPC55S6X
    default n

config SOC_LPC55S66
    bool
    select SERIES_NXP_LPC55S6X
    default n
    
```

## drivers/hal/st/Kconfig
```kconfig
config MANUFACTOR_STM32
    bool
    default n

source "$OS_ROOT/drivers/hal/st/*/Kconfig"

comment "Configure base hal in STM32CubeMX"
```

## drivers/hal/st/STM32F0xx_HAL/Kconfig
```kconfig
config SERIES_STM32F0
    bool
    select MANUFACTOR_STM32
    select ARCH_ARM_CORTEX_M0
    default n

config SOC_STM32F0XXX
    bool
    select SERIES_STM32F0
    default n

config SOC_STM32F030xC
    bool
    select SERIES_STM32F0
    default n

config SOC_STM32F091xC
    bool
    select MANUFACTOR_STM32
    select SERIES_STM32F0
    default n

config SOC_STM32F030xx
    bool
    select SERIES_STM32F0
    default n

config SOC_STM32F070xx
    bool
    select SERIES_STM32F0
    default n

config SOC_STM32F071xx
    bool
    select SERIES_STM32F0
    default n

config SOC_STM32F072xx
    bool
    select SERIES_STM32F0
    default n

config SOC_STM32F078xx
    bool
    select SERIES_STM32F0
    default n

config SOC_STM32F091xx
    bool
    select SERIES_STM32F0
    default n

config SOC_STM32F098xx
    bool
    select SERIES_STM32F0
    default n
```

## drivers/hal/st/STM32F1xx_HAL/Kconfig
```kconfig
config SERIES_STM32F1
    bool
    select ARCH_ARM_CORTEX_M3
    default n

config SOC_STM32F1XX
    bool
    select MANUFACTOR_STM32
    select SERIES_STM32F1
    default n

config SOC_STM32F103xB
    bool
    select MANUFACTOR_STM32
    select SERIES_STM32F1
    default n


config SOC_STM32F103xE
    bool
    select MANUFACTOR_STM32
    select SERIES_STM32F1
    default n
```

## drivers/hal/st/STM32F3xx_HAL/Kconfig
```kconfig
config SERIES_STM32F3
    bool
    select ARCH_ARM_CORTEX_M4
    default n

config SOC_STM32F3XX
    bool
    select MANUFACTOR_STM32
    select SERIES_STM32F3
    default n
```

## drivers/hal/st/STM32F4xx_HAL/Kconfig
```kconfig
config SERIES_STM32F4
    bool
    select ARCH_ARM_CORTEX_M4
    default n

config SOC_STM32F4XX
    bool
    select MANUFACTOR_STM32
    select SERIES_STM32F4
    default n

config SOC_STM32F429xx
    bool
    select MANUFACTOR_STM32
    select SERIES_STM32F4
    default n

config SOC_STM32F407xx
    bool
    select MANUFACTOR_STM32
    select SERIES_STM32F4
    default n

config SOC_STM32F405xx
    bool
    select MANUFACTOR_STM32
    select SERIES_STM32F4
    default n

config SOC_STM32F469xx
    bool
    select MANUFACTOR_STM32
    select SERIES_STM32F4
    default n
    
config SOC_STM32F423xx
    bool
    select MANUFACTOR_STM32
    select SERIES_STM32F4
    default n
    
config SOC_STM32F427xx
    bool
    select MANUFACTOR_STM32
    select SERIES_STM32F4
    default n
    
config SOC_STM32F479xx
    bool
    select MANUFACTOR_STM32
    select SERIES_STM32F4
    default n
```

## drivers/hal/st/STM32F7xx_HAL/Kconfig
```kconfig
config SERIES_STM32F7
    bool
    select ARCH_ARM_CORTEX_M7
    default n

config SOC_STM32F722xx
    bool
    select MANUFACTOR_STM32
    select SERIES_STM32F7
    default n

config SOC_STM32F7XX
    bool
    select MANUFACTOR_STM32
    select SERIES_STM32F7
    default n

config SOC_STM32F746xx
    bool
    select MANUFACTOR_STM32
    select SERIES_STM32F7
    default n

config SOC_STM32F767xx
    bool
    select MANUFACTOR_STM32
    select SERIES_STM32F7
    default n

config SOC_STM32F769xx
    bool
    select MANUFACTOR_STM32
    select SERIES_STM32F7
    default n
```

## drivers/hal/st/STM32G0xx_HAL/Kconfig
```kconfig
config SERIES_STM32G0
    bool
    select ARCH_ARM_CORTEX_M0_PLUS
    default n

config SOC_STM32G0XX
    bool
    select MANUFACTOR_STM32
    select SERIES_STM32G0
    default n

config SOC_STM32G071RB
    bool
    select MANUFACTOR_STM32
    select SERIES_STM32G0
    default n
```

## drivers/hal/st/STM32G4xx_HAL/Kconfig
```kconfig
config SERIES_STM32G4
    bool
    select ARCH_ARM_CORTEX_M4
    default n

config SOC_STM32G4XX
    bool
    select MANUFACTOR_STM32
    select SERIES_STM32G4
    default n
```

## drivers/hal/st/STM32H7xx_HAL/Kconfig
```kconfig
config SERIES_STM32H7
    bool
    default n

config SERIES_STM32H7_M4
    bool
    select SERIES_STM32H7
    select ARCH_ARM_CORTEX_M4
    default n

config SERIES_STM32H7_M7
    bool
    select SERIES_STM32H7
    select ARCH_ARM_CORTEX_M7
    default n

config SOC_STM32H742xx
    bool
    select MANUFACTOR_STM32
    select SERIES_STM32H7_M7
    default n
    
config SOC_STM32H743xx
    bool
    select MANUFACTOR_STM32
    select SERIES_STM32H7_M7
    default n

config SOC_STM32H745xx_CM4
    bool
    select MANUFACTOR_STM32
    select SERIES_STM32H7_M4
    default n
 
config SOC_STM32H745xx_CM7
    bool
    select MANUFACTOR_STM32
    select SERIES_STM32H7_M7
    default n
    
config SOC_STM32H747xx_CM7
    bool
    select MANUFACTOR_STM32
    select SERIES_STM32H7_M7
    default n

config SOC_STM32H747xx_CM4
    bool
    select MANUFACTOR_STM32
    select SERIES_STM32H7_M4
    default n

config SOC_STM32H750xx
    bool
    select MANUFACTOR_STM32
    select SERIES_STM32H7_M7
    default n
    
config SOC_STM32H753xx
    bool
    select MANUFACTOR_STM32
    select SERIES_STM32H7_M7
    default n
  
config SOC_STM32H755xx_CM4
    bool
    select MANUFACTOR_STM32
    select SERIES_STM32H7_M4
    default n  
 
config SOC_STM32H755xx_CM7
    bool
    select MANUFACTOR_STM32
    select SERIES_STM32H7_M7
    default n 

config SOC_STM32H757xx_CM4
    bool
    select MANUFACTOR_STM32
    select SERIES_STM32H7_M4
    default n 

config SOC_STM32H757xx_CM7
    bool
    select MANUFACTOR_STM32
    select SERIES_STM32H7_M7
    default n 
```

## drivers/hal/st/STM32L0xx_HAL/Kconfig
```kconfig
config SERIES_STM32L0
    bool
    select ARCH_ARM_CORTEX_M0
    default n

config SOC_STM32L0XX
    bool
    select MANUFACTOR_STM32
    select SERIES_STM32L0
    default n

config SOC_STM32L053R8
    bool
    select MANUFACTOR_STM32
    select SERIES_STM32L0
    default n
	
config SOC_STM32L051XX
    bool
	select MANUFACTOR_STM32
	select SERIES_STM32L0
    default n
    
config SOC_STM32L010xx
    bool
    select MANUFACTOR_STM32
    select SERIES_STM32L0
    default n
    
config SOC_STM32L071xx
    bool
    select MANUFACTOR_STM32
    select SERIES_STM32L0
    default n
    
config SOC_STM32L072xx
    bool
    select MANUFACTOR_STM32
    select SERIES_STM32L0
    default n
    
config SOC_STM32L073xx
    bool
    select MANUFACTOR_STM32
    select SERIES_STM32L0
    default n
   
config SOC_STM32L081xx
    bool
    select MANUFACTOR_STM32
    select SERIES_STM32L0
    default n
    
config SOC_STM32L082xx
    bool
    select MANUFACTOR_STM32
    select SERIES_STM32L0
    default n
    
config SOC_STM32L083xx
    bool
    select MANUFACTOR_STM32
    select SERIES_STM32L0
    default n   
    
    
```

## drivers/hal/st/STM32L1xx_HAL/Kconfig
```kconfig
config SERIES_STM32L1
    bool
    select ARCH_ARM_CORTEX_M3
    default n

config SOC_STM32L1XX
    bool
    select MANUFACTOR_STM32
    select SERIES_STM32L1
    default n

config SOC_STM32L152RE
    bool
    select MANUFACTOR_STM32
    select SERIES_STM32L1
    default n
```

## drivers/hal/st/STM32L4xx_HAL/Kconfig
```kconfig
config SERIES_STM32L4
    bool
    select ARCH_ARM_CORTEX_M4
    default n

config SOC_STM32L475VE
    bool
    select MANUFACTOR_STM32
    select SERIES_STM32L4
    default n

config SOC_STM32L475VG
    bool
    select MANUFACTOR_STM32
    select SERIES_STM32L4
    default n

config SOC_STM32L496VG
    bool
    select MANUFACTOR_STM32
    select SERIES_STM32L4
    default n

config SOC_STM32L4R5ZI
    bool
    select MANUFACTOR_STM32
    select SERIES_STM32L4
    default n

config SOC_STM32L4R5xx
    bool
    select MANUFACTOR_STM32
    select SERIES_STM32L4
    default n

config SOC_STM32L4R9AI
    bool
    select MANUFACTOR_STM32
    select SERIES_STM32L4
    default n

config SOC_STM32L4R9xx
    bool
    select MANUFACTOR_STM32
    select SERIES_STM32L4
    default n

config SOC_STM32L452xx
    bool
    select MANUFACTOR_STM32
    select SERIES_STM32L4
    default n

config SOC_STM32L433RC
    bool
    select MANUFACTOR_STM32
    select SERIES_STM32L4
    default n

config SOC_STM32L432KC
    bool
    select MANUFACTOR_STM32
    select SERIES_STM32L4
    default n

config SOC_STM32L422xx
    bool
    select MANUFACTOR_STM32
    select SERIES_STM32L4
    default n

config SOC_STM32L443xx
    bool
    select MANUFACTOR_STM32
    select SERIES_STM32L4
    default n

config SOC_STM32L462xx
    bool
    select MANUFACTOR_STM32
    select SERIES_STM32L4
    default n
```

## drivers/hal/st/STM32L5xx_HAL/Kconfig
```kconfig
config SERIES_STM32L5
    bool
    default n

config SOC_STM32L562E_DK
    bool
    select MANUFACTOR_STM32
    select SERIES_STM32L5
    select ARCH_ARM_CORTEX_M33
    default n

config SOC_STM32L562E_DK_TZ
    bool
    select MANUFACTOR_STM32
    select SERIES_STM32L5
    select ARCH_ARM_CORTEX_M33_TZ
    default n

config SOC_STM32L562xx
    bool
    select MANUFACTOR_STM32
    select SERIES_STM32L5
    select ARCH_ARM_CORTEX_M33
    default n
```

## drivers/hal/st/STM32MP1xx_HAL/Kconfig
```kconfig
config SERIES_STM32MP1
    bool
    default n

config SERIES_STM32MP1_M4
    bool
    select SERIES_STM32MP1
    select ARCH_ARM_CORTEX_M4
    default n

config SERIES_STM32MP1_A7
    bool
    select SERIES_STM32MP1
    select ARCH_ARM_CORTEX_A7
    default n

config SOC_STM32MP157_CA7
    bool
    select MANUFACTOR_STM32
    select SERIES_STM32MP1_A7
    default n

config SOC_STM32MP157_CM4
    bool
    select MANUFACTOR_STM32
    select SERIES_STM32MP1_M4
    default n
```

## drivers/hal/st/drivers/Kconfig
```kconfig
menuconfig BSP_USING_ETH
    bool "Enable Ethernet"
    select NET_USING_LWIP
    default n
    if BSP_USING_ETH
        comment "config eth hw"
        config ETH_RESET_PIN
            int "ETH reset pin number(default:phy_reset pin -->51)"
            default 51
            
        config ETH_RESET_PIN_ACTIVE_HIGH
            bool "ETH reset pin active level is high"
            default n
        
        choice
            prompt "choose eth hardware"
            default PHY_USING_LAN8720A
            help
                Select the eth hardware

            config PHY_USING_LAN8720A
                bool "LAN8720A"

            config PHY_USING_DM9161CEP
                bool "DM9161CEP"

            config PHY_USING_DP83848C
                bool "DP83848C"
        endchoice
    endif

config DEFAULT_SYSTEM_CLOCK_CONFIG
    bool "default system clock config"
    default n
        
```
