## drivers/hwcrypto/Kconfig
```kconfig
menu "HwCrypto"
menuconfig OS_USING_HWCRYPTO
        bool "Using hardware crypto drivers"
        default n

    if OS_USING_HWCRYPTO
        config OS_HWCRYPTO_DEFAULT_NAME
            string "Hardware crypto device name"
            default "hwcryto"

        config OS_HWCRYPTO_IV_MAX_SIZE
            int "IV max size"
            default "16"

        config OS_HWCRYPTO_KEYBIT_MAX_SIZE
            int "Key max bit length"
            default 256

        config OS_HWCRYPTO_USING_GCM
            bool "Using hardware GCM"
            default n

        config OS_HWCRYPTO_USING_AES
            bool "Using hardware AES"
            default n

        if OS_HWCRYPTO_USING_AES
            config OS_HWCRYPTO_USING_AES_ECB
                bool "Using hardware AES ECB mode"
                default y

            config OS_HWCRYPTO_USING_AES_CBC
                bool "Using hardware AES CBC mode"
                default n

            config OS_HWCRYPTO_USING_AES_CFB
                bool "Using hardware AES CFB mode"
                default n

            config OS_HWCRYPTO_USING_AES_CTR
                bool "Using hardware AES CTR mode"
                default n

            config OS_HWCRYPTO_USING_AES_OFB
                bool "Using hardware AES OFB mode"
                default n
        endif

        config OS_HWCRYPTO_USING_DES
            bool "Using hardware DES"
            default n

        if OS_HWCRYPTO_USING_DES
            config OS_HWCRYPTO_USING_DES_ECB
                bool "Using hardware DES ECB mode"
                default y

            config OS_HWCRYPTO_USING_DES_CBC
                bool "Using hardware DES CBC mode"
                default n
        endif

        config OS_HWCRYPTO_USING_3DES
            bool "Using hardware 3DES"
            default n

        if OS_HWCRYPTO_USING_3DES
            config OS_HWCRYPTO_USING_3DES_ECB
                bool "Using hardware 3DES ECB mode"
                default y

            config OS_HWCRYPTO_USING_3DES_CBC
                bool "Using hardware 3DES CBC mode"
                default n
        endif

        config OS_HWCRYPTO_USING_RC4
            bool "Using hardware RC4"
            default n

        config OS_HWCRYPTO_USING_MD5
            bool "Using hardware MD5"
            default n

        config OS_HWCRYPTO_USING_SHA1
            bool "Using hardware SHA1"
            default n

        config OS_HWCRYPTO_USING_SHA2
            bool "Using hardware SHA2"
            default n

        if OS_HWCRYPTO_USING_SHA2
            config OS_HWCRYPTO_USING_SHA2_224
                bool "Using hardware SHA2_224 mode"
                default n

            config OS_HWCRYPTO_USING_SHA2_256
                bool "Using hardware SHA2_256 mode"
                default y

            config OS_HWCRYPTO_USING_SHA2_384
                bool "Using hardware SHA2_384 mode"
                default n

            config OS_HWCRYPTO_USING_SHA2_512
                bool "Using hardware SHA2_512 mode"
                default n
        endif

        config OS_HWCRYPTO_USING_RNG
            bool "Using hardware RNG"
            default n

        config OS_HWCRYPTO_USING_CRC
            bool "Using hardware CRC"
            default n

        if OS_HWCRYPTO_USING_CRC
            config OS_HWCRYPTO_USING_CRC_07
                bool "Using hardware CRC-8 0x07 polynomial"
                default n

            config OS_HWCRYPTO_USING_CRC_8005
                bool "Using hardware CRC-16 0x8005 polynomial"
                default n

            config OS_HWCRYPTO_USING_CRC_1021
                bool "Using hardware CRC-16 0x1021 polynomial"
                default n

            config OS_HWCRYPTO_USING_CRC_3D65
                bool "Using hardware CRC-16 0x3D65 polynomial"
                default n

            config OS_HWCRYPTO_USING_CRC_04C11DB7
                bool "Using hardware CRC-32 0x04C11DB7 polynomial"
                default y
        endif

        config OS_HWCRYPTO_USING_BIGNUM
            bool "Using hardware bignum"
            default n

        if OS_HWCRYPTO_USING_BIGNUM
            config OS_HWCRYPTO_USING_BIGNUM_EXPTMOD
                bool "Using hardware bignum expt_mod operation"
                default y

            config OS_HWCRYPTO_USING_BIGNUM_MULMOD
                bool "Using hardware bignum mul_mod operation"
                default y

            config OS_HWCRYPTO_USING_BIGNUM_MUL
                bool "Using hardware bignum mul operation"
                default n

            config OS_HWCRYPTO_USING_BIGNUM_ADD
                bool "Using hardware bignum add operation"
                default n

            config OS_HWCRYPTO_USING_BIGNUM_SUB
                bool "Using hardware bignum sub operation"
                default n
        endif
    endif
endmenu
```

## drivers/i2c/Kconfig
```kconfig
menu "I2C"
    config OS_USING_I2C
        bool "Using I2C device drivers"
        default n

    config OS_USING_I2C_BITOPS
        depends on OS_USING_I2C
        select OS_USING_CLOCKSOURCE
        bool "Use GPIO to simulate I2C"
        default n

        if OS_USING_I2C_BITOPS
            config SOFT_I2C_BUS_DELAY_US
                int "simulate I2C bus delay(us)"
                default 10
        
            menuconfig BSP_USING_SOFT_I2C1
                bool "Enable I2C1 BUS (software simulation)"
                default n
                if BSP_USING_SOFT_I2C1
                    config BSP_SOFT_I2C1_SCL_PIN
                        int "i2c1 scl pin number"
                        default 32
                    config BSP_SOFT_I2C1_SDA_PIN
                        int "I2C1 sda pin number"
                        default 33
                endif

            menuconfig BSP_USING_SOFT_I2C2
                bool "Enable I2C2 BUS (software simulation)"
                default n
                if BSP_USING_SOFT_I2C2
                    config BSP_SOFT_I2C2_SCL_PIN
                        int "i2c2 scl pin number"
                        default 32
                    config BSP_SOFT_I2C2_SDA_PIN
                        int "I2C2 sda pin number"
                        default 33
                endif

            menuconfig BSP_USING_SOFT_I2C3
                bool "Enable I2C3 BUS (software simulation)"
                default n
                if BSP_USING_SOFT_I2C3
                    config BSP_SOFT_I2C3_SCL_PIN
                        int "i2c3 scl pin number"
                        default 32
                    config BSP_SOFT_I2C3_SDA_PIN
                        int "I2C3 sda pin number"
                        default 33
                endif

            menuconfig BSP_USING_SOFT_I2C4
                bool "Enable I2C4 BUS (software simulation)"
                default n
                if BSP_USING_SOFT_I2C4
                    config BSP_SOFT_I2C4_SCL_PIN
                        int "i2c4 scl pin number"
                        default 54
                    config BSP_SOFT_I2C4_SDA_PIN
                        int "I2C4 sda pin number"
                        default 33
                endif
        endif
        
    config BSP_USING_I2C_AT24CXX
        depends on OS_USING_I2C
        bool "Use at24cxx eeprom"
        default n
        
        if BSP_USING_I2C_AT24CXX
            config BSP_AT24CXX_I2C_BUS_NAME
                string "at24xx i2c bus name"
                default "i2c1"

            config BSP_AT24CXX_I2C_ADDR
                hex "at24xx i2c addr(7bit)"
                default 0x50
        endif
        
endmenu
```

## drivers/infrared/Kconfig
```kconfig
menu "Infrared"
    config OS_USING_INFRARED
        bool "Using infrared device drivers"
        select OS_USING_TIMER_DRIVER
        select OS_USING_CLOCKSOURCE
        select OS_USING_TIMER
        select OS_TIMER_SORT
        default n

    if OS_USING_INFRARED    
        menuconfig BSP_USING_RMT_CTL_ATK_TX
            bool "Enable atk remote control tx"
            default n

            if BSP_USING_RMT_CTL_ATK_TX
                config BSP_USING_RMT_CTL_ATK_TX_PIN
                    int "tx pin"
                    default 16
            endif
            
        menuconfig BSP_USING_RMT_CTL_ATK_RX
            bool "Enable atk remote control rx"
            default n

            if BSP_USING_RMT_CTL_ATK_RX
                config BSP_USING_RMT_CTL_ATK_RX_PIN
                    int "rx pin"
                    default 17
            endif
    endif

endmenu
```

## drivers/lpmgr/Kconfig
```kconfig
menu "LPMGR"
    if OS_USING_HRTIMER_FOR_SYSTICK
        comment "please close <Using high-resolution timer for systick> [Drivers --> Timer]"
    endif
    
    if !OS_USING_HRTIMER_FOR_SYSTICK
        config OS_USING_LPMGR
        bool "Enable low power manager drivers"
        select OS_TIMER_SORT
        default n
        
        if OS_USING_LPMGR
            config LPMGR_TIMER_DEVICE_NAME
                string "lpmgr timer device name"
                default "lptim1"
                
            config BSP_USING_MINSLEEP_MS
                int "lpmgr min sleep time(ms)"
                range 10 10000
                default 20
                    
            choice
                prompt "Low power options"
                default OS_USING_TICKLESS_LPMGR

                config OS_USING_TICKLESS_LPMGR
                    bool "Tickless for low power consumption"
                config OS_USING_SIMPLE_LPM
                    bool "Simple low power consumption"
                    
            endchoice
        endif    
    endif
endmenu
```

## drivers/misc/Kconfig
```kconfig
menu "MISC"
    config OS_USING_PUSH_BUTTON
        bool "Using push button device drivers"
        default y
        
    config OS_USING_LED
        bool "Using led device drivers"
        default y
        
    config OS_USING_BUZZER
        bool "Using buzzer device drivers"
        default n
        
    config OS_USING_ADC
        bool "Using ADC device drivers"
        default n
        
    config OS_USING_DAC
        bool "Using DAC device drivers"
        default n

    config OS_USING_PWM
        bool "Using PWM device drivers"
        default n

    config OS_USING_INPUT_CAPTURE
        bool "Using input capture device drivers"
        default n
        if OS_USING_INPUT_CAPTURE
            config OS_INPUT_CAPTURE_RB_SIZE
                int "Set input capture ringbuffer size"
                default 100
        endif
        
    config OS_USING_PULSE_ENCODER
        bool "Using pulse encoder device drivers"
        default n        

endmenu
```
