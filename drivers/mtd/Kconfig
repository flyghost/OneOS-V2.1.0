## drivers/mtd/Kconfig
```kconfig
menu "MTD"
    config OS_USING_MTD
        bool "Using mtd device"
        default y
endmenu
```

## drivers/nand/Kconfig
```kconfig
menu "NAND"
    config OS_USING_NAND
        bool "Using nand flash driver"
        select OS_FAL_DYNAMIC_FLASH
        default n

    if OS_USING_NAND
        config BSP_NAND_MT29F4G08ABADA
            bool "nand flash MT29F4G08ABADA"
            default n
    endif
        
endmenu
```

## drivers/pin/Kconfig
```kconfig
menu "PIN"
    config OS_USING_PIN
        bool "Using generic GPIO device drivers"
        default y
        
    config OS_PIN_MAX_CHIP
        int "IO chip number"
        default 1
        depends on OS_USING_PIN
        
    menuconfig BSP_USING_PIN_PCF8574
        bool "Using IO expander device pcf8574"
        select OS_USING_PIN
        default n
        
        if BSP_USING_PIN_PCF8574
            config OS_PCF8574_I2C_BUS_NAME
                string "pcf8574 i2c bus name"
                default "soft_i2c2"

            config OS_PCF8574_I2C_BUS_ADDR
                hex "pcf8574 i2c addr(7bit)"
                default 0x20
                
            config OS_PCF8574_INT_PIN
                int "pcf8574 int pin"
                default 28
                
            config OS_PCF8574_PIN_BASE
                int "pcf8574 pin base(0, 1000, 2000, ...)"
                default 1000
        endif

endmenu
```

## drivers/rtc/Kconfig
```kconfig
menu "RTC"
    config OS_USING_RTC
        bool "Using RTC drivers"
        default n
        if OS_USING_RTC
            config OS_RTC_DEV_NAME
                string "rtc device name"
                default "rtc"
        endif
endmenu
```

## drivers/sdio/Kconfig
```kconfig
menu "SDIO"
config OS_USING_SDIO
    bool "Using SD/MMC device drivers"
    default n

    if OS_USING_SDIO
        config OS_SDIO_STACK_SIZE
            int "The stack size for sdio irq thread"
            default 512

        config OS_SDIO_TASK_PRIORITY
            int "The priority level value of sdio irq thread"
            default 15

        config OS_MMCSD_STACK_SIZE
            int "The stack size for mmcsd thread"
            default 1024

        config OS_MMCSD_TASK_PREORITY
            int "The priority level value of mmcsd thread"
            default 22

        config OS_MMCSD_MAX_PARTITION
            int "mmcsd max partition"
            default 16
        config OS_SDIO_DEBUG
            bool "Enable SDIO debug log output"
        default n
    endif
endmenu
```

## drivers/sensors/Kconfig
```kconfig
menu "Sensors"
    config OS_USING_SENSOR
        bool "Using sensor device drivers"
        default n

    if OS_USING_SENSOR

        menuconfig OS_USING_SHT20
            bool "Enable sht20"
            select OS_USING_I2C
            default n

            if OS_USING_SHT20
                config OS_SHT20_I2C_BUS_NAME
                    string "sht20 i2c bus name"
                    default "i2c1"

                config OS_SHT20_I2C_ADDR
                    hex "sht20 i2c addr(7bit)"
                    default 0x40
            endif

        menuconfig OS_USING_AHT10
            bool "Enable aht10"
            select OS_USING_I2C
            default n

            if OS_USING_AHT10

                config OS_AHT10_I2C_BUS_NAME
                    string "aht10 i2c bus name"
                    default "i2c1"

                config OS_AHT10_I2C_ADDR
                    hex "aht10 i2c addr(7bit)"
                    default 0x38
            endif
        
        menuconfig OS_USING_AHT20
            bool "Enable aht20"
            select OS_USING_I2C
            default n

            if OS_USING_AHT20
                config OS_AHT20_I2C_BUS_NAME
                    string "aht20 i2c bus name"
                    default "soft_i2c2"

                config OS_AHT20_I2C_ADDR
                    hex "aht20 i2c addr(7bit)"
                    default 0x38
            endif

        menuconfig OS_USING_ADXL345
            bool "Enable adxl345"
            select OS_USING_I2C
            default n

            if OS_USING_ADXL345
                config OS_ADXL345_I2C_BUS_NAME
                    string "adxl345 i2c bus name"
                    default "i2c1"

                config OS_ADXL345_I2C_ADDR
                    hex "adxl345 i2c addr(7bit)"
                    default 0x53
            endif

        menuconfig OS_USING_BH1750
            bool "Enable bh1750"
            select OS_USING_I2C
            default n

            if OS_USING_BH1750
                config OS_BH1750_I2C_BUS_NAME
                    string "bh1750 i2c bus name"
                    default "i2c2"

                config OS_BH1750_I2C_ADDR
                    hex "bh1750 i2c addr(7bit)"
                    default 0x23
            endif

        menuconfig OS_USING_BMP180
            bool "Enable bmp180"
            select OS_USING_I2C
            default n

            if OS_USING_BMP180
                config OS_BMP180_I2C_BUS_NAME
                    string "bmp180 i2c bus name"
                    default "i2c2"

                config OS_BMP180_I2C_ADDR
                    hex "bmp180 i2c addr(7bit)"
                    default 0x77
            endif

        menuconfig OS_USING_MPU6XXX
            bool "Enable mpu6xxx"
            select PKG_USING_MPU6XXX
            default n
            
            if OS_USING_MPU6XXX

                choice
                    prompt "mpu6xxx bus type"
                    default OS_MPU6XXX_BUS_I2C
                    config OS_MPU6XXX_BUS_I2C
                        bool "i2c"
                        select OS_USING_I2C
                    config OS_MPU6XXX_BUS_SPI
                        bool "spi"
                        select OS_USING_SPI
                endchoice

                config OS_MPU6XXX_BUS_NAME
                    string "mpu6xxx bus name"
                    default "i2c2"

                config OS_MPU6XXX_SPI_ATTACH_NAME
                    string "mpu6xxx spi attach bus name"
                    default "mpu6xxx_spi"
                    depends on OS_MPU6XXX_BUS_SPI

                config OS_MPU6XXX_ADDR
                    hex "mpu6xxx addr(7bit)"
                    default 0x68
                    depends on OS_MPU6XXX_BUS_I2C

                config OS_MPU6XXX_CS_PIN
                    int "mpu6xxx cs pin number"
                    default 403
                    depends on OS_MPU6XXX_BUS_SPI

                config OS_MPU6XXX_INT_PIN
                    int "mpu6xxx interrupt pin number"
                    default 21
                    
                config PKG_USING_MPU6XXX
                    bool
                    default n
                config PKG_USING_MPU6XXX_ACCE
                    bool "mpu6xxx acce"
                    default y
              
                config PKG_USING_MPU6XXX_GYRO
                    bool "mpu6xxx gyro"
                    default y
                    
                config PKG_USING_MPU6XXX_TEMP
                    bool "mpu6xxx temp"
                    default n

                config OS_USING_ICM20602
                    bool "Enable icm20602"
                    default n

                config OS_USING_ICM20608
                    bool "Enable icm20608"
                    default n

                config OS_USING_MPU9250
                    bool "Enable mpu9250(ak8963)"
                    default n

                config OS_USING_MPU6050
                    bool "Enable mpu6050"
                    default n
            endif

        menuconfig OS_USING_AK8963
            bool "Enable ak8963"
            select OS_USING_I2C
            default n

            if OS_USING_AK8963
                config OS_AK8963_I2C_BUS_NAME
                    string "ak8963 i2c bus name"
                    default "i2c2"

                config OS_AK8963_I2C_ADDR
                    hex "ak8963 i2c addr(7bit)"
                    default 0x0c
            endif

        menuconfig OS_USING_LSM6DSL
            bool "Enable lsm6dsl"
            select OS_USING_I2C
            default n

            if OS_USING_LSM6DSL
                config OS_LSM6DSL_I2C_BUS_NAME
                    string "lsm6dsl i2c bus name"
                    default "i2c2"

                config OS_LSM6DSL_I2C_ADDR
                    hex "lsm6dsl i2c addr(sad = 0 --> 6a, sad = 1 --> 6b)"
                    default 0x0c
            endif
        menuconfig OS_USING_LSM6DSO
            bool "Enable lsm6dso"
            select OS_USING_I2C
            default n

            if OS_USING_LSM6DSO
                config OS_LSM6DSO_I2C_BUS_NAME
                    string "lsm6dso i2c bus name"
                    default "i2c2"

                config OS_LSM6DSO_I2C_ADDR
                    hex "lsm6dsl i2c addr(if SA0=0 -> 6A if SA0=1 -> 6B )"
                    default 0x6A
            endif
        menuconfig OS_USING_AP3216C
            bool "Enable ap3216c"
            select OS_USING_I2C
            default n

            if OS_USING_AP3216C
                config OS_AP3216C_I2C_BUS_NAME
                    string "ap3216c i2c bus name"
                    default "i2c3"

                config OS_AP3216C_I2C_ADDR
                    hex "ap3216c i2c addr"
                    default 0x1e
            endif
        menuconfig OS_USING_PHOTO_DIODE
            bool "Enable photo diode"
            select OS_USING_I2C
            default n

            if OS_USING_PHOTO_DIODE
                config OS_PHOTO_DIODE_ADC_NAME
                    string "photo diode adc name"
                    default "adc3"

                config OS_PHOTO_DIODE_ADC_CHANNEL
                    hex "photo diode adc channel"
                    default 6
            endif
    endif

endmenu
```

## drivers/serial/Kconfig
```kconfig
menu "Serial"
    config OS_USING_SERIAL
        bool "Enable serial drivers"
        default y
        select OS_USING_DMA
        select OS_USING_DMA_RAM
        select OS_USING_SOFT_DMA
        
    if OS_USING_SERIAL            
        config OS_SERIAL_DELAY_CLOSE
            bool "Enable serial close after sending"
            default y
            
        config OS_SERIAL_RX_BUFSZ
            int "Set RX buffer size"
            default 64
            
        config OS_SERIAL_TX_BUFSZ
            int "Set TX buffer size"
            default 64            
    endif
    
    source "$OS_ROOT/drivers/serial/*/Kconfig"
endmenu
```

## drivers/serial/posix/Kconfig
```kconfig
menu "posix serial"
    config OS_USING_POSIX_SERIAL
        bool "Using posix serial drivers"
        select OS_USING_SERIAL
        select OS_SOFT_DMA_SUPPORT_NORMAL_MODE
        select OS_SOFT_DMA_SUPPORT_SIMUL_TIMEOUT
        default n

    config OS_USING_POSIX_SERIAL_NAME
        depends on OS_USING_POSIX_SERIAL
        string "posix serial device name"
        default "uartP"
endmenu
```

## drivers/serial/rtt/Kconfig
```kconfig
menu "rtt uart"
    config OS_USING_RTT
        bool "Using jlink rtt uart drivers"
        select OS_USING_SERIAL
        select OS_SOFT_DMA_SUPPORT_NORMAL_MODE
        select OS_SOFT_DMA_SUPPORT_SIMUL_TIMEOUT
        default n

    config OS_RTT_DEVICE_NAME
        depends on OS_USING_RTT
        string "jlink rtt uart device name"
        default "uartRTT"

endmenu
```

## drivers/sn/Kconfig
```kconfig
menu "SN"
    config OS_USING_SN
        bool "Enable SN Config"
        default n
        select BSP_USING_FLASH
endmenu
```

## drivers/spi/Kconfig
```kconfig
menu "SPI"
    config OS_USING_SPI
        bool "Using SPI Bus/Device device drivers"
        default n

    config OS_USING_QSPI
        depends on OS_USING_SPI
        bool "Enable QSPI mode"
        default n

    config OS_USING_SPI_MSD
        depends on OS_USING_SPI
        bool "SPI MSD"
        default n
        select OS_USING_MTD

    config OS_USING_SFUD
        depends on OS_USING_SPI
        select OS_USING_FAL
        bool "Using serial flash universal driver"
        default n

    if OS_USING_SFUD

        config OS_SFUD_USING_SFDP
            bool "Using auto probe flash JEDEC SFDP parameter"
            default y

        config OS_SFUD_USING_FLASH_INFO_TABLE
            bool "Using defined supported flash chip information table"
            default y

        config OS_DEBUG_SFUD
            bool "Show more SFUD debug information"
            default n

        menuconfig OS_SFUD_USING_SPI
            bool "Using SPI mode support"
            default n

            if OS_SFUD_USING_SPI
                config OS_SPI_FLASH_BUS_NAME
                    string "spi flash bus name"
                    default "spi2"

                config OS_SPI_FLASH_CS_PIN
                    int "spi flash cs pin"
                    default 28
            endif

        menuconfig OS_SFUD_USING_QSPI
            bool "Using QSPI mode support"
            default n

            if OS_SFUD_USING_QSPI
                config OS_QSPI_FLASH_BUS_NAME
                    string "qspi flash bus name"
                    default "qspi"

            endif

        menuconfig OS_EXTERN_FLASH_PORT_CFG
            bool "Extern flash sfud port cfg"
            default y

            if OS_EXTERN_FLASH_PORT_CFG
                config OS_EXTERN_FLASH_DEV_NAME
                    string "Extern flash dev name"
                    default "AT45DB041E"

                config OS_EXTERN_FLASH_BUS_NAME
                    string "Extern flash bus name"
                    default "sfud_bus"

                config OS_EXTERN_FLASH_NAME
                    string "Extern flash name"
                    default "nor_flash"

                config OS_EXTERN_FLASH_SIZE
                    int "Extern flash size"
                    default 16777216
                    
                config OS_EXTERN_FLASH_BLOCK_SIZE
                    int "Extern flash block size"
                    default 4096

                config OS_EXTERN_FLASH_PAGE_SIZE
                    int "Extern flash page size"
                    default 4096
            endif
    endif

    config BSP_USING_W25QXX
        bool "Using W25QXX NorFlash"
        depends on OS_USING_SPI
        select OS_USING_SFUD
        default n

    menuconfig BSP_USING_NM25Q
        bool "Using NM25Q NorFlash"
        depends on OS_USING_SPI
        default n
        
        if BSP_USING_NM25Q
            config BSP_NM25Q_SPI_BUS
                string "spi bus name"
                default "spi2"
            config BSP_NM25Q_SPI_CS
                int "spi cs pin"
                default 28
        endif

    menuconfig BSP_USING_ENC28J60
        bool "Using enc28j60 spi net module"
        default n
        select NET_USING_LWIP

        if BSP_USING_ENC28J60
            config BSP_ENC28J60_SPI_BUS
                string "enc28j60 spi bus name"
                default "spi2"

            config BSP_ENC28J60_SPI_CS
                int "enc28j60 spi cs pin"
                default 53

            config BSP_ENC28J60_SPI_DEV
                string "enc28j60 spi device name"
                default "spi21"

            config BSP_ENC28J60_IRQ
                int "enc28j60 spi irq pin"
                default 51

            config BSP_ENC28J60_RST
                int "enc28j60 spi rst pin"
                default 52
        endif

    menuconfig BSP_USING_SDCARD
        bool "Enable SDCARD (SPI)"
        select OS_USING_SPI_MSD
        default n

        if BSP_USING_SDCARD
            config BSP_SDCARD_SPI_DEV
                string "sdcard spi device name"
                default "spi2"

            config BSP_SDCARD_SPI_CS_PIN
                int "sdcard SPI_CS pin"
                default 28
        endif

    config BSP_USING_NRF24L01
        bool "Enable NRF24L01"
        select BSP_USING_SPI
        select BSP_USING_SPI2
        select PKG_USING_NRF24L01
        default n

endmenu
```
