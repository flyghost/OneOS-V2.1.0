## drivers/timer/Kconfig
```kconfig
menu "Timer"
    config OS_USING_TIMER_DRIVER
        bool "Using timer driver"
        default y

    if OS_USING_TIMER_DRIVER
        config OS_USING_CLOCKSOURCE
            bool "clocksource"
            default y
            
            if OS_USING_CLOCKSOURCE
                config OS_CLOCKSOURCE_SHOW
                    bool "clocksource show"
                    default n
            endif
            
        config OS_USING_TIMEKEEPING
            bool "Timekeeping"
            depends on OS_USING_CLOCKSOURCE
            default n
            
        config OS_USING_CLOCKEVENT
            bool "clockevent"
            select OS_USING_CLOCKSOURCE
            default n
            
            if OS_USING_CLOCKEVENT
                config OS_CLOCKEVENT_SHOW
                    bool "clockevent show"
                    default n
            endif
        
        config OS_USING_HRTIMER
            bool "hrtimer(soft timer)"
            select OS_USING_CLOCKSOURCE
            select OS_USING_CLOCKEVENT
            default n
            
            if OS_USING_HRTIMER
                config OS_USING_HRTIMER_FOR_KERNEL_TICK
                    bool "hrtimer for kernel tick"
                    default y
            endif
            
        if ARCH_ARM_CORTEX_M
            menu "cortex-m hardware timer config"                    
                choice
                    prompt "cortex-m systick config"
                    
                    if !OS_USING_HRTIMER_FOR_KERNEL_TICK
                        config OS_USING_SYSTICK_FOR_KERNEL_TICK
                            bool "systick for kernel tick"
                    endif
                    
                    if OS_USING_CLOCKSOURCE
                        config OS_USING_SYSTICK_FOR_CLOCKSOURCE
                            bool "systick for clocksource"
                    endif
                        
                    if OS_USING_CLOCKEVENT
                        config OS_USING_SYSTICK_FOR_CLOCKEVENT
                            bool "systick for clockevent"
                    endif
                endchoice
                
                config OS_USING_DWT_FOR_CLOCKSOURCE
                    bool "cortex-m dwt for clocksource"
                    default n
                    depends on OS_USING_CLOCKSOURCE
            endmenu
        endif
    endif
endmenu
```

## drivers/touch/Kconfig
```kconfig
menu "Touch"
    config OS_USING_TOUCH
    bool "Using Touch device drivers"
    default n

    if OS_USING_TOUCH
        config OS_TOUCH_X_REVERSE
            bool "x coordinate reverse"
            default n

        config OS_TOUCH_Y_REVERSE
            bool "y coordinate reverse"
            default n

        config OS_TOUCH_XY_SWAP
            bool "xy coordinate swap"
            default n

        if 0
            menuconfig OS_USING_GT9147
                bool "Enable gt9147"
                select OS_USING_I2C
                select BSP_USING_I2C
                default n

                if OS_USING_GT9147
                    config OS_GT9147_I2C_BUS_NAME
                        string "gt9147 i2c bus name"
                        default "i2c1"

                    config OS_GT9147_I2C_ADDR_HIGH
                        hex "gt9147 i2c addr high(7bit)"
                        default 0x5d

                    config OS_GT9147_I2C_ADDR_LOW
                        hex "gt9147 i2c addr low"
                        default 0x14

                    config OS_GT9147_RST_PIN
                        int "gt9147 rst pin"
                        default 61

                    config OS_GT9147_IRQ_PIN
                        int "gt9147 irq pin"
                        default 63
                endif
        endif

        menuconfig OS_USING_FT6X06
            bool "Enable ft6x06"
            select OS_USING_I2C
            select BSP_USING_I2C
            default n

            if OS_USING_FT6X06
                config OS_FT6X060_I2C_BUS_NAME
                    string "ft6x06 i2c bus name"
                    default "i2c2"

                config OS_FT6X06_I2C_ADDR
                    hex "ft6x06 i2c addr(7bit)"
                    default 0x2a
            endif

        menuconfig OS_USING_STMPE811
            bool "Enable stmpe811"
            select OS_USING_I2C
            select BSP_USING_I2C
            default n

            if OS_USING_STMPE811
                config OS_STMPE811_I2C_BUS_NAME
                    string "stmpe811 i2c bus name"
                    default "i2c3"

                config OS_STMPE811_I2C_ADDR
                    hex "stmpe811 i2c addr(7bit)"
                    default 0x41
            endif
			
        menuconfig OS_USING_FT5406
            bool "Enable ft5406"
            select OS_USING_I2C
            select BSP_USING_I2C
            default n

            if OS_USING_FT5406
                config OS_FT5406_I2C_BUS_NAME
                    string "ft5406 i2c bus name"
                    default "soft_i2c1"

                config OS_FT5406_I2C_ADDR
                    hex "ft5406 i2c addr(7bit)"
                    default 0x38
            endif
    endif
endmenu
```

## drivers/usb/Kconfig
```kconfig
menu "USB"
    menuconfig OS_USING_USB_HOST
        bool "Using USB host"
        default n
        if OS_USING_USB_HOST
            config USB_USING_HOST_HS
                bool "usb host use hs"
                default n
            config USB_USING_HOST_FS
                bool "usb host use fs"
                default n
        
            if USB_USING_HOST_HS || USB_USING_HOST_FS
                config ENABLE_USBH_AUDIO_CLASS
                    bool "enable usbh audio class"
                    default n
                    
                config ENABLE_USBH_CDC_CLASS
                    bool "enable usbh cdc class"
                    default n
                    
                config ENABLE_USBH_MSC_CLASS
                    bool "enable usbh msc class"
                    default n
                    
                config ENABLE_USBH_HID_CLASS
                    bool "enable usbh hid class"
                    default y
                    
                config ENABLE_USBH_MTP_CLASS
                    bool "enable usbh mtp class"
                    default n
                    
                config ENABLE_USBH_HUB_CLASS
                    bool "enable usbh hub class"
                    default n
                    
                config ENABLE_USBH_SPECIFIC_CDC_CLASS
                    bool "enable usbh specific cdc class"
                    default n
            endif
        
        endif
        
        
        
    menuconfig OS_USING_USB_DEVICE
        bool "Using USB device"
        default n
        
        if OS_USING_USB_DEVICE
            config USB_USING_DEVICE_HS
                bool "usb device use hs"
                default n
                
            if USB_USING_DEVICE_HS
                config USBD_HS_VENDOR_ID
                    hex "USBD HS Vendor ID"
                    default 0x0FFE
                    
                config USBD_HS_PRODUCT_ID
                    hex "USBD HS Product ID"
                    default 0x0001
                    
                choice
                    prompt "choose usb device class"
                        default OS_USBD_CDC_CLASS_HS
                        help
                            Select usb hs device class

                        config OS_USBD_PRINTER_CLASS_HS
                            bool "Printer device hs"

                        config OS_USBD_MSC_CLASS_HS
                            bool "MSC device hs"

                        config OS_USBD_HID_CLASS_HS
                            bool "HID device hs"

                        config OS_USBD_CDC_CLASS_HS
                            bool "CDC device hs"
                endchoice
                
                if OS_USBD_CDC_CLASS_HS
                    config OS_USBD_CDC_HS_STK_SIZE
                        int "virtual com task stack size"
                        default 512
                endif    
            endif
            
            config USB_USING_DEVICE_FS
                bool "usb device use fs"
                default y
                
            if USB_USING_DEVICE_FS
                config USBD_FS_VENDOR_ID
                    hex "USBD FS Vendor ID"
                    default 0x0FFE
                    
                config USBD_FS_PRODUCT_ID
                    hex "USBD FS Product ID"
                    default 0x0001
                    
                choice
                    prompt "choose usb device class"
                        default OS_USBD_CDC_CLASS_FS
                        help
                            Select usb fs device class

                        config OS_USBD_PRINTER_CLASS_FS
                            bool "Printer device fs"
                        
                        config OS_USBD_MSC_CLASS_FS
                            bool "MSC device fs"

                        config OS_USBD_HID_CLASS_FS
                            bool "HID device fs"

                        config OS_USBD_CDC_CLASS_FS
                            bool "CDC device fs"
                endchoice
                
                if OS_USBD_CDC_CLASS_FS
                    config OS_USBD_CDC_FS_STK_SIZE
                        int "virtual com task stack size"
                        default 512
                endif    
            endif
        endif
        
        

    if OS_USING_USB_DEVICE || OS_USING_USB_HOST
        config OS_USBD_TASK_STACK_SZ
            int "usb task stack size"
            default 4096
        endif
endmenu
```

## drivers/watchdog/Kconfig
```kconfig
menu "WDG"
    config OS_USING_WDG
        bool "Using watchdog drivers"
        default n
endmenu
```

## drivers/wlan/Kconfig
```kconfig
menuconfig OS_USING_WLAN
    bool "WLAN"
    default n
    select OS_USING_DEVICE_NOTIFY
    
    if OS_USING_WLAN
        config OS_WLAN_DEVICE_STA_NAME
            string "The device name for station"
            default "wlan0"

        config OS_WLAN_DEVICE_AP_NAME
            string "The device name for ap"
            default "wlan1"

        config OS_WLAN_PROTOCOL_NUM_MAX
            int "transport protocol max num"
            default 5
        
        config OS_WLAN_INIT_TASK_STACK_SIZE
            int "wlan init stack size"
            default 1024
            
        config OS_WLAN_INIT_TASK_PRIORITY
            int "wlan init priority"
            default 10
            
        config OS_WLAN_LWIP
            bool
            default n
            
        
    endif
    
    
```
