## templates/cm32m101a-64/Kconfig
```kconfig
mainmenu "One-Os Configuration"

#Define the relative path to root directory of os code
OS_ROOT=../..
SRC_HAL=cmiot

config BOARD_CM32M1
    bool
	select SOC_CM32M101A
    default y
	
source "$OS_ROOT/Kconfig"
```

## templates/configs/Kconfig
```kconfig
choice
    prompt "MANUFACTOR"
        default MANUFACTOR_STM32
        
    config MANUFACTOR_STM32
        bool "STM32"

    config MANUFACTOR_GD32
        bool "GD32"

    config MANUFACTOR_GD32V
        bool "GD32V"

    config MANUFACTOR_NXP
        bool "NXP"

    config MANUFACTOR_HDSC
        bool "HDSC"

    config MANUFACTOR_CMIOT
        bool "CMIOT"

    config MANUFACTOR_MM32
        bool "MM32"
                
    config MANUFACTOR_HK32
        bool "HK32"
        
    config MANUFACTOR_INGENIC
        bool "INGENIC"
        
    config MANUFACTOR_NRF
        bool "NRF"
        
    config MANUFACTOR_FM33
        bool "FM33"
        
    #config MANUFACTOR_BEKEN
    #    bool "BEKEN"
    
endchoice

if MANUFACTOR_STM32
    source "$OS_ROOT/templates/configs/st/Kconfig"
endif

if MANUFACTOR_GD32
    source "$OS_ROOT/templates/configs/gd/Kconfig"
endif

if MANUFACTOR_GD32V
    source "$OS_ROOT/templates/configs/gd32v/Kconfig"
endif

if MANUFACTOR_NXP
    source "$OS_ROOT/templates/configs/nxp/Kconfig"
endif

if MANUFACTOR_HDSC
    source "$OS_ROOT/templates/configs/hdsc/Kconfig"
endif

if MANUFACTOR_CMIOT
    source "$OS_ROOT/templates/configs/cmiot/Kconfig"
endif

if MANUFACTOR_HSXP
    #source "$OS_ROOT/templates/configs/hsxp/Kconfig"
endif

if MANUFACTOR_MM32
    source "$OS_ROOT/templates/configs/mm32/Kconfig"
endif

if MANUFACTOR_HK32
    source "$OS_ROOT/templates/configs/hk32/Kconfig"
endif

if MANUFACTOR_INGENIC
    source "$OS_ROOT/templates/configs/ingenic/Kconfig"
endif

if MANUFACTOR_NRF
    source "$OS_ROOT/templates/configs/nrf/Kconfig"
endif

if MANUFACTOR_FM33
    source "$OS_ROOT/templates/configs/fm/Kconfig"
endif

if MANUFACTOR_BEKEN
    source "$OS_ROOT/templates/configs/beken/Kconfig"
endif
```

## templates/configs/beken/Kconfig
```kconfig
choice
    prompt "|--SERIES"
        default SERIES_BK72
    help
        Select the device in BEKEN

    config SERIES_BK72
        bool "BK72"
		
endchoice

if SERIES_BK72
    source "$OS_ROOT/templates/configs/beken/bk72/Kconfig"
endif
```

## templates/configs/beken/bk72/Kconfig
```kconfig
choice
    prompt "|----MODEL"
        default MODEL_BK7231
    help
        Select the device in BK72

    config MODEL_BK7231
        bool "Bk7231"	
endchoice

if MODEL_BK7231
    source "$OS_ROOT/templates/configs/beken/bk72/bk7231/Kconfig"
endif
```

## templates/configs/beken/bk72/bk7231/Kconfig
```kconfig
choice
    prompt "|------SUB MODEL"
        default TEMP_bk7231n
    help
        Select the device in bk7231

    config TEMP_bk7231n
        bool "bk7231n"
endchoice
```

## templates/configs/cmiot/Kconfig
```kconfig
choice
    prompt "|--SERIES"
        default SERIES_CM32M10
    help
        Select the device in CM32
     
    config SERIES_CM32M10
        bool "CM32M10"
   
endchoice

if SERIES_CM32M10
    source "$OS_ROOT/templates/configs/cmiot/m10/Kconfig"
endif
    
```

## templates/configs/cmiot/m10/Kconfig
```kconfig
choice
    prompt "|----MODEL"
        default MODEL_CM32M101
    help
        Select the device in CM32M101

    config MODEL_CM32M101
        bool "CM32M101"

endchoice

if MODEL_CM32M101
    source "$OS_ROOT/templates/configs/cmiot/m10/m101/Kconfig"
endif
```

## templates/configs/cmiot/m10/m101/Kconfig
```kconfig
choice
    prompt "|------SUB MODEL"
        default TEMP_cm32m101a-64
    help
        Select the device in CM32M101x

    config TEMP_cm32m101a-64
        bool "cm32m101a-64"

endchoice
```

## templates/configs/fm/Kconfig
```kconfig
choice
    prompt "|--SERIES"
        default SERIES_FM33LG0
    help
        Select the device in FM33

    config SERIES_FM33LG0
        bool "FM33LG0"

    config SERIES_FM33LC0
        bool "FM33LC0"

    config SERIES_FM33G0
        bool "FM33G0"
endchoice

if SERIES_FM33LG0
    source "$OS_ROOT/templates/configs/fm/lg0/Kconfig"
endif

if SERIES_FM33LC0
    source "$OS_ROOT/templates/configs/fm/lc0/Kconfig"
endif

if SERIES_FM33G0
    source "$OS_ROOT/templates/configs/fm/g0/Kconfig"
endif
```

## templates/configs/fm/g0/Kconfig
```kconfig
choice
    prompt "|----MODEL"
        default MODEL_FM33G04
    help
        Select the device in FM33G04x

    config MODEL_FM33G02
        bool "FM33G02"
        
    config MODEL_FM33G04
        bool "FM33G04"

endchoice

if MODEL_FM33G02
    source "$OS_ROOT/templates/configs/fm/g0/g02/Kconfig"
endif

if MODEL_FM33G04
    source "$OS_ROOT/templates/configs/fm/g0/g04/Kconfig"
endif
```

## templates/configs/fm/g0/g02/Kconfig
```kconfig
choice
    prompt "|------SUB MODEL"
        default TEMP_FM33G023
    help
        Select the device in FM33G02x

    config TEMP_FM33G022
        bool "FM33G022"

    config TEMP_FM33G023
        bool "FM33G023"
     
    config TEMP_FM33G025
        bool "FM33G025"

    config TEMP_FM33G026
        bool "FM33G026"

    config TEMP_FM33G028
        bool "FM33G028"

endchoice
```

## templates/configs/fm/g0/g04/Kconfig
```kconfig
choice
    prompt "|------SUB MODEL"
        default TEMP_FM33G048
    help
        Select the device in FM33G04x

    config TEMP_FM33G042
        bool "FM33G042"

    config TEMP_FM33G043
        bool "FM33G043"
   
    config TEMP_FM33G045
        bool "FM33G045"

    config TEMP_FM33G046
        bool "FM33G046"

    config TEMP_FM33G048
        bool "FM33G048"

endchoice
```

## templates/configs/fm/lc0/Kconfig
```kconfig
choice
    prompt "|----MODEL"
        default MODEL_FM33LC04
    help
        Select the device in FM33LC04x

    config MODEL_FM33LC01
        bool "FM33LC01"

    config MODEL_FM33LC02
        bool "FM33LC02"
        
    config MODEL_FM33LC04
        bool "FM33LC04"

endchoice

if MODEL_FM33LC01
    source "$OS_ROOT/templates/configs/fm/lc0/lc01/Kconfig"
endif

if MODEL_FM33LC02
    source "$OS_ROOT/templates/configs/fm/lc0/lc02/Kconfig"
endif

if MODEL_FM33LC04
    source "$OS_ROOT/templates/configs/fm/lc0/lc04/Kconfig"
endif
```

## templates/configs/fm/lc0/lc01/Kconfig
```kconfig
choice
    prompt "|------SUB MODEL"
        default TEMP_FM33LC016
    help
        Select the device in FM33LC01x

    config TEMP_FM33LC013
        bool "FM33LC013"

    config TEMP_FM33LC014
        bool "FM33LC014"
        
    config TEMP_FM33LC015
        bool "FM33LC015"

    config TEMP_FM33LC016
        bool "FM33LC016"

endchoice
```

## templates/configs/fm/lc0/lc02/Kconfig
```kconfig
choice
    prompt "|------SUB MODEL"
        default TEMP_FM33LC023
    help
        Select the device in FM33LC02x

    config TEMP_FM33LC023
        bool "FM33LC023"

    config TEMP_FM33LC024
        bool "FM33LC024"
        
    config TEMP_FM33LC025
        bool "FM33LC025"

    config TEMP_FM33LC026
        bool "FM33LC026"

endchoice
```

## templates/configs/fm/lc0/lc04/Kconfig
```kconfig
choice
    prompt "|------SUB MODEL"
        default TEMP_FM33LC046
    help
        Select the device in FM33LC04x

    config TEMP_FM33LC043
        bool "FM33LC043"

    config TEMP_FM33LC044
        bool "FM33LC044"
        
    config TEMP_FM33LC045
        bool "FM33LC045"

    config TEMP_FM33LC046
        bool "FM33LC046"

endchoice
```

## templates/configs/fm/lg0/Kconfig
```kconfig
choice
    prompt "|----MODEL"
        default MODEL_FM33LG04
    help
        Select the device in FM33LG04x

    config MODEL_FM33LG01
        bool "FM33LG01"

    config MODEL_FM33LG02
        bool "FM33LG02"
        
    config MODEL_FM33LG04
        bool "FM33LG04"

endchoice

if MODEL_FM33LG01
    source "$OS_ROOT/templates/configs/fm/lg0/lg01/Kconfig"
endif

if MODEL_FM33LG02
    source "$OS_ROOT/templates/configs/fm/lg0/lg02/Kconfig"
endif

if MODEL_FM33LG04
    source "$OS_ROOT/templates/configs/fm/lg0/lg04/Kconfig"
endif
```

## templates/configs/fm/lg0/lg01/Kconfig
```kconfig
choice
    prompt "|------SUB MODEL"
        default TEMP_FM33LG016
    help
        Select the device in FM33LG01x

    config TEMP_FM33LG012
        bool "FM33LG012"
        
    config TEMP_FM33LG013
        bool "FM33LG013"

    config TEMP_FM33LG016
        bool "FM33LG016"

endchoice
```

## templates/configs/fm/lg0/lg02/Kconfig
```kconfig
choice
    prompt "|------SUB MODEL"
        default TEMP_FM33LG023
    help
        Select the device in FM33LG02x

    config TEMP_FM33LG023
        bool "FM33LG023"
        
    config TEMP_FM33LG025
        bool "FM33LG025"

    config TEMP_FM33LG026
        bool "FM33LG026"

endchoice
```

## templates/configs/fm/lg0/lg04/Kconfig
```kconfig
choice
    prompt "|------SUB MODEL"
        default TEMP_FM33LG048
    help
        Select the device in FM33LG04x

    config TEMP_FM33LG043
        bool "FM33LG043"
        
    config TEMP_FM33LG045
        bool "FM33LG045"

    config TEMP_FM33LG046
        bool "FM33LG046"

    config TEMP_FM33LG048
        bool "FM33LG048"

endchoice
```

## templates/configs/gd/Kconfig
```kconfig
choice
    prompt "|--SERIES"
        default SERIES_GD32F30x
    help
        GD32F30x

    config SERIES_GD32F30x
        bool "GD32F30x"
        
    config SERIES_GD32F3x0
        bool "GD32F3x0"
        
    config SERIES_GD32F403
        bool "GD32F403"
    
    config SERIES_GD32F4xx
        bool "GD32F4xx"
    
    config SERIES_GD32E10x
        bool "GD32E10x"
    
    config SERIES_GD32E50x
        bool "GD32E50x"

    config SERIES_GD32F10x
        bool "GD32F10x"
        
    config SERIES_GD32F20x
        bool "GD32F20x"
        
endchoice

if SERIES_GD32F30x
    source "$OS_ROOT/templates/configs/gd/f30x/Kconfig"
endif

if SERIES_GD32F3x0
    source "$OS_ROOT/templates/configs/gd/f3x0/Kconfig"
endif

if SERIES_GD32F403
    source "$OS_ROOT/templates/configs/gd/f403/Kconfig"
endif

if SERIES_GD32F4xx
    source "$OS_ROOT/templates/configs/gd/f4xx/Kconfig"
endif

if SERIES_GD32E10x
    source "$OS_ROOT/templates/configs/gd/e10x/Kconfig"
endif

if SERIES_GD32E50x
    source "$OS_ROOT/templates/configs/gd/e50x/Kconfig"
endif

if SERIES_GD32F10x
    source "$OS_ROOT/templates/configs/gd/f10x/Kconfig"
endif

if SERIES_GD32F20x
    source "$OS_ROOT/templates/configs/gd/f20x/Kconfig"
endif
```

## templates/configs/gd/e10x/Kconfig
```kconfig
choice
    prompt "|----MODEL"
        default MODEL_GD32E103
    help
        Select the device in GD32F30x

    config MODEL_GD32E103
        bool "GD32E103"

endchoice

if MODEL_GD32E103
    source "$OS_ROOT/templates/configs/gd/e10x/e103/Kconfig"
endif
```

## templates/configs/gd/e10x/e103/Kconfig
```kconfig
choice
    prompt "|------SUB MODEL"
        default TEMP_GD32E103C8
    help
        Select the device in GD32E103xx

    config TEMP_GD32E103T8
        bool "GD32E103T8"
    
    config TEMP_GD32E103TB
        bool "GD32E103TB"
    
    config TEMP_GD32E103C8
        bool "GD32E103C8"
    
    config TEMP_GD32E103CB
        bool "GD32E103CB"
    
    config TEMP_GD32E103R8
        bool "GD32E103R8"
        
    config TEMP_GD32E103RB
        bool "GD32E103RB"
    
    config TEMP_GD32E103V8
        bool "GD32E103V8"
    
    config TEMP_GD32E103VB
        bool "GD32E103VB"

endchoice
```

## templates/configs/gd/e50x/Kconfig
```kconfig
choice
    prompt "|----MODEL"
        default MODEL_GD32E503
    help
        Select the device in GD32E50x

    config MODEL_GD32E503
        bool "GD32E503"
	
	config MODEL_GD32E505
        bool "GD32E505"
		
	config MODEL_GD32E507
        bool "GD32E507"

endchoice

if MODEL_GD32E503
    source "$OS_ROOT/templates/configs/gd/e50x/e503/Kconfig"
endif

if MODEL_GD32E505
    source "$OS_ROOT/templates/configs/gd/e50x/e505/Kconfig"
endif

if MODEL_GD32E507
    source "$OS_ROOT/templates/configs/gd/e50x/e507/Kconfig"
endif
```

## templates/configs/gd/e50x/e503/Kconfig
```kconfig
choice
    prompt "|------SUB MODEL"
        default TEMP_GD32E503CC
    help
        Select the device in GD32E503xx

    config TEMP_GD32E503CC
        bool "GD32E503CC"
    
    config TEMP_GD32E503CE
        bool "GD32E503CE"
    
    config TEMP_GD32E503RC
        bool "GD32E503RC"
    
    config TEMP_GD32E503RE
        bool "GD32E503RE"
    
    config TEMP_GD32E503VC
        bool "GD32E503VC"
        
    config TEMP_GD32E503VE
        bool "GD32E503VE"
    
    config TEMP_GD32E503ZC
        bool "GD32E503ZC"
    
    config TEMP_GD32E503ZE
        bool "GD32E503ZE"

endchoice
```
