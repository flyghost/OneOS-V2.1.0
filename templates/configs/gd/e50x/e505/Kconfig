## templates/configs/gd/e50x/e505/Kconfig
```kconfig
choice
    prompt "|------SUB MODEL"
        default TEMP_GD32E505RB
    help
        Select the device in GD32E505xx

    config TEMP_GD32E505RB
        bool "GD32E505RB"
    
    config TEMP_GD32E505RC
        bool "GD32E505RC"
    
    config TEMP_GD32E505RE
        bool "GD32E505RE"
    
    config TEMP_GD32E505VC
        bool "GD32E505VC"
        
    config TEMP_GD32E505VE
        bool "GD32E505VE"
    
    config TEMP_GD32E505ZC
        bool "GD32E505ZC"
    
    config TEMP_GD32E505ZE
        bool "GD32E505ZE"

endchoice
```

## templates/configs/gd/e50x/e507/Kconfig
```kconfig
choice
    prompt "|------SUB MODEL"
        default TEMP_GD32E507RC
    help
        Select the device in GD32E507xx
    
    config TEMP_GD32E507RC
        bool "GD32E507RC"
    
    config TEMP_GD32E507RE
        bool "GD32E507RE"
    
    config TEMP_GD32E507VC
        bool "GD32E507VC"
        
    config TEMP_GD32E507VE
        bool "GD32E507VE"
    
    config TEMP_GD32E507ZC
        bool "GD32E507ZC"
    
    config TEMP_GD32E507ZE
        bool "GD32E507ZE"

endchoice
```

## templates/configs/gd/f10x/Kconfig
```kconfig
choice
    prompt "|----MODEL"
        default MODEL_GD32F101
    help
        Select the device in GD32F10x


    config MODEL_GD32F101
        bool "GD32F101"

    config MODEL_GD32F103
        bool "GD32F103"

    config MODEL_GD32F105
        bool "GD32F105"

    config MODEL_GD32F107
        bool "GD32F107"


endchoice


if MODEL_GD32F101
    source "$OS_ROOT/templates/configs/gd/f10x/f101/Kconfig"
endif

if MODEL_GD32F103
    source "$OS_ROOT/templates/configs/gd/f10x/f103/Kconfig"
endif

if MODEL_GD32F105
    source "$OS_ROOT/templates/configs/gd/f10x/f105/Kconfig"
endif

if MODEL_GD32F107
    source "$OS_ROOT/templates/configs/gd/f10x/f107/Kconfig"
endif
```

## templates/configs/gd/f10x/f101/Kconfig
```kconfig
choice
    prompt "|------SUB MODEL"
        default TEMP_GD32F101TB
    help
        Select the device in GD32F101xx

    config TEMP_GD32F101TB
        bool "GD32F101TB"

    config TEMP_GD32F101CB
        bool "GD32F101CB"

    config TEMP_GD32F101RB
        bool "GD32F101RB"

    config TEMP_GD32F101VB
        bool "GD32F101VB"

    config TEMP_GD32F101RC
        bool "GD32F101RC"

    config TEMP_GD32F101RD
        bool "GD32F101RD"

    config TEMP_GD32F101RE
        bool "GD32F101RE"

    config TEMP_GD32F101RF
        bool "GD32F101RF"

    config TEMP_GD32F101RG
        bool "GD32F101RG"

    config TEMP_GD32F101RI
        bool "GD32F101RI"

    config TEMP_GD32F101RK
        bool "GD32F101RK"

    config TEMP_GD32F101VC
        bool "GD32F101VC"

    config TEMP_GD32F101VD
        bool "GD32F101VD"

    config TEMP_GD32F101VE
        bool "GD32F101VE"

    config TEMP_GD32F101VF
        bool "GD32F101VF"

    config TEMP_GD32F101VG
        bool "GD32F101VG"

    config TEMP_GD32F101VI
        bool "GD32F101VI"

    config TEMP_GD32F101VK
        bool "GD32F101VK"


endchoice
```

## templates/configs/gd/f10x/f103/Kconfig
```kconfig
choice
    prompt "|------SUB MODEL"
        default TEMP_GD32F103T8
    help
        Select the device in GD32F103xx


    config TEMP_GD32F103T8
        bool "GD32F103T8"

    config TEMP_GD32F103TB
        bool "GD32F103TB"

    config TEMP_GD32F103C8
        bool "GD32F103C8"

    config TEMP_GD32F103CB
        bool "GD32F103CB"

    config TEMP_GD32F103R8
        bool "GD32F103R8"

    config TEMP_GD32F103RB
        bool "GD32F103RB"

    config TEMP_GD32F103V8
        bool "GD32F103V8"

    config TEMP_GD32F103VB
        bool "GD32F103VB"

    config TEMP_GD32F103RC
        bool "GD32F103RC"

    config TEMP_GD32F103RD
        bool "GD32F103RD"

    config TEMP_GD32F103RE
        bool "GD32F103RE"

    config TEMP_GD32F103RF
        bool "GD32F103RF"

    config TEMP_GD32F103RG
        bool "GD32F103RG"

    config TEMP_GD32F103RI
        bool "GD32F103RI"

    config TEMP_GD32F103RK
        bool "GD32F103RK"

    config TEMP_GD32F103VC
        bool "GD32F103VC"

    config TEMP_GD32F103VD
        bool "GD32F103VD"

    config TEMP_GD32F103VE
        bool "GD32F103VE"

    config TEMP_GD32F103VF
        bool "GD32F103VF"

    config TEMP_GD32F103VG
        bool "GD32F103VG"

    config TEMP_GD32F103VI
        bool "GD32F103VI"

    config TEMP_GD32F103VK
        bool "GD32F103VK"

    config TEMP_GD32F103ZC
        bool "GD32F103ZC"

    config TEMP_GD32F103ZD
        bool "GD32F103ZD"

    config TEMP_GD32F103ZE
        bool "GD32F103ZE"

    config TEMP_GD32F103ZF
        bool "GD32F103ZF"

    config TEMP_GD32F103ZG
        bool "GD32F103ZG"

    config TEMP_GD32F103ZI
        bool "GD32F103ZI"

    config TEMP_GD32F103ZK
        bool "GD32F103ZK"

endchoice
```

## templates/configs/gd/f10x/f105/Kconfig
```kconfig
choice
    prompt "|------SUB MODEL"
        default TEMP_GD32F105VC
    help
        Select the device in GD32F105xx


    config TEMP_GD32F105R8
        bool "GD32F105R8"

    config TEMP_GD32F105RB
        bool "GD32F105RB"

    config TEMP_GD32F105RC
        bool "GD32F105RC"

    config TEMP_GD32F105RD
        bool "GD32F105RD"

    config TEMP_GD32F105RE
        bool "GD32F105RE"

    config TEMP_GD32F105RF
        bool "GD32F105RF"

    config TEMP_GD32F105RG
        bool "GD32F105RG"

    config TEMP_GD32F105V8
        bool "GD32F105V8"

    config TEMP_GD32F105VB
        bool "GD32F105VB"

    config TEMP_GD32F105VC
        bool "GD32F105VC"

    config TEMP_GD32F105VD
        bool "GD32F105VD"

    config TEMP_GD32F105VE
        bool "GD32F105VE"

    config TEMP_GD32F105VF
        bool "GD32F105VF"

    config TEMP_GD32F105VG
        bool "GD32F105VG"

    config TEMP_GD32F105ZC
        bool "GD32F105ZC"

    config TEMP_GD32F105ZD
        bool "GD32F105ZD"

    config TEMP_GD32F105ZE
        bool "GD32F105ZE"

    config TEMP_GD32F105ZF
        bool "GD32F105ZF"

    config TEMP_GD32F105ZG
        bool "GD32F105ZG"


endchoice
```

## templates/configs/gd/f10x/f107/Kconfig
```kconfig
choice
    prompt "|------SUB MODEL"
        default TEMP_GD32F107RB
    help
        Select the device in GD32F107xx


    config TEMP_GD32F107RB
        bool "GD32F107RB"

    config TEMP_GD32F107RC
        bool "GD32F107RC"

    config TEMP_GD32F107RD
        bool "GD32F107RD"

    config TEMP_GD32F107RE
        bool "GD32F107RE"

    config TEMP_GD32F107RF
        bool "GD32F107RF"

    config TEMP_GD32F107RG
        bool "GD32F107RG"

    config TEMP_GD32F107VB
        bool "GD32F107VB"

    config TEMP_GD32F107VC
        bool "GD32F107VC"

    config TEMP_GD32F107VD
        bool "GD32F107VD"

    config TEMP_GD32F107VE
        bool "GD32F107VE"

    config TEMP_GD32F107VF
        bool "GD32F107VF"

    config TEMP_GD32F107VG
        bool "GD32F107VG"

    config TEMP_GD32F107ZC
        bool "GD32F107ZC"

    config TEMP_GD32F107ZD
        bool "GD32F107ZD"

    config TEMP_GD32F107ZE
        bool "GD32F107ZE"

    config TEMP_GD32F107ZF
        bool "GD32F107ZF"

    config TEMP_GD32F107ZG
        bool "GD32F107ZG"


endchoice
```

## templates/configs/gd/f20x/Kconfig
```kconfig
choice
    prompt "|----MODEL"
        default MODEL_GD32F205
    help
        Select the device in GD32F20x


    config MODEL_GD32F205
        bool "GD32F205"

    config MODEL_GD32F207
        bool "GD32F207"


endchoice


if MODEL_GD32F205
    source "$OS_ROOT/templates/configs/gd/f20x/f205/Kconfig"
endif

if MODEL_GD32F207
    source "$OS_ROOT/templates/configs/gd/f20x/f207/Kconfig"
endif
```

## templates/configs/gd/f20x/f205/Kconfig
```kconfig
choice
    prompt "|------SUB MODEL"
        default TEMP_GD32F205RG
    help
        Select the device in GD32F205xx


    config TEMP_GD32F205RC
        bool "GD32F205RC"

    config TEMP_GD32F205RE
        bool "GD32F205RE"

    config TEMP_GD32F205RG
        bool "GD32F205RG"

    config TEMP_GD32F205RK
        bool "GD32F205RK"

    config TEMP_GD32F205VC
        bool "GD32F205VC"

    config TEMP_GD32F205VE
        bool "GD32F205VE"

    config TEMP_GD32F205VG
        bool "GD32F205VG"

    config TEMP_GD32F205VK
        bool "GD32F205VK"

    config TEMP_GD32F205ZC
        bool "GD32F205ZC"

    config TEMP_GD32F205ZE
        bool "GD32F205ZE"

    config TEMP_GD32F205ZG
        bool "GD32F205ZG"

    config TEMP_GD32F205ZK
        bool "GD32F205ZK"

endchoice
```

## templates/configs/gd/f20x/f207/Kconfig
```kconfig
choice
    prompt "|------SUB MODEL"
        default TEMP_GD32F207RC
    help
        Select the device in GD32F207xx


    config TEMP_GD32F207RC
        bool "GD32F207RC"

    config TEMP_GD32F207RE
        bool "GD32F207RE"

    config TEMP_GD32F207RG
        bool "GD32F207RG"

    config TEMP_GD32F207RK
        bool "GD32F207RK"

    config TEMP_GD32F207VC
        bool "GD32F207VC"

    config TEMP_GD32F207VE
        bool "GD32F207VE"

    config TEMP_GD32F207VG
        bool "GD32F207VG"

    config TEMP_GD32F207VK
        bool "GD32F207VK"

    config TEMP_GD32F207ZC
        bool "GD32F207ZC"

    config TEMP_GD32F207ZE
        bool "GD32F207ZE"

    config TEMP_GD32F207ZG
        bool "GD32F207ZG"

    config TEMP_GD32F207ZK
        bool "GD32F207ZK"

    config TEMP_GD32F207IE
        bool "GD32F207IE"

    config TEMP_GD32F207IG
        bool "GD32F207IG"

    config TEMP_GD32F207IK
        bool "GD32F207IK"
        
endchoice
```

## templates/configs/gd/f30x/Kconfig
```kconfig
choice
    prompt "|----MODEL"
        default MODEL_GD32F303
    help
        Select the device in GD32F30x

    config MODEL_GD32F303
        bool "GD32F303"
    
    config MODEL_GD32F305
        bool "GD32F305"
    
    config MODEL_GD32F307
        bool "GD32F307"

endchoice

if MODEL_GD32F303
    source "$OS_ROOT/templates/configs/gd/f30x/f303/Kconfig"
endif

if MODEL_GD32F305
    source "$OS_ROOT/templates/configs/gd/f30x/f305/Kconfig"
endif

if MODEL_GD32F307
    source "$OS_ROOT/templates/configs/gd/f30x/f307/Kconfig"
endif
```

## templates/configs/gd/f30x/f303/Kconfig
```kconfig
choice
    prompt "|------SUB MODEL"
        default TEMP_GD32F303CC
    help
        Select the device in GD32F303xx

    config TEMP_GD32F303CC
        bool "GD32F303CC"
        
    config TEMP_GD32F303CE
        bool "GD32F303CE"
    
    config TEMP_GD32F303CG
        bool "GD32F303CG"
        
    config TEMP_GD32F303RC
        bool "GD32F303RC"
        
    config TEMP_GD32F303RE
        bool "GD32F303RE"
    
    config TEMP_GD32F303RG
        bool "GD32F303RG"
        
    config TEMP_GD32F303RI
        bool "GD32F303RI"
    
    config TEMP_GD32F303RK
        bool "GD32F303RK"
        
    config TEMP_GD32F303VC
        bool "GD32F303VC"
		
    config TEMP_GD32F303VE
        bool "GD32F303VE"
		
    config TEMP_GD32F303VG
        bool "GD32F303VG"
	
    config TEMP_GD32F303VI
        bool "GD32F303VI"
		
    config TEMP_GD32F303VK
        bool "GD32F303VK"
		
    config TEMP_GD32F303ZC
        bool "GD32F303ZC"
		
    config TEMP_GD32F303ZE
        bool "GD32F303ZE"
		
    config TEMP_GD32F303ZG
        bool "GD32F303ZG"
	
    config TEMP_GD32F303ZI
        bool "GD32F303ZI"
		
    config TEMP_GD32F303ZK
        bool "GD32F303ZK"

endchoice
```

## templates/configs/gd/f30x/f305/Kconfig
```kconfig
choice
    prompt "|------SUB MODEL"
        default TEMP_GD32F305RB
    help
        Select the device in GD32F305xx

    config TEMP_GD32F305RB
        bool "GD32F305RB"

    config TEMP_GD32F305RC
        bool "GD32F305RC"
        
    config TEMP_GD32F305RE
        bool "GD32F305RE"
    
    config TEMP_GD32F305RG
        bool "GD32F305RG"
        
    config TEMP_GD32F305VC
        bool "GD32F305VC"
    
    config TEMP_GD32F305VE
        bool "GD32F305VE"
        
    config TEMP_GD32F305VG
        bool "GD32F305VG"
    
    config TEMP_GD32F305ZC
        bool "GD32F305ZC"
        
    config TEMP_GD32F305ZE
        bool "GD32F305ZE"
    
    config TEMP_GD32F305ZG
        bool "GD32F305ZG"
        
endchoice
```

## templates/configs/gd/f30x/f307/Kconfig
```kconfig
choice
    prompt "|------SUB MODEL"
        default TEMP_GD32F307RC
    help
        Select the device in GD32F307xx

    config TEMP_GD32F307RC
        bool "GD32F307RC"
        
    config TEMP_GD32F307RE
        bool "GD32F307RE"
    
    config TEMP_GD32F307RG
        bool "GD32F307RG"
        
    config TEMP_GD32F307VC
        bool "GD32F307VC"
    
    config TEMP_GD32F307VE
        bool "GD32F307VE"
        
    config TEMP_GD32F307VG
        bool "GD32F307VG"
    
    config TEMP_GD32F307ZC
        bool "GD32F307ZC"
        
    config TEMP_GD32F307ZE
        bool "GD32F307ZE"
    
    config TEMP_GD32F307ZG
        bool "GD32F307ZG"
        
endchoice
```

## templates/configs/gd/f3x0/Kconfig
```kconfig
choice
    prompt "|----MODEL"
        default MODEL_GD32F330
    help
        Select the device in GD32F3x0

    config MODEL_GD32F330
        bool "GD32F330"
    
    config MODEL_GD32F350
        bool "GD32F350"

endchoice

if MODEL_GD32F330
    source "$OS_ROOT/templates/configs/gd/f3x0/f330/Kconfig"
endif

if MODEL_GD32F350
    source "$OS_ROOT/templates/configs/gd/f3x0/f350/Kconfig"
endif
```

## templates/configs/gd/f3x0/f330/Kconfig
```kconfig
choice
    prompt "|------SUB MODEL"
        default TEMP_GD32F330CB
    help
        Select the device in GD32F330xx

    config TEMP_GD32F330CB
        bool "GD32F330CB"
        
    config TEMP_GD32F330R8
        bool "GD32F330R8"
        
    config TEMP_GD32F330RB
        bool "GD32F330RB"
    
    

endchoice
```

## templates/configs/gd/f3x0/f350/Kconfig
```kconfig
choice
    prompt "|------SUB MODEL"
        default TEMP_GD32F350CB
    help
        Select the device in GD32F350xx

    config TEMP_GD32F350CB
        bool "GD32F350CB"
    
    config TEMP_GD32F350R8
        bool "GD32F350R8"
        
    config TEMP_GD32F350RB
        bool "GD32F350RB"
    
    

endchoice
```

## templates/configs/gd/f403/Kconfig
```kconfig
choice
    prompt "|----MODEL"
        default MODEL_GD32F403
    help
        Select the device in GD32F403

    config MODEL_GD32F403
        bool "GD32F403"

endchoice

if MODEL_GD32F403
    source "$OS_ROOT/templates/configs/gd/f403/f403/Kconfig"
endif
```

## templates/configs/gd/f403/f403/Kconfig
```kconfig
choice
    prompt "|------SUB MODEL"
        default TEMP_GD32F403RC
    help
        Select the device in GD32F403xx

    config TEMP_GD32F403RC
        bool "GD32F403RC"
    
    config TEMP_GD32F403RE
        bool "GD32F403RE"
        
    config TEMP_GD32F403RG
        bool "GD32F403RG"
    
    config TEMP_GD32F403RI
        bool "GD32F403RI"
    
    config TEMP_GD32F403RK
        bool "GD32F403RK"
    
    config TEMP_GD32F403VC
        bool "GD32F403VC"
    
    config TEMP_GD32F403VE
        bool "GD32F403VE"
    
    config TEMP_GD32F403VG
        bool "GD32F403VG"
        
    config TEMP_GD32F403VI
        bool "GD32F403VI"
        
    config TEMP_GD32F403VK
        bool "GD32F403VK"
    
    config TEMP_GD32F403ZC
        bool "GD32F403ZC"
    
    config TEMP_GD32F403ZE
        bool "GD32F403ZE"
    
    config TEMP_GD32F403ZG
        bool "GD32F403ZG"
        
    config TEMP_GD32F403ZI
        bool "GD32F403ZI"
        
    config TEMP_GD32F403ZK
        bool "GD32F403ZK"

endchoice
```

## templates/configs/gd/f4xx/Kconfig
```kconfig
choice
    prompt "|----MODEL"
        default MODEL_GD32F405
    help
        Select the device in GD32F4xx

    config MODEL_GD32F405
        bool "GD32F405"
    
    config MODEL_GD32F407
        bool "GD32F407"
    
    config MODEL_GD32F450
        bool "GD32F450"

endchoice

if MODEL_GD32F405
    source "$OS_ROOT/templates/configs/gd/f4xx/f405/Kconfig"
endif

if MODEL_GD32F407
    source "$OS_ROOT/templates/configs/gd/f4xx/f407/Kconfig"
endif

if MODEL_GD32F450
    source "$OS_ROOT/templates/configs/gd/f4xx/f450/Kconfig"
endif
```
