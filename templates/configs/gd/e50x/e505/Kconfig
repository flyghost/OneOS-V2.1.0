## templates/configs/gd/f4xx/f405/Kconfig
```kconfig
choice
    prompt "|------SUB MODEL"
        default TEMP_GD32F405RE
    help
        Select the device in GD32F405xx
      
    config TEMP_GD32F405RE
        bool "GD32F405RE"
    
    config TEMP_GD32F405RG
        bool "GD32F405RG"
    
    config TEMP_GD32F405RK
        bool "GD32F405RK"
    
    config TEMP_GD32F405VG
        bool "GD32F405VG"
        
    config TEMP_GD32F405VK
        bool "GD32F405VK"
    
    config TEMP_GD32F405ZG
        bool "GD32F405ZG"
        
    config TEMP_GD32F405ZK
        bool "GD32F405ZK"

endchoice
```

## templates/configs/gd/f4xx/f407/Kconfig
```kconfig
choice
    prompt "|------SUB MODEL"
        default TEMP_GD32F407RE
    help
        Select the device in GD32F407xx

    config TEMP_GD32F407RE
        bool "GD32F407RE"
    
    config TEMP_GD32F407RG
        bool "GD32F407RG"
    
    config TEMP_GD32F407RK
        bool "GD32F407RK"
    
    config TEMP_GD32F407VE
        bool "GD32F407VE"
    
    config TEMP_GD32F407VG
        bool "GD32F407VG"
        
    config TEMP_GD32F407VK
        bool "GD32F407VK"
    
    config TEMP_GD32F407ZE
        bool "GD32F407ZE"
    
    config TEMP_GD32F407ZG
        bool "GD32F407ZG"
        
    config TEMP_GD32F407ZK
        bool "GD32F407ZK"
        
    config TEMP_GD32F407IE
        bool "GD32F407IE"
		
    config TEMP_GD32F407IG
        bool "GD32F407IG"
    
    config TEMP_GD32F407IK
        bool "GD32F407IK"
    

endchoice
```

## templates/configs/gd/f4xx/f450/Kconfig
```kconfig
choice
    prompt "|------SUB MODEL"
        default TEMP_GD32F450VE
    help
        Select the device in GD32F450xx
    
    config TEMP_GD32F450VE
        bool "GD32F450VE"
    
    config TEMP_GD32F450VG
        bool "GD32F450VG"
        
    config TEMP_GD32F450VI
        bool "GD32F450VI"
        
    config TEMP_GD32F450VK
        bool "GD32F450VK"
    
    config TEMP_GD32F450ZE
        bool "GD32F450ZE"
    
    config TEMP_GD32F450ZG
        bool "GD32F450ZG"
    
    config TEMP_GD32F450ZI
        bool "GD32F450ZI"
    
    config TEMP_GD32F450ZK
        bool "GD32F450ZK"
        
    config TEMP_GD32F450IG
        bool "GD32F450IG"
    
    config TEMP_GD32F450II
        bool "GD32F450II"
    
    config TEMP_GD32F450IK
        bool "GD32F450IK"

endchoice
```

## templates/configs/gd32v/Kconfig
```kconfig
choice
    prompt "|--SERIES"
        default SERIES_GD32VF10x
    help
        GD32VF10x

    config SERIES_GD32VF10x
        bool "GD32VF10x"
        
endchoice

if SERIES_GD32VF10x
    source "$OS_ROOT/templates/configs/gd32v/f10x/Kconfig"
endif
```

## templates/configs/gd32v/f10x/Kconfig
```kconfig
choice
    prompt "|----MODEL"
        default MODEL_GD32VF103
    help
        Select the device in GD32VF10x

    config MODEL_GD32VF103
        bool "GD32VF103"
    
endchoice

if MODEL_GD32VF103
    source "$OS_ROOT/templates/configs/gd32v/f10x/f103/Kconfig"
endif
```
