## templates/configs/gd32v/f10x/f103/Kconfig
```kconfig
choice
    prompt "|------SUB MODEL"
        default TEMP_GD32VF103CBT6
    help
        Select the device in GD32VF103xx

    config TEMP_GD32VF103CBT6
        bool "GD32VF103CBT6"

    config TEMP_gd32vf103-longan-nano
        bool "gd32vf103-longan-nano"
        
endchoice
```

## templates/configs/hdsc/Kconfig
```kconfig
choice
    prompt "|--SERIES"
        default SERIES_HC32L19
    help
        Select the device in HC32

    config SERIES_HC32F07
        bool "HC32F07"

    config SERIES_HC32F17
        bool "HC32F17"

    config SERIES_HC32F19
        bool "HC32F19"

    config SERIES_HC32F4A
        bool "HC32F4A"

    config SERIES_HC32F46
        bool "HC32F46"

    config SERIES_HC32L07
        bool "HC32L07"
     
    config SERIES_HC32L17
        bool "HC32L17"
        
    config SERIES_HC32L19
        bool "HC32L19"
   
endchoice

if SERIES_HC32F07
    source "$OS_ROOT/templates/configs/hdsc/f07/Kconfig"
endif

if SERIES_HC32F17
    source "$OS_ROOT/templates/configs/hdsc/f17/Kconfig"
endif

if SERIES_HC32F19
    source "$OS_ROOT/templates/configs/hdsc/f19/Kconfig"
endif

if SERIES_HC32F4A
    source "$OS_ROOT/templates/configs/hdsc/f4a/Kconfig"
endif

if SERIES_HC32F46
    source "$OS_ROOT/templates/configs/hdsc/f46/Kconfig"
endif

if SERIES_HC32L07
    source "$OS_ROOT/templates/configs/hdsc/l07/Kconfig"
endif

if SERIES_HC32L17
    source "$OS_ROOT/templates/configs/hdsc/l17/Kconfig"
endif

if SERIES_HC32L19
    source "$OS_ROOT/templates/configs/hdsc/l19/Kconfig"
endif
    
```

## templates/configs/hdsc/f07/Kconfig
```kconfig
choice
    prompt "|----MODEL"
        default MODEL_HC32F072
    help
        Select the device in HC32F07x

    config MODEL_HC32F072
        bool "HC32F072"

endchoice

if MODEL_HC32F072
    source "$OS_ROOT/templates/configs/hdsc/f07/f072/Kconfig"
endif
```

## templates/configs/hdsc/f07/f072/Kconfig
```kconfig
choice
    prompt "|------SUB MODEL"
        default TEMP_HC32F072PATA
    help
        Select the device in HC32F072xxxx

    config TEMP_HC32F072FAUA
        bool "HC32F072FAUA"
        
    config TEMP_HC32F072JATA
        bool "HC32F072JATA"

    config TEMP_HC32F072KATA
        bool "HC32F072KATA"

    config TEMP_HC32F072PATA
        bool "HC32F072PATA"

endchoice
```

## templates/configs/hdsc/f17/Kconfig
```kconfig
choice
    prompt "|----MODEL"
        default MODEL_HC32F176
    help
        Select the device in HC32F17x

    config MODEL_HC32F170
        bool "HC32F170"
        
    config MODEL_HC32F176
        bool "HC32F176"

endchoice

if MODEL_HC32F170
    source "$OS_ROOT/templates/configs/hdsc/f17/f170/Kconfig"
endif

if MODEL_HC32F176
    source "$OS_ROOT/templates/configs/hdsc/f17/f176/Kconfig"
endif
```

## templates/configs/hdsc/f17/f170/Kconfig
```kconfig
choice
    prompt "|------SUB MODEL"
        default TEMP_HC32F170JATA
    help
        Select the device in HC32F170xxxx

    config TEMP_HC32F170JATA
        bool "HC32F170JATA"
        
    config TEMP_HC32F170FAUA
        bool "HC32F170FAUA"

endchoice
```

## templates/configs/hdsc/f17/f176/Kconfig
```kconfig
choice
    prompt "|------SUB MODEL"
        default TEMP_HC32F176KATA
    help
        Select the device in HC32F176xxxx

    config TEMP_HC32F176KATA
        bool "HC32F176KATA"
        
    config TEMP_HC32F176JATA
        bool "HC32F176JATA"
        
    config TEMP_HC32F176MATA
        bool "HC32F176MATA"
        
    config TEMP_HC32F176PATA
        bool "HC32F176PATA"
        
endchoice
```

## templates/configs/hdsc/f19/Kconfig
```kconfig
choice
    prompt "|----MODEL"
        default MODEL_HC32F196
    help
        Select the device in HC32F19x

    config MODEL_HC32F190
        bool "HC32F190"
        
    config MODEL_HC32F196
        bool "HC32F196"

endchoice

if MODEL_HC32F190
    source "$OS_ROOT/templates/configs/hdsc/f19/f190/Kconfig"
endif

if MODEL_HC32F196
    source "$OS_ROOT/templates/configs/hdsc/f19/f196/Kconfig"
endif
```

## templates/configs/hdsc/f19/f190/Kconfig
```kconfig
choice
    prompt "|------SUB MODEL"
        default TEMP_HC32F190JCTA
    help
        Select the device in HC32F190xxxx

    config TEMP_HC32F190JCTA
        bool "HC32F190JCTA"
        
    config TEMP_HC32F190FCUA
        bool "HC32F190FCUA"

endchoice
```

## templates/configs/hdsc/f19/f196/Kconfig
```kconfig
choice
    prompt "|------SUB MODEL"
        default TEMP_HC32F196PCTA
    help
        Select the device in HC32F196xxxx

    config TEMP_HC32F196PCTA
        bool "HC32F196PCTA"

    config TEMP_HC32F196KCTA
        bool "HC32F196KCTA"

    config TEMP_HC32F196MCTA
        bool "HC32F196MCTA"

    config TEMP_HC32F196JCTA
        bool "HC32F196JCTA"

endchoice
```

## templates/configs/hdsc/f46/Kconfig
```kconfig
choice
    prompt "|----MODEL"
        default MODEL_HC32F460
    help
        Select the device in HC32F46x

    config MODEL_HC32F460
        bool "HC32F460"

endchoice

if MODEL_HC32F460
    source "$OS_ROOT/templates/configs/hdsc/f46/f460/Kconfig"
endif
```

## templates/configs/hdsc/f46/f460/Kconfig
```kconfig
choice
    prompt "|------SUB MODEL"
        default TEMP_HC32F460PETB
    help
        Select the device in HC32F460xxxx

    config TEMP_HC32F460JETA
        bool "HC32F460JETA"
        
    config TEMP_HC32F460JEUA
        bool "HC32F460JEUA"

    config TEMP_HC32F460KETA
        bool "HC32F460KETA"

    config TEMP_HC32F460KEUA
        bool "HC32F460KEUA"

    config TEMP_HC32F460PEHB
        bool "HC32F460PEHB"

    config TEMP_HC32F460PETB
        bool "HC32F460PETB"

endchoice
```

## templates/configs/hdsc/f4a/Kconfig
```kconfig
choice
    prompt "|----MODEL"
    default MODEL_HC32F4A0
    help
        Select the device in HC32F4Ax

    config MODEL_HC32F4A0
        bool "HC32F4A0"
endchoice

if MODEL_HC32F4A0
    source "$OS_ROOT/templates/configs/hdsc/f4a/f4a0/Kconfig"
endif
```

## templates/configs/hdsc/f4a/f4a0/Kconfig
```kconfig
choice
    prompt "|------SUB MODEL"
    default TEMP_HC32F4A0PITB
    help
        Select the device in HC32F4A0xxxx

    config TEMP_HC32F4A0PGTB
        bool "HC32F4A0PGTB"
        
    config TEMP_HC32F4A0PITB
        bool "HC32F4A0PITB"

    config TEMP_HC32F4A0RGTB
        bool "HC32F4A0RGTB"

    config TEMP_HC32F4A0RITB
        bool "HC32F4A0RITB"

    config TEMP_HC32F4A0SGHB
        bool "HC32F4A0SGHB"
        
    config TEMP_HC32F4A0SGTB
        bool "HC32F4A0SGTB"

    config TEMP_HC32F4A0SIHB
        bool "HC32F4A0SIHB"

    config TEMP_HC32F4A0SITB
        bool "HC32F4A0SITB"

    config TEMP_HC32F4A0TIHB
        bool "HC32F4A0TIHB"

endchoice
```

## templates/configs/hdsc/l07/Kconfig
```kconfig
choice
    prompt "|----MODEL"
        default MODEL_HC32L072
    help
        Select the device in HC32L07x

    config MODEL_HC32L072
        bool "HC32L072"
        
    config MODEL_HC32L073
        bool "HC32L073"

endchoice

if MODEL_HC32L072
    source "$OS_ROOT/templates/configs/hdsc/l07/l072/Kconfig"
endif

if MODEL_HC32L073
    source "$OS_ROOT/templates/configs/hdsc/l07/l073/Kconfig"
endif
```

## templates/configs/hdsc/l07/l072/Kconfig
```kconfig
choice
    prompt "|------SUB MODEL"
        default TEMP_HC32L072PATA
    help
        Select the device in HC32L072xxxx

    config TEMP_HC32L072FAUA
        bool "HC32L072FAUA"
        
    config TEMP_HC32L072JATA
        bool "HC32L072JATA"

    config TEMP_HC32L072KATA
        bool "HC32L072KATA"

    config TEMP_HC32L072PATA
        bool "HC32L072PATA"

endchoice
```

## templates/configs/hdsc/l07/l073/Kconfig
```kconfig
choice
    prompt "|------SUB MODEL"
        default TEMP_HC32L073PATA
    help
        Select the device in HC32L073xxxx

    config TEMP_HC32L073JATA
        bool "HC32L073JATA"

    config TEMP_HC32L073KATA
        bool "HC32L073KATA"

    config TEMP_HC32L073PATA
        bool "HC32L073PATA"

endchoice
```

## templates/configs/hdsc/l17/Kconfig
```kconfig
choice
    prompt "|----MODEL"
        default MODEL_HC32L176
    help
        Select the device in HC32L17x

    config MODEL_HC32L170
        bool "HC32L170"
        
    config MODEL_HC32L176
        bool "HC32L176"

endchoice

if MODEL_HC32L170
    source "$OS_ROOT/templates/configs/hdsc/l17/l170/Kconfig"
endif

if MODEL_HC32L176
    source "$OS_ROOT/templates/configs/hdsc/l17/l176/Kconfig"
endif
```

## templates/configs/hdsc/l17/l170/Kconfig
```kconfig
choice
    prompt "|------SUB MODEL"
        default TEMP_HC32L170JATA
    help
        Select the device in HC32L170xxxx

    config TEMP_HC32L170JATA
        bool "HC32L170JATA"
        
    config TEMP_HC32L170FAUA
        bool "HC32L170FAUA"

endchoice
```

## templates/configs/hdsc/l17/l176/Kconfig
```kconfig
choice
    prompt "|------SUB MODEL"
        default TEMP_HC32L176KATA
    help
        Select the device in HC32L176xxxx

    config TEMP_HC32L176KATA
        bool "HC32L176KATA"
        
    config TEMP_HC32L176JATA
        bool "HC32L176JATA"
        
    config TEMP_HC32L176MATA
        bool "HC32L176MATA"
        
    config TEMP_HC32L176PATA
        bool "HC32L176PATA"
        
endchoice
```

## templates/configs/hdsc/l19/Kconfig
```kconfig
choice
    prompt "|----MODEL"
        default MODEL_HC32L196
    help
        Select the device in HC32L19x

    config MODEL_HC32L190
        bool "HC32L190"
        
    config MODEL_HC32L196
        bool "HC32L196"

endchoice

if MODEL_HC32L190
    source "$OS_ROOT/templates/configs/hdsc/l19/l190/Kconfig"
endif

if MODEL_HC32L196
    source "$OS_ROOT/templates/configs/hdsc/l19/l196/Kconfig"
endif
```

## templates/configs/hdsc/l19/l190/Kconfig
```kconfig
choice
    prompt "|------SUB MODEL"
        default TEMP_HC32L190JCTA
    help
        Select the device in HC32L190xxxx

    config TEMP_HC32L190JCTA
        bool "HC32L190JCTA"
        
    config TEMP_HC32L190FCUA
        bool "HC32L190FCUA"

endchoice
```

## templates/configs/hdsc/l19/l196/Kconfig
```kconfig
choice
    prompt "|------SUB MODEL"
        default TEMP_HC32L196PCTA
    help
        Select the device in HC32L196xxxx

    config TEMP_HC32L196PCTA
        bool "HC32L196PCTA"

    config TEMP_HC32L196KCTA
        bool "HC32L196KCTA"

    config TEMP_HC32L196MCTA
        bool "HC32L196MCTA"

    config TEMP_HC32L196JCTA
        bool "HC32L196JCTA"

    config TEMP_hc32l196pcta-stk
        bool "hc32l196pcta-stk"

endchoice
```

## templates/configs/hk32/Kconfig
```kconfig
choice
    prompt "|--SERIES"
        default SERIES_HK32F1
    help
        Select the device in HK32
        
    config SERIES_HK32F0
        bool "HK32F0"
        
    config SERIES_HK32F1
        bool "HK32F1"
        
    config SERIES_HK32L0
        bool "HK32L0"
        
    config SERIES_HK32F3
        bool "HK32F3"
        
endchoice

if SERIES_HK32F0
    source "$OS_ROOT/templates/configs/hk32/f0/Kconfig"
endif

if SERIES_HK32F1
    source "$OS_ROOT/templates/configs/hk32/f1/Kconfig"
endif

if SERIES_HK32L0
    source "$OS_ROOT/templates/configs/hk32/l0/Kconfig"
endif

if SERIES_HK32F3
    source "$OS_ROOT/templates/configs/hk32/f3/Kconfig"
endif
```

## templates/configs/hk32/f0/Kconfig
```kconfig
choice
    prompt "|----MODEL"
        default MODEL_HK32F030
    help
        Select the device in HK32F0xx

    config MODEL_HK32F030
        bool "HK32F030"

    config MODEL_HK32F031
        bool "HK32F031"
        
    config MODEL_HK32F04A
        bool "HK32F04A"
        
endchoice

if MODEL_HK32F030
    source "$OS_ROOT/templates/configs/hk32/f0/f030/Kconfig"
endif

if MODEL_HK32F031
    source "$OS_ROOT/templates/configs/hk32/f0/f031/Kconfig"
endif

if MODEL_HK32F04A
    source "$OS_ROOT/templates/configs/hk32/f0/f04a/Kconfig"
endif
```
