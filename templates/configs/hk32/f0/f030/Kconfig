## templates/configs/hk32/f0/f030/Kconfig
```kconfig
choice
    prompt "|------SUB MODEL"
        default TEMP_HK32F030RBT6
    help
        Select the device in HK32F030

    config TEMP_HK32F030RBT6
        bool "HK32F030RBT6"
        
    config TEMP_HK32F030CBT6
        bool "HK32F030CBT6"
        
    config TEMP_HK32F030KBT6
        bool "HK32F030KBT6"
        
    config TEMP_HK32F030FBP6
        bool "HK32F030FBP6"
        
endchoice
```

## templates/configs/hk32/f0/f031/Kconfig
```kconfig
choice
    prompt "|------SUB MODEL"
        default TEMP_HK32F031CBT6
    help
        Select the device in HK32F031

    config TEMP_HK32F031CBT6
        bool "HK32F031CBT6"
        
    config TEMP_HK32F031KBT6
        bool "HK32F031KBT6"
        
    config TEMP_HK32F031KBU6
        bool "HK32F031KBU6"
        
    config TEMP_HK32F031GBU6
        bool "HK32F031GBU6"
        
    config TEMP_HK32F031FBP6
        bool "HK32F031FBP6"
        
endchoice
```

## templates/configs/hk32/f0/f04a/Kconfig
```kconfig
choice
    prompt "|------SUB MODEL"
        default TEMP_HK32F04ARBT6
    help
        Select the device in HK32F04A

    config TEMP_HK32F04ARBT6
        bool "HK32F04ARBT6"
        
    config TEMP_HK32F04ACBT6
        bool "HK32F04ACBT6"
        
    config TEMP_HK32F04AKBT6
        bool "HK32F04AKBT6"
        
    config TEMP_HK32F04AKBU6
        bool "HK32F04AKBU6"
        
    config TEMP_HK32F04AGBU6
        bool "HK32F04AGBU6"
        
    config TEMP_HK32F04AFBP6
        bool "HK32F04AFBP6"
        
endchoice
```

## templates/configs/hk32/f1/Kconfig
```kconfig
choice
    prompt "|----MODEL"
        default MODEL_HK32F103
    help
        Select the device in HK32F1xx

    config MODEL_HK32F103
        bool "HK32F103"

endchoice

if MODEL_HK32F103
    source "$OS_ROOT/templates/configs/hk32/f1/f103/Kconfig"
endif
```

## templates/configs/hk32/f1/f103/Kconfig
```kconfig
choice
    prompt "|------SUB MODEL"
        default TEMP_hk32f103-hk-mini
    help
        Select the device in HK32F103xx

    config TEMP_HK32F103RBT6
        bool "HK32F103RBT6"

    config TEMP_HK32F103R8T6
        bool "HK32F103R8T6"

    config TEMP_HK32F103CBT6
        bool "HK32F103CBT6"

    config TEMP_HK32F103C8T6
        bool "HK32F103C8T6"

    config TEMP_HK32F103VBT6A
        bool "HK32F103VBT6A"

    config TEMP_HK32F103V8T6A
        bool "HK32F103V8T6A"

    config TEMP_HK32F103RBT6A
        bool "HK32F103RBT6A"

    config TEMP_HK32F103R8T6A
        bool "HK32F103R8T6A"

    config TEMP_HK32F103CBT6A
        bool "HK32F103CBT6A"

    config TEMP_HK32F103C8T6A
        bool "HK32F103C8T6A"

    config TEMP_HK32F103VET6
        bool "HK32F103VET6"

    config TEMP_HK32F103VDT6
        bool "HK32F103VDT6"

    config TEMP_HK32F103VCT6
        bool "HK32F103VCT6"

    config TEMP_HK32F103RET6
        bool "HK32F103RET6"

    config TEMP_HK32F103RDT6
        bool "HK32F103RDT6"

    config TEMP_HK32F103RCT6
        bool "HK32F103RCT6"
		
    config TEMP_hk32f103-hk-mini
        bool "hk32f103-hk-mini"
        
endchoice
```

## templates/configs/hk32/f3/Kconfig
```kconfig
choice
    prompt "|----MODEL"
        default MODEL_HK32F39A
    help
        Select the device in HK32F3xx

    config MODEL_HK32F39A
        bool "HK32F39A"

endchoice

if MODEL_HK32F39A
    source "$OS_ROOT/templates/configs/hk32/f3/f39a/Kconfig"
endif
```

## templates/configs/hk32/f3/f39a/Kconfig
```kconfig
choice
    prompt "|------SUB MODEL"
        default TEMP_HK32F39ARET6
    help
        Select the device in HK32F39A

    config TEMP_HK32F39ARET6
        bool "HK32F39ARET6"
        
endchoice
```

## templates/configs/hk32/l0/Kconfig
```kconfig
choice
    prompt "|----MODEL"
        default MODEL_HK32L083
    help
        Select the device in HK32F1xx

    config MODEL_HK32L083
        bool "HK32L083"

endchoice

if MODEL_HK32L083
    source "$OS_ROOT/templates/configs/hk32/l0/l083/Kconfig"
endif

if MODEL_HK32L084
    source "$OS_ROOT/templates/configs/hk32/l0/l084/Kconfig"
endif

if MODEL_HK32L088
    source "$OS_ROOT/templates/configs/hk32/l0/l088/Kconfig"
endif
```

## templates/configs/hk32/l0/l083/Kconfig
```kconfig
choice
    prompt "|------SUB MODEL"
        default TEMP_HK32L083RBT6
    help
        Select the device in HK32L083

    config TEMP_HK32L083RBT6
        bool "HK32L083RBT6"
        
endchoice
```

## templates/configs/hk32/l0/l084/Kconfig
```kconfig
choice
    prompt "|------SUB MODEL"
        default TEMP_HK32L084CBT6
    help
        Select the device in HK32L084

    config TEMP_HK32L084CBT6
        bool "HK32L084CBT6"

    config TEMP_HK32L084RBT6
        bool "HK32L084RBT6"
        
endchoice
```

## templates/configs/hk32/l0/l088/Kconfig
```kconfig
choice
    prompt "|------SUB MODEL"
        default TEMP_HK32L088C8T6
    help
        Select the device in HK32L088

    config TEMP_HK32L088C8T6
        bool "HK32L088C8T6"
    
    config TEMP_HK32L088R8T6
        bool "HK32L088R8T6"
    
endchoice
```

## templates/configs/ingenic/Kconfig
```kconfig
choice
    prompt "|--SERIES"
        default SERIES_XBURST
    help
        XBURXT

    config SERIES_XBURST
        bool "XBURST"
        
endchoice

if SERIES_XBURST
    source "$OS_ROOT/templates/configs/ingenic/xburst/Kconfig"
endif
```

## templates/configs/ingenic/xburst/Kconfig
```kconfig
choice
    prompt "|----MODEL"
        default MODEL_X1000X
    help
        Select the device in XBURST

    config MODEL_X1000X
        bool "X1000X"
    
endchoice

if MODEL_X1000X
    source "$OS_ROOT/templates/configs/ingenic/xburst/x1000x/Kconfig"
endif
```

## templates/configs/ingenic/xburst/x1000x/Kconfig
```kconfig
choice
    prompt "|------SUB MODEL"
        default TEMP_x1000e
    help
        Select the device in X1000X

    config TEMP_x1000e
        bool "x1000e"

    config TEMP_x1000-halley2-baseboard
        bool "x1000-halley2-baseboard"
        
endchoice
```

## templates/configs/mm32/Kconfig
```kconfig
choice
    prompt "|--SERIES"
        default SERIES_MM32F327XX
    help
        Select the device in MM32

    config SERIES_MM32F013XX
        bool "MM32F013XX"
        
    config SERIES_MM32F027XX
        bool "MM32F027XX"

    config SERIES_MM32F103XX
        bool "MM32F103XX"
        
    config SERIES_MM32L3XX
        bool "MM32L3XX"
        
    config SERIES_MM32F327XX
        bool "MM32F327XX"
        
    config SERIES_MM32SPIN2XX
        bool "MM32SPIN2XX"
        
    config SERIES_MM32W3XX
        bool "MM32WXX"
        
endchoice

if SERIES_MM32F103XX
    source "$OS_ROOT/templates/configs/mm32/f103xx/Kconfig"
endif

if SERIES_MM32F027XX
    source "$OS_ROOT/templates/configs/mm32/f027xx/Kconfig"
endif

if SERIES_MM32F013XX
    source "$OS_ROOT/templates/configs/mm32/f013xx/Kconfig"
endif

if SERIES_MM32L3XX
    source "$OS_ROOT/templates/configs/mm32/l3xx/Kconfig"
endif

if SERIES_MM32F327XX
    source "$OS_ROOT/templates/configs/mm32/f327xx/Kconfig"
endif

if SERIES_MM32SPIN2XX
    source "$OS_ROOT/templates/configs/mm32/spin2xx/Kconfig"
endif

if SERIES_MM32W3XX
    source "$OS_ROOT/templates/configs/mm32/w3xx/Kconfig"
endif
```

## templates/configs/mm32/f013xx/Kconfig
```kconfig
choice
    prompt "|----MODEL"
        default TEMP_MM32F0131C4N
    help
        Select the device in MM32F013XX

    config TEMP_MM32F0131C4N
        bool "MM32F0131C4N"

    config TEMP_MM32F0131C4P
        bool "MM32F0131C4P"

    config TEMP_MM32F0131C6P
        bool "MM32F0131C6P"

    config TEMP_MM32F0132C4N
        bool "MM32F0132C4N"

    config TEMP_MM32F0132C4P
        bool "MM32F0132C4P"

    config TEMP_MM32F0132C6P
        bool "MM32F0132C6P"
        
    config TEMP_MM32F0132C7P
        bool "MM32F0132C7P"
        
    config TEMP_MM32F0133C4P
        bool "MM32F0133C4P"

    config TEMP_MM32F0133C4N
        bool "MM32F0133C4N"

    config TEMP_MM32F0133C6P
        bool "MM32F0133C6P"

    config TEMP_MM32F0133C7P
        bool "MM32F0133C7P"

endchoice
```

## templates/configs/mm32/f027xx/Kconfig
```kconfig
choice
    prompt "|----MODEL"
        default TEMP_MM32F0271D6P
    help
        Select the device in MM32F027X

    config TEMP_MM32F0271D6P
        bool "MM32F0271D6P"

    config TEMP_MM32F0271D7P
        bool "MM32F0271D7P"

    config TEMP_MM32F0271D8P
        bool "MM32F0271D8P"

    config TEMP_MM32F0272D6P
        bool "MM32F0272D6P"

    config TEMP_MM32F0272D7P
        bool "MM32F0272D7P"

    config TEMP_MM32F0272D8P
        bool "MM32F0272D8P"

    config TEMP_MM32F0273D6P
        bool "MM32F0273D6P"

    config TEMP_MM32F0273D7P
        bool "MM32F0273D7P"

    config TEMP_MM32F0273D8P
        bool "MM32F0273D8P"

endchoice
```

## templates/configs/mm32/f103xx/Kconfig
```kconfig
choice
    prompt "|----MODEL"
        default TEMP_MM32F103C8T6
    help
        Select the device in MM32F103XX

    config TEMP_MM32F103C8T6
        bool "MM32F103C8T6"

    config TEMP_MM32F103CBT6
        bool "MM32F103CBT6"

    config TEMP_MM32F103K8T6
        bool "MM32F103K8T6"

    config TEMP_MM32F103KBT6
        bool "MM32F103KBT6"

    config TEMP_MM32F103KBU6
        bool "MM32F103KBU6"

    config TEMP_MM32F103R8T6
        bool "MM32F103R8T6"

    config TEMP_MM32F103RBT6
        bool "MM32F103RBT6"

endchoice
```

## templates/configs/mm32/f327xx/Kconfig
```kconfig
choice
    prompt "|----MODEL"
        default TEMP_mm32f3277g8p-cmcc-oneos
    help
        Select the device in MM32F327X

    config TEMP_MM32F3273E7P
        bool "MM32F3273E7P"

    config TEMP_MM32F3273E8P
        bool "MM32F3273E8P"

    config TEMP_MM32F3273G7P
        bool "MM32F3273G7P"

    config TEMP_MM32F3273G8P
        bool "MM32F3273G8P"

    config TEMP_MM32F3277E7P
        bool "MM32F3277E7P"

    config TEMP_MM32F3277E8P
        bool "MM32F3277E8P"

    config TEMP_MM32F3277E9P
        bool "MM32F3277E9P"

    config TEMP_MM32F3277G7P
        bool "MM32F3277G7P"

    config TEMP_MM32F3277G8P
        bool "MM32F3277G8P"

    config TEMP_MM32F3277G9P
        bool "MM32F3277G9P"

    config TEMP_mm32f3277g7p-eminiboard-seekfree
        bool "mm32f3277g7p-eminiboard-seekfree"
        
    config TEMP_mm32f3277g8p-cmcc-oneos
        bool "mm32f3277g8p-cmcc-oneos"

endchoice
```

## templates/configs/mm32/l3xx/Kconfig
```kconfig
choice
    prompt "|----MODEL"
        default TEMP_MM32L373PF
    help
        Select the device in MM32L3XX

    config TEMP_MM32L362PF
        bool "MM32L362PF"
        
    config TEMP_MM32L362NT
        bool "MM32L362NT"
        
    config TEMP_MM32L373PF
        bool "MM32L373PF"
        
    config TEMP_MM32L373PS
        bool "MM32L373PS"
        
endchoice
```

## templates/configs/mm32/spin2xx/Kconfig
```kconfig
choice
    prompt "|----MODEL"
        default TEMP_MM32SPIN320B
    help
        Select the device in MM32SPIN2XX
        
    config TEMP_MM32SPIN27PS
        bool "MM32SPIN27PF"
        
    config TEMP_MM32SPIN320B
        bool "MM32SPIN320B"
        
    config TEMP_MM32SPIN360C
        bool "MM32SPIN360C"
        
    config TEMP_MM32SPIN422C
        bool "MM32SPIN422C"
        
    config TEMP_MM32SPIN423C
        bool "MM32SPIN423C"
        
endchoice
```

## templates/configs/mm32/w3xx/Kconfig
```kconfig
choice
    prompt "|---- MODEL"
        default TEMP_MM32W362PFB
    help
        Select the device in MM32W3XX
        
    config TEMP_MM32W362PFB
        bool "MM32W362PFB"
        
    config TEMP_MM32W362PSB
        bool "MM32W362PSB"
        
    config TEMP_MM32W373PFB
        bool "MM32W373PFB"
        
    config TEMP_MM32W373PSB
        bool "MM32W373PSB"
        
endchoice
```

## templates/configs/nrf/Kconfig
```kconfig
choice
    prompt "|--SERIES"
        default SERIES_NRF52
    help
        Select the device in NRF

    config SERIES_NRF52
        bool "NRF52"
		
endchoice

if SERIES_NRF52
    source "$OS_ROOT/templates/configs/nrf/nrf52/Kconfig"
endif
```

## templates/configs/nrf/nrf52/Kconfig
```kconfig
choice
    prompt "|----MODEL"
        default MODEL_NRF52840
    help
        Select the device in NRF52

    config MODEL_NRF52832
        bool "NRF52832"
		
    config MODEL_NRF52840
        bool "NRF52840"
		
endchoice

if MODEL_NRF52832
    source "$OS_ROOT/templates/configs/nrf/nrf52/nrf52832/Kconfig"
endif

if MODEL_NRF52840
    source "$OS_ROOT/templates/configs/nrf/nrf52/nrf52840/Kconfig"
endif
```

## templates/configs/nrf/nrf52/nrf52832/Kconfig
```kconfig
choice
    prompt "|------SUB MODEL"
        default TEMP_nrf52832-pca10040
    help
        Select the device in nRF52832

    config TEMP_nrf52832-pca10040
        bool "nrf52832-pca10040"
endchoice
```
