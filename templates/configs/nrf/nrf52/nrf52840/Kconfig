## templates/configs/nrf/nrf52/nrf52840/Kconfig
```kconfig
choice
    prompt "|------SUB MODEL"
        default TEMP_nrf52840-pca10056
    help
        Select the device in nRF52840

    config TEMP_nrf52840-pca10056
        bool "nrf52840-pca10056"
endchoice
```

## templates/configs/nxp/Kconfig
```kconfig
choice
    prompt "|--SERIES"
        default SERIES_NXP_LPC5500
    help
        Select the device in nxp series
        
    config SERIES_NXP_LPC5500
        bool "LPC5500"

endchoice

if SERIES_NXP_LPC5500
    source "$OS_ROOT/templates/configs/nxp/lpc5500/Kconfig"
endif
```

## templates/configs/nxp/lpc5500/Kconfig
```kconfig
choice
    prompt "|----MODEL"
        default MODEL_LPC55S6X
    help
        Select the device in LPC5500
        
    config MODEL_LPC55S6X
        bool "LPC55S6X"
        
endchoice

if MODEL_LPC55S6X
    source "$OS_ROOT/templates/configs/nxp/lpc5500/lpc55s6x/Kconfig"
endif
```

## templates/configs/nxp/lpc5500/lpc55s6x/Kconfig
```kconfig
choice
    prompt "|------SUB MODEL"
        default TEMP_lpc55s69-nxp-evk
    help
        Select the device in LPC55S6X

    config TEMP_lpc55s69-nxp-evk
        bool "lpc55s69-nxp-exk"
        
endchoice
```

## templates/configs/st/Kconfig
```kconfig
choice
    prompt "|--SERIES"
        default SERIES_STM32F1
    help
        Select the device in STM32

    config SERIES_STM32L0
        bool "STM32L0"

    config SERIES_STM32F0
        bool "STM32F0"
        
    config SERIES_STM32F1
        bool "STM32F1"

     config SERIES_STM32F3
        bool "STM32F3"

    config SERIES_STM32F4
        bool "STM32F4"
        
    config SERIES_STM32F7
        bool "STM32F7"
    
    config SERIES_STM32G0
        bool "STM32G0"
        
    config SERIES_STM32G4
        bool "STM32G4"
        
    config SERIES_STM32L1
        bool "STM32L1"
        
    config SERIES_STM32L4
        bool "STM32L4"
    
    config SERIES_STM32L5
        bool "STM32L5"
    
    config SERIES_STM32H7
        bool "STM32H7"

    config SERIES_STM32MP1
        bool "STM32MP1"
        
endchoice

if SERIES_STM32L0
    source "$OS_ROOT/templates/configs/st/l0/Kconfig"
endif

if SERIES_STM32F0
    source "$OS_ROOT/templates/configs/st/f0/Kconfig"
endif

if SERIES_STM32F1
    source "$OS_ROOT/templates/configs/st/f1/Kconfig"
endif

if SERIES_STM32F3
    source "$OS_ROOT/templates/configs/st/f3/Kconfig"
endif

if SERIES_STM32F4
    source "$OS_ROOT/templates/configs/st/f4/Kconfig"
endif

if SERIES_STM32F7
    source "$OS_ROOT/templates/configs/st/f7/Kconfig"
endif

if SERIES_STM32G0
    source "$OS_ROOT/templates/configs/st/g0/Kconfig"
endif

if SERIES_STM32G4
    source "$OS_ROOT/templates/configs/st/g4/Kconfig"
endif

if SERIES_STM32L1
    source "$OS_ROOT/templates/configs/st/l1/Kconfig"
endif

if SERIES_STM32L4
    source "$OS_ROOT/templates/configs/st/l4/Kconfig"
endif

if SERIES_STM32L5
    source "$OS_ROOT/templates/configs/st/l5/Kconfig"
endif

if SERIES_STM32H7
    source "$OS_ROOT/templates/configs/st/h7/Kconfig"
endif      

if SERIES_STM32MP1
    source "$OS_ROOT/templates/configs/st/mp1/Kconfig"
endif      
```

## templates/configs/st/f0/Kconfig
```kconfig
choice
    prompt "|----MODEL"
        default MODEL_STM32F091
    help
        Select the device in STM32F0xx

    config MODEL_STM32F030
        bool "STM32F030"

    config MODEL_STM32F070
        bool "STM32F070"

    config MODEL_STM32F071
        bool "STM32F071"

    config MODEL_STM32F072
        bool "STM32F072"

    config MODEL_STM32F078
        bool "STM32F078"

    config MODEL_STM32F091
        bool "STM32F091"

    config MODEL_STM32F098
        bool "STM32F098"

endchoice

if MODEL_STM32F030
    source "$OS_ROOT/templates/configs/st/f0/f030/Kconfig"
endif

if MODEL_STM32F070
    source "$OS_ROOT/templates/configs/st/f0/f070/Kconfig"
endif

if MODEL_STM32F071
    source "$OS_ROOT/templates/configs/st/f0/f071/Kconfig"
endif

if MODEL_STM32F072
    source "$OS_ROOT/templates/configs/st/f0/f072/Kconfig"
endif

if MODEL_STM32F078
    source "$OS_ROOT/templates/configs/st/f0/f078/Kconfig"
endif

if MODEL_STM32F091
    source "$OS_ROOT/templates/configs/st/f0/f091/Kconfig"
endif

if MODEL_STM32F098
    source "$OS_ROOT/templates/configs/st/f0/f098/Kconfig"
endif
```

## templates/configs/st/f0/f030/Kconfig
```kconfig
choice
    prompt "|------SUB MODEL"
        default TEMP_STM32F030CC
    help
        Select the device in STM32F030xx

    config TEMP_STM32F030CC
        bool "STM32F030CC"

    config TEMP_STM32F030RC
        bool "STM32F030RC"

endchoice
```

## templates/configs/st/f0/f070/Kconfig
```kconfig
choice
    prompt "|------SUB MODEL"
        default TEMP_STM32F070CB
    help
        Select the device in STM32F070xx

    config TEMP_STM32F070CB
        bool "STM32F070CB"

    config TEMP_STM32F070RB
        bool "STM32F070RB"

endchoice
```

## templates/configs/st/f0/f071/Kconfig
```kconfig
choice
    prompt "|------SUB MODEL"
        default TEMP_STM32F071VB
    help
        Select the device in STM32F071xx

    config TEMP_STM32F071C8
        bool "STM32F071C8"

    config TEMP_STM32F071RB
        bool "STM32F071RB"

    config TEMP_STM32F071VB
        bool "STM32F071VB"

endchoice
```

## templates/configs/st/f0/f072/Kconfig
```kconfig
choice
    prompt "|------SUB MODEL"
        default TEMP_STM32F072V8
    help
        Select the device in STM32F072xx

    config TEMP_STM32F072V8
        bool "STM32F072V8"

    config TEMP_STM32F072VB
        bool "STM32F072VB"

    config TEMP_STM32F072C8
        bool "STM32F072C8"

    config TEMP_STM32F072CB
        bool "STM32F072CB"

    config TEMP_STM32F072R8
        bool "STM32F072R8"

endchoice
```

## templates/configs/st/f0/f078/Kconfig
```kconfig
choice
    prompt "|------SUB MODEL"
        default TEMP_STM32F078RB
    help
        Select the device in STM32F078xx

    config TEMP_STM32F078RB
        bool "STM32F078RB"

endchoice
```

## templates/configs/st/f0/f091/Kconfig
```kconfig
choice
    prompt "|------SUB MODEL"
        default TEMP_stm32f091-nucleo-64
    help
        Select the device in STM32F091xx

    config TEMP_stm32f091-nucleo-64
        bool "stm32f091-nucleo-64"

    config TEMP_STM32F091VB
        bool "STM32F091VB"

    config TEMP_STM32F091CB
        bool "STM32F091CB"

    config TEMP_STM32F091CC
        bool "STM32F091CC"

    config TEMP_STM32F091RB
        bool "STM32F091RB"

    config TEMP_STM32F091RC
        bool "STM32F091RC"

endchoice
```

## templates/configs/st/f0/f098/Kconfig
```kconfig
choice
    prompt "|------SUB MODEL"
        default TEMP_STM32F098RC
    help
        Select the device in STM32F098xx

    config TEMP_STM32F098RC
        bool "STM32F098RC"

endchoice
```

## templates/configs/st/f1/Kconfig
```kconfig
choice
    prompt "|----MODEL"
        default MODEL_STM32F103
    help
        Select the device in STM32F1xx

    config MODEL_STM32F100
        bool "STM32F100"

    config MODEL_STM32F101
        bool "STM32F101"

    config MODEL_STM32F102
        bool "STM32F102"

    config MODEL_STM32F103
        bool "STM32F103"

    config MODEL_STM32F105
        bool "STM32F105"
        
    config MODEL_STM32F107
        bool "STM32F107"

endchoice

if MODEL_STM32F100
    source "$OS_ROOT/templates/configs/st/f1/f100/Kconfig"
endif

if MODEL_STM32F101
    source "$OS_ROOT/templates/configs/st/f1/f101/Kconfig"
endif

if MODEL_STM32F102
    source "$OS_ROOT/templates/configs/st/f1/f102/Kconfig"
endif

if MODEL_STM32F103
    source "$OS_ROOT/templates/configs/st/f1/f103/Kconfig"
endif

if MODEL_STM32F105
    source "$OS_ROOT/templates/configs/st/f1/f105/Kconfig"
endif

if MODEL_STM32F107
    source "$OS_ROOT/templates/configs/st/f1/f107/Kconfig"
endif
```

## templates/configs/st/f1/f100/Kconfig
```kconfig
choice
    prompt "|------SUB MODEL"
        default TEMP_STM32F100VE
    help
        Select the device in STM32F100xx

    config TEMP_STM32F100RC
        bool "STM32F100RC"
    
    config TEMP_STM32F100RD
        bool "STM32F100RD"
    
    config TEMP_STM32F100RE
        bool "STM32F100RE"
    
    config TEMP_STM32F100VC
        bool "STM32F100VC"
    
    config TEMP_STM32F100VD
        bool "STM32F100VD"
    
    config TEMP_STM32F100VE
        bool "STM32F100VE"  
    
    config TEMP_STM32F100ZC
        bool "STM32F100ZC"
    
    config TEMP_STM32F100ZD
        bool "STM32F100ZD"  
    
    config TEMP_STM32F100ZE
        bool "STM32F100ZE"
    
endchoice
```

## templates/configs/st/f1/f101/Kconfig
```kconfig
choice
    prompt "|------SUB MODEL"
        default TEMP_STM32F101VE
    help
        Select the device in STM32F101xx

    config TEMP_STM32F101CB
        bool "STM32F101CB"

    config TEMP_STM32F101RB
        bool "STM32F101RB"
    
    config TEMP_STM32F101RC
        bool "STM32F101RC"
        
    config TEMP_STM32F101RD
        bool "STM32F101RD"
        
    config TEMP_STM32F101RE
        bool "STM32F101RE"
        
    config TEMP_STM32F101RF
        bool "STM32F101RF"
    
    config TEMP_STM32F101RG
        bool "STM32F101RG"
    
    config TEMP_STM32F101VB
        bool "STM32F101VB"
    
    config TEMP_STM32F101VC
        bool "STM32F101VC"
    
    config TEMP_STM32F101VD
        bool "STM32F101VD"
    
    config TEMP_STM32F101VE
        bool "STM32F101VE"
    
    config TEMP_STM32F101VF
        bool "STM32F101VF"

    config TEMP_STM32F101VG
        bool "STM32F101VG"
    
    config TEMP_STM32F101ZC
        bool "STM32F101ZC"
        
    config TEMP_STM32F101ZD
        bool "STM32F101ZD"
    
    config TEMP_STM32F101ZE
        bool "STM32F101ZE"
    
     config TEMP_STM32F101ZF
        bool "STM32F101ZF"
    
    config TEMP_STM32F101ZG
        bool "STM32F101ZG"

endchoice
```

## templates/configs/st/f1/f102/Kconfig
```kconfig
choice
    prompt "|------SUB MODEL"
        default TEMP_STM32F102RB
    help
        Select the device in STM32F102xx

    config TEMP_STM32F102CB
        bool "STM32F102CB"

    config TEMP_STM32F102RB
        bool "STM32F102RB"
    
endchoice
```

## templates/configs/st/f1/f103/Kconfig
```kconfig
choice
    prompt "|------SUB MODEL"
        default TEMP_STM32F103RC
    help
        Select the device in STM32F103xx

    config TEMP_STM32F103C8
        bool "STM32F103C8"
        
    config TEMP_STM32F103CB
        bool "STM32F103CB"
        
    config TEMP_STM32F103R8
        bool "STM32F103R8"
        
    config TEMP_STM32F103RB
        bool "STM32F103RB"
        
    config TEMP_STM32F103RC
        bool "STM32F103RC"
        
    config TEMP_STM32F103RD
        bool "STM32F103RD"
        
    config TEMP_STM32F103RE
        bool "STM32F103RE"
        
    config TEMP_STM32F103RF
        bool "STM32F103RF"
    
    config TEMP_STM32F103RG
        bool "STM32F103RG"
    
    config TEMP_STM32F103T8
        bool "STM32F103T8"

    config TEMP_STM32F103V8
        bool "STM32F103V8"
        
    config TEMP_STM32F103VB
        bool "STM32F103VB"  
        
    config TEMP_STM32F103VC
        bool "STM32F103VC"
    
    config TEMP_STM32F103VD
        bool "STM32F103VD"
    
    config TEMP_STM32F103VE
        bool "STM32F103VE"  
    
    config TEMP_STM32F103VF
        bool "STM32F103VF"

    config TEMP_STM32F103VG
        bool "STM32F103VG"  
    
    config TEMP_STM32F103ZC
        bool "STM32F103ZC"
        
    config TEMP_STM32F103ZD
        bool "STM32F103ZD"  
    
    config TEMP_STM32F103ZE
        bool "STM32F103ZE"
        
     config TEMP_STM32F103ZF
        bool "STM32F103ZF"  
    
    config TEMP_STM32F103ZG
        bool "STM32F103ZG"
        
    config TEMP_stm32f103-m5310-nbiot
        bool "stm32f103-m5310-nbiot"
    
    config TEMP_stm32f103zet6-atk-elite
        bool "stm32f103zet6-atk-elite"
        
endchoice
```

## templates/configs/st/f1/f105/Kconfig
```kconfig
choice
    prompt "|------SUB MODEL"
        default TEMP_STM32F105RC
    help
        Select the device in STM32F105xx

    config TEMP_STM32F105R8
        bool "STM32F105R8"
        
    config TEMP_STM32F105RB
        bool "STM32F105RB"
        
    config TEMP_STM32F105RC
        bool "STM32F105RC"

    config TEMP_STM32F105V8
        bool "STM32F105V8"
        
    config TEMP_STM32F105VB
        bool "STM32F105VB"  
        
    config TEMP_STM32F105VC
        bool "STM32F105VC"

endchoice
```

## templates/configs/st/f1/f107/Kconfig
```kconfig
choice
    prompt "|------SUB MODEL"
        default TEMP_STM32F107VC
    help
        Select the device in STM32F107xx
    
    config TEMP_STM32F107RB
        bool "STM32F107RB"
    
    config TEMP_STM32F107RC
        bool "STM32F107RC"
    
    config TEMP_STM32F107VB
        bool "STM32F107VB"
    
    config TEMP_STM32F107VC
        bool "STM32F107VC"
		
    config TEMP_stm32f107-vct6-100
        bool "stm32f107-vct6-100"
		
endchoice
```

## templates/configs/st/f3/Kconfig
```kconfig
choice
    prompt "|----MODEL"
        default MODEL_STM32F302
    help
        Select the device in STM32F3xx

    config MODEL_STM32F301
        bool "STM32F301"

    config MODEL_STM32F302
        bool "STM32F302"

    config MODEL_STM32F303
        bool "STM32F303"

    config MODEL_STM32F318
        bool "STM32F318"
        
    config MODEL_STM32F328
        bool "STM32F328"

    config MODEL_STM32F334
        bool "STM32F334"
        
    config MODEL_STM32F358
        bool "STM32F358"
        
    config MODEL_STM32F373
        bool "STM32F373"
        
    config MODEL_STM32F378
        bool "STM32F378"

    config MODEL_STM32F398
        bool "STM32F398"

endchoice

if MODEL_STM32F301
    source "$OS_ROOT/templates/configs/st/f3/f301/Kconfig"
endif

if MODEL_STM32F302
    source "$OS_ROOT/templates/configs/st/f3/f302/Kconfig"
endif

if MODEL_STM32F303
    source "$OS_ROOT/templates/configs/st/f3/f303/Kconfig"
endif

if MODEL_STM32F318
    source "$OS_ROOT/templates/configs/st/f3/f318/Kconfig"
endif

if MODEL_STM32F328
    source "$OS_ROOT/templates/configs/st/f3/f328/Kconfig"
endif

if MODEL_STM32F334
    source "$OS_ROOT/templates/configs/st/f3/f334/Kconfig"
endif

if MODEL_STM32F358
    source "$OS_ROOT/templates/configs/st/f3/f358/Kconfig"
endif

if MODEL_STM32F373
    source "$OS_ROOT/templates/configs/st/f3/f373/Kconfig"
endif

if MODEL_STM32F378
    source "$OS_ROOT/templates/configs/st/f3/f378/Kconfig"
endif

if MODEL_STM32F398
    source "$OS_ROOT/templates/configs/st/f3/f398/Kconfig"
endif
```

## templates/configs/st/f3/f301/Kconfig
```kconfig
choice
    prompt "|------SUB MODEL"
        default TEMP_STM32F301R8
    help
        Select the device in STM32F301xx

    config TEMP_STM32F301R8
        bool "STM32F301R8"

    config TEMP_STM32F301C8
        bool "STM32F301C8"
endchoice
```

## templates/configs/st/f3/f302/Kconfig
```kconfig
choice
    prompt "|------SUB MODEL"
        default TEMP_stm32f302-nucleo
    help
        Select the device in STM32F302xx

    config TEMP_STM32F302C8
        bool "STM32F302C8"

    config TEMP_STM32F302CB
        bool "STM32F302CB"
        
    config TEMP_STM32F302CC
        bool "STM32F302CC"

    config TEMP_STM32F302R8
        bool "STM32F302R8"

    config TEMP_STM32F302RB
        bool "STM32F302RB"
        
    config TEMP_STM32F302RC
        bool "STM32F302RC"
        
    config TEMP_STM32F302RD
        bool "STM32F302RD"
        
    config TEMP_STM32F302RE
        bool "STM32F302RE"

    config TEMP_STM32F302VB
        bool "STM32F302VB"

    config TEMP_STM32F302VC
        bool "STM32F302VC"

    config TEMP_STM32F302VD
        bool "STM32F302VD"

    config TEMP_STM32F302VE
        bool "STM32F302VE"
        
    config TEMP_STM32F302ZD
        bool "STM32F302ZD"

    config TEMP_STM32F302ZE
        bool "STM32F302ZE"

    config TEMP_stm32f302-nucleo
        bool "stm32f302-nucleo"
        
endchoice
```
