## templates/configs/st/f4/f469/Kconfig
```kconfig
choice
    prompt "|------SUB MODEL"
        default TEMP_stm32f469-st-disco
    help
        Select the device in STM32F469xx

    config TEMP_stm32f469-st-disco
        bool "stm32f469-st-disco"
    
    config TEMP_STM32F469AG
        bool "STM32F469AG"

    config TEMP_STM32F469AI
        bool "STM32F469AI"

    config TEMP_STM32F469BE
        bool "STM32F469BE"

    config TEMP_STM32F469BG
        bool "STM32F469BG"

    config TEMP_STM32F469BI
        bool "STM32F469BI"

    config TEMP_STM32F469IE
        bool "STM32F469IE"

    config TEMP_STM32F469IG
        bool "STM32F469IG"

    config TEMP_STM32F469II
        bool "STM32F469II"

    config TEMP_STM32F469NE
        bool "STM32F469NE"

    config TEMP_STM32F469NG
        bool "STM32F469NG"

    config TEMP_STM32F469NI
        bool "STM32F469NI"

    config TEMP_STM32F469VE
        bool "STM32F469VE"

    config TEMP_STM32F469VG
        bool "STM32F469VG"

    config TEMP_STM32F469VI
        bool "STM32F469VI"

    config TEMP_STM32F469ZE
        bool "STM32F469ZE"

    config TEMP_STM32F469ZG
        bool "STM32F469ZG"

    config TEMP_STM32F469ZI
        bool "STM32F469ZI"

endchoice

 
```

## templates/configs/st/f4/f479/Kconfig
```kconfig
choice
    prompt "|------SUB MODEL"
        default TEMP_STM32F479AG
    help
        Select the device in STM32F479xx
    config TEMP_STM32F479AG
        bool "STM32F479AG"

    config TEMP_STM32F479AI
        bool "STM32F479AI"

    config TEMP_STM32F479BG
        bool "STM32F479BG"

    config TEMP_STM32F479BI
        bool "STM32F479BI"

    config TEMP_STM32F479IG
        bool "STM32F479IG"

    config TEMP_STM32F479II
        bool "STM32F479II"

    config TEMP_STM32F479NG
        bool "STM32F479NG"

    config TEMP_STM32F479NI
        bool "STM32F479NI"

    config TEMP_STM32F479VG
        bool "STM32F479VG"

    config TEMP_STM32F479VI
        bool "STM32F479VI"

    config TEMP_STM32F479ZG
        bool "STM32F479ZG"

    config TEMP_STM32F479ZI
        bool "STM32F479ZI"

endchoice
```

## templates/configs/st/f7/Kconfig
```kconfig
choice
    prompt "|----MODEL"
        default MODEL_STM32F767
    help
        Select the device in STM32F7xx

    config MODEL_STM32F72X
        bool "STM32F72X"
        
    config MODEL_STM32F73X
        bool "STM32F73X"
        
    config MODEL_STM32F74X
        bool "STM32F74X"

    config MODEL_STM32F75X
        bool "STM32F75X"
    
    config MODEL_STM32F765
        bool "STM32F765"

    config MODEL_STM32F767
        bool "STM32F767"

    config MODEL_STM32F769
        bool "STM32F769"
        
    config MODEL_STM32F777
        bool "STM32F777"
        
    config MODEL_STM32F778
        bool "STM32F778"
        
    config MODEL_STM32F779
        bool "STM32F779"
endchoice

if MODEL_STM32F72X
    source "$OS_ROOT/templates/configs/st/f7/f72x/Kconfig"
endif

if MODEL_STM32F73X
    source "$OS_ROOT/templates/configs/st/f7/f73x/Kconfig"
endif

if MODEL_STM32F74X
    source "$OS_ROOT/templates/configs/st/f7/f74x/Kconfig"
endif

if MODEL_STM32F75X
    source "$OS_ROOT/templates/configs/st/f7/f75x/Kconfig"
endif

if MODEL_STM32F765
    source "$OS_ROOT/templates/configs/st/f7/f765/Kconfig"
endif

if MODEL_STM32F767
    source "$OS_ROOT/templates/configs/st/f7/f767/Kconfig"
endif

if MODEL_STM32F769
    source "$OS_ROOT/templates/configs/st/f7/f769/Kconfig"
endif

if MODEL_STM32F777
    source "$OS_ROOT/templates/configs/st/f7/f777/Kconfig"
endif

if MODEL_STM32F778
    source "$OS_ROOT/templates/configs/st/f7/f778/Kconfig"
endif

if MODEL_STM32F779
    source "$OS_ROOT/templates/configs/st/f7/f779/Kconfig"
endif
```

## templates/configs/st/f7/f72x/Kconfig
```kconfig
choice
    prompt "|------SUB MODEL"
        default TEMP_stm32f722-st-nucleo
    help
        Select the device in STM32F72x

    config TEMP_stm32f722-st-nucleo
        bool "stm32f722-st-nucleo"
    config TEMP_STM32F722IC
        bool "STM32F722IC"
    config TEMP_STM32F722IE
        bool "STM32F722IE"
    config TEMP_STM32F722RC
        bool "STM32F722RC"
    config TEMP_STM32F722RE
        bool "STM32F722RE"
    config TEMP_STM32F722VC
        bool "STM32F722VC"
    config TEMP_STM32F722VE
        bool "STM32F722VE"
    config TEMP_STM32F722ZC
        bool "STM32F722ZC"
    config TEMP_STM32F722ZE
        bool "STM32F722ZE"
    config TEMP_STM32F723IC
        bool "STM32F723IC"
    config TEMP_STM32F723IE
        bool "STM32F723IE"
    config TEMP_STM32F723VC
        bool "STM32F723VC"
    config TEMP_STM32F723VE
        bool "STM32F723VE"
    config TEMP_STM32F723ZC
        bool "STM32F723ZC"
    config TEMP_STM32F723ZE
        bool "STM32F723ZE"
endchoice
```
