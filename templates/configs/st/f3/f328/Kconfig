## templates/configs/st/f3/f328/Kconfig
```kconfig
choice
    prompt "|------SUB MODEL"
        default TEMP_STM32F328C8
    help
        Select the device in STM32F328xx

    config TEMP_STM32F328C8
        bool "STM32F328C8"
endchoice
```

## templates/configs/st/f3/f334/Kconfig
```kconfig
choice
    prompt "|------SUB MODEL"
        default TEMP_stm32f334-r8t6-nucleo
    help
        Select the device in STM32F334xx

    config TEMP_STM32F334C8
        bool "STM32F334C8"

    config TEMP_STM32F334R8
        bool "STM32F334R8"

    config TEMP_stm32f334-r8t6-nucleo
        bool "stm32f334-r8t6-nucleo"

endchoice
```

## templates/configs/st/f3/f358/Kconfig
```kconfig
choice
    prompt "|------SUB MODEL"
        default TEMP_STM32F358CC
    help
        Select the device in STM32F358xx

    config TEMP_STM32F358CC
        bool "STM32F358CC"

    config TEMP_STM32F358RC
        bool "STM32F358RC"
        
    config TEMP_STM32F358VC
        bool "STM32F358VC"
        
endchoice
```

## templates/configs/st/f3/f373/Kconfig
```kconfig
choice
    prompt "|------SUB MODEL"
        default TEMP_STM32F373CB
    help
        Select the device in STM32F373xx

    config TEMP_STM32F373C8
        bool "STM32F373C8"
        
    config TEMP_STM32F373CB
        bool "STM32F373CB"
        
    config TEMP_STM32F373CC
        bool "STM32F373CC"

    config TEMP_STM32F373R8
        bool "STM32F373R8"

    config TEMP_STM32F373RB
        bool "STM32F373RB"

    config TEMP_STM32F373RC
        bool "STM32F373RC"
        
    config TEMP_STM32F373V8
        bool "STM32F373V8"

    config TEMP_STM32F373VB
        bool "STM32F373VB"

    config TEMP_STM32F373VC
        bool "STM32F373VC"

endchoice
```

## templates/configs/st/f3/f378/Kconfig
```kconfig
choice
    prompt "|------SUB MODEL"
        default TEMP_STM32F378CC
    help
        Select the device in STM32F378xx

    config TEMP_STM32F378CC
        bool "STM32F378CC"

    config TEMP_STM32F378RC
        bool "STM32F378RC"
        
    config TEMP_STM32F378VC
        bool "STM32F378VC"
endchoice
```

## templates/configs/st/f3/f398/Kconfig
```kconfig
choice
    prompt "|------SUB MODEL"
        default TEMP_STM32F398VE
    help
        Select the device in STM32F398xx

    config TEMP_STM32F398VE
        bool "STM32F398VE"

endchoice
```

## templates/configs/st/f4/Kconfig
```kconfig
choice
    prompt "|----MODEL"
        default MODEL_STM32F401
    help
        Select the device in STM32F4xx

    config MODEL_STM32F401
        bool "STM32F401"
        
    config MODEL_STM32F405
        bool "STM32F405"
        
    config MODEL_STM32F407
        bool "STM32F407"

    config MODEL_STM32F410
        bool "STM32F410"

    config MODEL_STM32F411
        bool "STM32F411"
        
    config MODEL_STM32F412
        bool "STM32F412"

    config MODEL_STM32F413
        bool "STM32F413"

    config MODEL_STM32F415
        bool "STM32F415"

    config MODEL_STM32F417
        bool "STM32F417"

    config MODEL_STM32F423
        bool "STM32F423"
    
    config MODEL_STM32F427
        bool "STM32F427"
   
   config MODEL_STM32F429
        bool "STM32F429"

   config MODEL_STM32F43X
        bool "STM32F43X"

   config MODEL_STM32F446
        bool "STM32F446"

   config MODEL_STM32F469
        bool "STM32F469"

   config MODEL_STM32F479
        bool "STM32F479"
    
endchoice

if MODEL_STM32F401
    source "$OS_ROOT/templates/configs/st/f4/f401/Kconfig"
endif

if MODEL_STM32F405
    source "$OS_ROOT/templates/configs/st/f4/f405/Kconfig"
endif

if MODEL_STM32F407
    source "$OS_ROOT/templates/configs/st/f4/f407/Kconfig"
endif

if MODEL_STM32F410
    source "$OS_ROOT/templates/configs/st/f4/f410/Kconfig"
endif

if MODEL_STM32F411
    source "$OS_ROOT/templates/configs/st/f4/f411/Kconfig"
endif

if MODEL_STM32F412
    source "$OS_ROOT/templates/configs/st/f4/f412/Kconfig"
endif

if MODEL_STM32F413
    source "$OS_ROOT/templates/configs/st/f4/f413/Kconfig"
endif

if MODEL_STM32F415
    source "$OS_ROOT/templates/configs/st/f4/f415/Kconfig"
endif

if MODEL_STM32F417
    source "$OS_ROOT/templates/configs/st/f4/f417/Kconfig"
endif

if MODEL_STM32F423
    source "$OS_ROOT/templates/configs/st/f4/f423/Kconfig"
endif

if MODEL_STM32F427
    source "$OS_ROOT/templates/configs/st/f4/f427/Kconfig"
endif

if MODEL_STM32F429
    source "$OS_ROOT/templates/configs/st/f4/f429/Kconfig"
endif

if MODEL_STM32F43X
    source "$OS_ROOT/templates/configs/st/f4/f43x/Kconfig"
endif

if MODEL_STM32F446
    source "$OS_ROOT/templates/configs/st/f4/f446/Kconfig"
endif

if MODEL_STM32F469
    source "$OS_ROOT/templates/configs/st/f4/f469/Kconfig"
endif

if MODEL_STM32F479
    source "$OS_ROOT/templates/configs/st/f4/f479/Kconfig"
endif
```

## templates/configs/st/f4/f401/Kconfig
```kconfig
choice
    prompt "|------SUB MODEL"
        default TEMP_STM32F401VE
    help
        Select the device in STM32F401xx

    config TEMP_STM32F401CB
        bool "STM32F401CB"
    
    config TEMP_STM32F401CC
        bool "STM32F401CC"
    
    config TEMP_STM32F401CD
        bool "STM32F401CD"
    
    config TEMP_STM32F401CE
        bool "STM32F401CE"
    
    config TEMP_STM32F401RB
        bool "STM32F401RB"
    
    config TEMP_STM32F401RC
        bool "STM32F401RC"
    
    config TEMP_STM32F401RD
        bool "STM32F401RD"
    
    config TEMP_STM32F401RE
        bool "STM32F401RE"
    
    config TEMP_STM32F401VB
        bool "STM32F401VB"
    
    config TEMP_STM32F401VC
        bool "STM32F401VC"
    
    config TEMP_STM32F401VD
        bool "STM32F401VD"
    
    config TEMP_STM32F401VE
        bool "STM32F401VE"
    
    config TEMP_stm32f401-cmcc-oneos
        bool "stm32f401-cmcc-oneos"
    
    config TEMP_stm32f401-ret6-nucleo
        bool "stm32f401-ret6-nucleo"
    
endchoice
```

## templates/configs/st/f4/f405/Kconfig
```kconfig
choice
    prompt "|------SUB MODEL"
        default TEMP_STM32F405VG
    help
        Select the device in STM32F405xx

    config TEMP_STM32F405OE
        bool "STM32F405OE"

    config TEMP_STM32F405OG
        bool "STM32F405OG"
    
    config TEMP_STM32F405RG
        bool "STM32F405RG"
    
    config TEMP_STM32F405VG
        bool "STM32F405VG"
    
    config TEMP_STM32F405ZG
        bool "STM32F405ZG"
    
endchoice
```

## templates/configs/st/f4/f407/Kconfig
```kconfig
choice
    prompt "|------SUB MODEL"
        default TEMP_STM32F407ZG
    help
        Select the device in STM32F407xx

    config TEMP_STM32F407VE
        bool "STM32F407VE"
    
    config TEMP_STM32F407VG
        bool "STM32F407VG"
    
    config TEMP_STM32F407ZE
        bool "STM32F407ZE"

    config TEMP_STM32F407ZG
        bool "STM32F407ZG"

    config TEMP_STM32F407IE
        bool "STM32F407IE"

    config TEMP_STM32F407IG
        bool "STM32F407IG"

    config TEMP_stm32f407-atk-explorer
        bool "stm32f407-atk-explorer"

endchoice
```

## templates/configs/st/f4/f410/Kconfig
```kconfig
choice
    prompt "|------SUB MODEL"
        default TEMP_STM32F410C8
    help
        Select the device in STM32F410xx

    config TEMP_STM32F410T8
        bool "STM32F410T8"

    config TEMP_STM32F410TB
        bool "STM32F410TB"

    config TEMP_STM32F410C8
        bool "STM32F410C8"
        
    config TEMP_STM32F410CB
        bool "STM32F410CB"
    
    config TEMP_STM32F410R8
        bool "STM32F410R8"

    config TEMP_STM32F410RB
        bool "STM32F410RB"

    config TEMP_stm32f410-rbt6-nucleo
        bool "stm32f410-rbt6-nucleo"
    
endchoice
```

## templates/configs/st/f4/f411/Kconfig
```kconfig
choice
    prompt "|------SUB MODEL"
        default TEMP_STM32F411VE
    help
        Select the device in STM32F411xx

    config TEMP_STM32F411CC
        bool "STM32F411CC"
        
    config TEMP_STM32F411CE
        bool "STM32F411CE"
    
    config TEMP_STM32F411RC
        bool "STM32F411RC"
        
    config TEMP_STM32F411RE
        bool "STM32F411RE"

    config TEMP_STM32F411VC
        bool "STM32F411VC"
        
    config TEMP_STM32F411VE
        bool "STM32F411VE"
    
    config TEMP_stm32f411-ret6-nucleo
        bool "stm32f411-ret6-nucleo"
    
endchoice
```

## templates/configs/st/f4/f412/Kconfig
```kconfig
choice
    prompt "|------SUB MODEL"
        default TEMP_STM32F412ZG
    help
        Select the device in STM32F412xx

    config TEMP_STM32F412CE
        bool "STM32F412CE"
        
    config TEMP_STM32F412CG
        bool "STM32F412CG"
        
    config TEMP_STM32F412RG
        bool "STM32F412RG"
    
    config TEMP_STM32F412VE
        bool "STM32F412VE"
        
    config TEMP_STM32F412VG
        bool "STM32F412VG"
        

    config TEMP_STM32F412ZE
        bool "STM32F412ZE"
        
    config TEMP_STM32F412ZG
        bool "STM32F412ZG"
    
endchoice
```

## templates/configs/st/f4/f413/Kconfig
```kconfig
choice
    prompt "|------SUB MODEL"
        default TEMP_STM32F413ZG
    help
        Select the device in STM32F413xx

    config TEMP_STM32F413CG
        bool "STM32F413CG"
        
    config TEMP_STM32F413CH
        bool "STM32F413CH"
    
    config TEMP_STM32F413RG
        bool "STM32F413RG"
        
    config TEMP_STM32F413RH
        bool "STM32F413RH"
    
    config TEMP_STM32F413VG
        bool "STM32F413VG"
        
    config TEMP_STM32F413VH
        bool "STM32F413VH"
    
    config TEMP_STM32F413ZG
        bool "STM32F413ZG"
        
    config TEMP_STM32F413ZH
        bool "STM32F413ZH"
    
    config TEMP_stm32f413-zht6-nucleo
        bool "stm32f413-zht6-nucleo"
    
endchoice
```

## templates/configs/st/f4/f415/Kconfig
```kconfig
choice
    prompt "|------SUB MODEL"
        default TEMP_STM32F415ZG
    help
        Select the device in STM32F415xx

    config TEMP_STM32F415RG
        bool "STM32F415RG"
    
    config TEMP_STM32F415OG
        bool "STM32F415OG"
    
    config TEMP_STM32F415VG
        bool "STM32F415VG"
    
    config TEMP_STM32F415ZG
        bool "STM32F415ZG"
    
endchoice
```

## templates/configs/st/f4/f417/Kconfig
```kconfig
choice
    prompt "|------SUB MODEL"
        default TEMP_STM32F417ZG
    help
        Select the device in STM32F417xx

    config TEMP_STM32F417VE
        bool "STM32F417VE"
    
    config TEMP_STM32F417VG
        bool "STM32F417VG"
    
    config TEMP_STM32F417ZE
        bool "STM32F417ZE"
    
    config TEMP_STM32F417ZG
        bool "STM32F417ZG"
    
    config TEMP_STM32F417IE
        bool "STM32F417IE"
    
    config TEMP_STM32F417IG
        bool "STM32F417IG"
    
endchoice
```

## templates/configs/st/f4/f423/Kconfig
```kconfig
choice
    prompt "|------SUB MODEL"
        default TEMP_STM32F423CH
    help
        Select the device in STM32F423xx

    config TEMP_STM32F423CH
        bool "STM32F423CH"
        
    config TEMP_STM32F423RH
        bool "STM32F423RH"
        
    config TEMP_STM32F423MH
        bool "STM32F423MH"
        
    config TEMP_STM32F423VH
        bool "STM32F423VH"
        
	config TEMP_STM32F423ZH
        bool "STM32F423ZH"
        
endchoice

 
```

## templates/configs/st/f4/f427/Kconfig
```kconfig
choice
    prompt "|------SUB MODEL"
        default TEMP_STM32F427AG
    help
        Select the device in STM32F427xx
  
    config TEMP_STM32F427AG
        bool "STM32F427AG"
        
    config TEMP_STM32F427AI
        bool "STM32F427AI"
        
    config TEMP_STM32F427IG
        bool "STM32F427IG"
        
    config TEMP_STM32F427II
        bool "STM32F427II"
        
    config TEMP_STM32F427VG
        bool "STM32F427VG"
        
    config TEMP_STM32F427VI
        bool "STM32F427VI"
        
    config TEMP_STM32F427ZG
        bool "STM32F427ZG"
        
    config TEMP_STM32F427ZI
        bool "STM32F427ZI"
        
endchoice
```

## templates/configs/st/f4/f429/Kconfig
```kconfig
choice
    prompt "|------SUB MODEL"
        default TEMP_STM32F429AG
    help
        Select the device in STM32F429xx

    config TEMP_STM32F429AG
        bool "STM32F429AG"
        
    config TEMP_STM32F429AI
        bool "STM32F429AI"
        
    config TEMP_STM32F429BE
        bool "STM32F429BE"
        
    config TEMP_STM32F429BG
        bool "STM32F429BG"
        
    config TEMP_STM32F429BI
        bool "STM32F429BI"
        
    config TEMP_STM32F429IE
        bool "STM32F429IE"
        
    config TEMP_STM32F429IG
        bool "STM32F429IG"
        
    config TEMP_STM32F429II
        bool "STM32F429II"
        
    config TEMP_STM32F429NE
        bool "STM32F429NE"
        
    config TEMP_STM32F429NG
        bool "STM32F429NG"
        
    config TEMP_STM32F429NI
        bool "STM32F429NI"
        
    config TEMP_STM32F429VE
        bool "STM32F429VE"
        
    config TEMP_STM32F429VG
        bool "STM32F429VG"
        
    config TEMP_STM32F429VI
        bool "STM32F429VI"
        
    config TEMP_STM32F429ZE
        bool "STM32F429ZE"
        
    config TEMP_STM32F429ZG
        bool "STM32F429ZG"
        
    config TEMP_STM32F429ZI
        bool "STM32F429ZI"

    config TEMP_stm32f429-atk-apollo
        bool "stm32f429-atk-apollo"
        
    config TEMP_stm32f429-st-disco
        bool "stm32f429-st-disco"

endchoice

 
```

## templates/configs/st/f4/f43x/Kconfig
```kconfig
choice
    prompt "|------SUB MODEL"
        default TEMP_STM32F437AI
    help
        Select the device in STM32F43xx
    config TEMP_STM32F437AI
        bool "STM32F437AI"

    config TEMP_STM32F437IG
        bool "STM32F437IG"

    config TEMP_STM32F437II
        bool "STM32F437II"

    config TEMP_STM32F437VG
        bool "STM32F437VG"

    config TEMP_STM32F437VI
        bool "STM32F437VI"

    config TEMP_STM32F437ZG
        bool "STM32F437ZG"

    config TEMP_STM32F437ZI
        bool "STM32F437ZI"

    config TEMP_STM32F439AI
        bool "STM32F439AI"

    config TEMP_STM32F439BG
        bool "STM32F439BG"

    config TEMP_STM32F439BI
        bool "STM32F439BI"

    config TEMP_STM32F439IG
        bool "STM32F439IG"

    config TEMP_STM32F439II
        bool "STM32F439II"

    config TEMP_STM32F439NG
        bool "STM32F439NG"

    config TEMP_STM32F439NI
        bool "STM32F439NI"

    config TEMP_STM32F439VG
        bool "STM32F439VG"

    config TEMP_STM32F439VI
        bool "STM32F439VI"

    config TEMP_STM32F439ZG
        bool "STM32F439ZG"

    config TEMP_STM32F439ZI
        bool "STM32F439ZI"

endchoice
```

## templates/configs/st/f4/f446/Kconfig
```kconfig
choice
    prompt "|------SUB MODEL"
        default TEMP_stm32f446-zet6-nucleo
    help
        Select the device in STM32F446xx

    config TEMP_stm32f446-zet6-nucleo
        bool "stm32f446-zet6-nucleo"

    config TEMP_STM32F446MC
        bool "STM32F446MC"

    config TEMP_STM32F446ME
        bool "STM32F446ME"

    config TEMP_STM32F446RC
        bool "STM32F446RC"

    config TEMP_STM32F446RE
        bool "STM32F446RE"

    config TEMP_STM32F446VC
        bool "STM32F446VC"

    config TEMP_STM32F446VE
        bool "STM32F446VE"

    config TEMP_STM32F446ZC
        bool "STM32F446ZC"

    config TEMP_STM32F446ZE
        bool "STM32F446ZE"
        
endchoice

 
```
