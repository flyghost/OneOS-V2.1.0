## templates/configs/st/f7/f73x/Kconfig
```kconfig
choice
    prompt "|------SUB MODEL"
        default TEMP_STM32F730I8
    help
        Select the device in STM32F73x
    config TEMP_STM32F730I8
        bool "STM32F730I8"

    config TEMP_STM32F730R8
        bool "STM32F730R8"

    config TEMP_STM32F730V8
        bool "STM32F730V8"

    config TEMP_STM32F730Z8
        bool "STM32F730Z8"

    config TEMP_STM32F732IE
        bool "STM32F732IE"

    config TEMP_STM32F732RE
        bool "STM32F732RE"

    config TEMP_STM32F732VE
        bool "STM32F732VE"

    config TEMP_STM32F732ZE
        bool "STM32F732ZE"

    config TEMP_STM32F733IE
        bool "STM32F733IE"

    config TEMP_STM32F733VE
        bool "STM32F733VE"

    config TEMP_STM32F733ZE
        bool "STM32F733ZE"

endchoice
```

## templates/configs/st/f7/f74x/Kconfig
```kconfig
choice
    prompt "|------SUB MODEL"
        default TEMP_stm32f746-st-nucleo
    help
        Select the device in STM32F74x

    config TEMP_stm32f746-st-nucleo
        bool "stm32f746-st-nucleo"
    
    config TEMP_STM32F745IE
        bool "STM32F745IE"

    config TEMP_STM32F745IG
        bool "STM32F745IG"

    config TEMP_STM32F745VE
        bool "STM32F745VE"

    config TEMP_STM32F745VG
        bool "STM32F745VG"

    config TEMP_STM32F745ZE
        bool "STM32F745ZE"

    config TEMP_STM32F745ZG
        bool "STM32F745ZG"

    config TEMP_STM32F746BE
        bool "STM32F746BE"

    config TEMP_STM32F746BG
        bool "STM32F746BG"

    config TEMP_STM32F746IE
        bool "STM32F746IE"

    config TEMP_STM32F746IG
        bool "STM32F746IG"

    config TEMP_STM32F746NE
        bool "STM32F746NE"

    config TEMP_STM32F746NG
        bool "STM32F746NG"

    config TEMP_STM32F746VE
        bool "STM32F746VE"

    config TEMP_STM32F746VG
        bool "STM32F746VG"

    config TEMP_STM32F746ZE
        bool "STM32F746ZE"

    config TEMP_STM32F746ZG
        bool "STM32F746ZG"
    
endchoice
```

## templates/configs/st/f7/f75x/Kconfig
```kconfig
choice
    prompt "|------SUB MODEL"
        default TEMP_STM32F750N8
    help
        Select the device in STM32F75x
    config TEMP_STM32F750N8
        bool "STM32F750N8"

    config TEMP_STM32F750V8
        bool "STM32F750V8"

    config TEMP_STM32F750Z8
        bool "STM32F750Z8"

    config TEMP_STM32F756BG
        bool "STM32F756BG"

    config TEMP_STM32F756IG
        bool "STM32F756IG"

    config TEMP_STM32F756NG
        bool "STM32F756NG"

    config TEMP_STM32F756VG
        bool "STM32F756VG"

    config TEMP_STM32F756ZG
        bool "STM32F756ZG"

endchoice
```

## templates/configs/st/f7/f765/Kconfig
```kconfig
choice
    prompt "|------SUB MODEL"
        default TEMP_STM32F765VG
    help
        Select the device in STM32F765xx

    config TEMP_STM32F765BG
        bool "STM32F765BG"
    
    config TEMP_STM32F765BI
        bool "STM32F765BI"
    
    config TEMP_STM32F765IG
        bool "STM32F765IG"
    
    config TEMP_STM32F765II
        bool "STM32F765II"
    
    config TEMP_STM32F765NG
        bool "STM32F765NG"
    
    config TEMP_STM32F765NI
        bool "STM32F765NI"
    
    config TEMP_STM32F765VG
        bool "STM32F765VG"
    
    config TEMP_STM32F765ZG
        bool "STM32F765ZG"
    
    config TEMP_STM32F765ZI
        bool "STM32F765ZI"
    
endchoice
```

## templates/configs/st/f7/f767/Kconfig
```kconfig
choice
    prompt "|------SUB MODEL"
        default TEMP_STM32F767VG
    help
        Select the device in STM32F767xx

    config TEMP_STM32F767BG
        bool "STM32F767BG"
    
    config TEMP_STM32F767BI
        bool "STM32F767BI"
    
    config TEMP_STM32F767IG
        bool "STM32F767IG"
    
    config TEMP_STM32F767II
        bool "STM32F767II"
    
    config TEMP_STM32F767NG
        bool "STM32F767NG"
    
    config TEMP_STM32F767NI
        bool "STM32F767NI"
        
    config TEMP_STM32F767VG
        bool "STM32F767VG"
    
    config TEMP_STM32F767VI
        bool "STM32F767VI"
        
    config TEMP_STM32F767ZG
        bool "STM32F767ZG"
    
    config TEMP_STM32F767ZI
        bool "STM32F767ZI"
    
    config TEMP_stm32f767-atk-apollo
        bool "stm32f767-atk-apollo"
    
endchoice
```

## templates/configs/st/f7/f769/Kconfig
```kconfig
choice
    prompt "|------SUB MODEL"
        default TEMP_STM32F769IG
    help
        Select the device in STM32F769xx

    config TEMP_STM32F769AI
        bool "STM32F769AI"

    config TEMP_STM32F769BG
        bool "STM32F769BG"
    
    config TEMP_STM32F769BI
        bool "STM32F769BI"
    
    config TEMP_STM32F769IG
        bool "STM32F769IG"
    
    config TEMP_STM32F769II
        bool "STM32F769II"
    
    config TEMP_STM32F769NG
        bool "STM32F769NG"
    
    config TEMP_STM32F769NI
        bool "STM32F769NI"

    config TEMP_stm32f769-st-disco
        bool "stm32f769-st-disco"
    
endchoice
```

## templates/configs/st/f7/f777/Kconfig
```kconfig
choice
    prompt "|------SUB MODEL"
        default TEMP_STM32F777VI
    help
        Select the device in STM32F777xx

    config TEMP_STM32F777BI
        bool "STM32F777BI"
    
    config TEMP_STM32F777II
        bool "STM32F777II"
    
    config TEMP_STM32F777NI
        bool "STM32F777NI"
    
    config TEMP_STM32F777VI
        bool "STM32F777VI"
    
    config TEMP_STM32F777ZI
        bool "STM32F777ZI"
    
endchoice
```

## templates/configs/st/f7/f778/Kconfig
```kconfig
choice
    prompt "|------SUB MODEL"
        default TEMP_STM32F778AI
    help
        Select the device in STM32F778xx

    config TEMP_STM32F778AI
        bool "STM32F778AI"
    
endchoice
```

## templates/configs/st/f7/f779/Kconfig
```kconfig
choice
    prompt "|------SUB MODEL"
        default TEMP_STM32F779II
    help
        Select the device in STM32F779xx

    config TEMP_STM32F779AI
        bool "STM32F779AI"
    
    config TEMP_STM32F779BI
        bool "STM32F779BI"

    config TEMP_STM32F779II
        bool "STM32F779II"
    
    config TEMP_STM32F779NI
        bool "STM32F779NI"
    
endchoice
```

## templates/configs/st/g0/Kconfig
```kconfig
choice
    prompt "|----MODEL"
        default MODEL_STM32G071
    help
        Select the device in STM32G0xx

    config MODEL_STM32G070
        bool "STM32G070"

    config MODEL_STM32G071
        bool "STM32G071"
        
    config MODEL_STM32G081
        bool "STM32G081"
        
    config MODEL_STM32G0B0
        bool "STM32G0B0"
        
    config MODEL_STM32G0B1
        bool "STM32G0B1"
        
    config MODEL_STM32G0C1
        bool "STM32G0C1"

endchoice

if MODEL_STM32G070
    source "$OS_ROOT/templates/configs/st/g0/g070/Kconfig"
endif

if MODEL_STM32G071
    source "$OS_ROOT/templates/configs/st/g0/g071/Kconfig"
endif

if MODEL_STM32G081
    source "$OS_ROOT/templates/configs/st/g0/g081/Kconfig"
endif

if MODEL_STM32G0B0
    source "$OS_ROOT/templates/configs/st/g0/g0B0/Kconfig"
endif

if MODEL_STM32G0B1
    source "$OS_ROOT/templates/configs/st/g0/g0B1/Kconfig"
endif

if MODEL_STM32G0C1
    source "$OS_ROOT/templates/configs/st/g0/g0C1/Kconfig"
endif
```

## templates/configs/st/g0/g070/Kconfig
```kconfig
choice
    prompt "|------SUB MODEL"
        default TEMP_stm32g070rb-nucleo-64
    help
        Select the device in STM32G071xx

    config TEMP_STM32G070CB
        bool "STM32G070CB"

    config TEMP_STM32G070RB
        bool "STM32G070RB"

    config TEMP_stm32g070rb-nucleo-64
        bool "stm32g070rb-nucleo-64"
    
endchoice
```

## templates/configs/st/g0/g071/Kconfig
```kconfig
choice
    prompt "|------SUB MODEL"
        default TEMP_stm32g071-nucleo-64
    help
        Select the device in STM32G071xx

    config TEMP_STM32G071C8
        bool "STM32G071C8"

    config TEMP_STM32G071CB
        bool "STM32G071CB"

    config TEMP_STM32G071R8
        bool "STM32G071R8"

    config TEMP_STM32G071RB
        bool "STM32G071RB"

    config TEMP_stm32g071-nucleo-64
        bool "stm32g071-nucleo-64"
    
endchoice
```

## templates/configs/st/g0/g081/Kconfig
```kconfig
choice
    prompt "|------SUB MODEL"
        default TEMP_STM32G081RB
    help
        Select the device in STM32G081xx

    config TEMP_STM32G081CB
        bool "STM32G081CB"

    config TEMP_STM32G081RB
        bool "STM32G081RB"
    
endchoice
```

## templates/configs/st/g0/g0b0/Kconfig
```kconfig
choice
    prompt "|------SUB MODEL"
        default TEMP_STM32G0B0CE
    help
        Select the device in STM32G0B0xx

    config TEMP_STM32G0B0CE
        bool "STM32G0B0CE"
    
endchoice
```

## templates/configs/st/g0/g0b1/Kconfig
```kconfig
choice
    prompt "|------SUB MODEL"
        default TEMP_STM32G0B1RE
    help
        Select the device in STM32G0B1xx

    config TEMP_STM32G0B1CB
        bool "STM32G0B1CB"

    config TEMP_STM32G0B1CC
        bool "STM32G0B1CC"

    config TEMP_STM32G0B1CE
        bool "STM32G0B1CE"
        
    config TEMP_STM32G0B1RB
        bool "STM32G0B1RB"

    config TEMP_STM32G0B1RE
        bool "STM32G0B1RE"

    config TEMP_STM32G0B1VB
        bool "STM32G0B1VB"

    config TEMP_STM32G0B1VC
        bool "STM32G0B1VC"

    config TEMP_stm32g0b1re-nucleo-64
        bool "stm32g0b1re-nucleo-64"
        
endchoice
```

## templates/configs/st/g0/g0c1/Kconfig
```kconfig
choice
    prompt "|------SUB MODEL"
        default TEMP_STM32G0C1RE
    help
        Select the device in STM32G0C1xx

    config TEMP_STM32G0C1RC
        bool "STM32G0C1RC"

    config TEMP_STM32G0C1RE
        bool "STM32G0C1RE"
    
endchoice
```

## templates/configs/st/g4/Kconfig
```kconfig
choice
    prompt "|----MODEL"
        default MODEL_STM32G431
    help
        Select the device in STM32G4xx

    config MODEL_STM32G431
        bool "STM32G431"
        
    config MODEL_STM32G441
        bool "STM32G441"
        
    config MODEL_STM32G473
        bool "STM32G473"

    config MODEL_STM32G474
        bool "STM32G474"

    config MODEL_STM32G483
        bool "STM32G483"

    config MODEL_STM32G484
        bool "STM32G484"

endchoice

if MODEL_STM32G431
    source "$OS_ROOT/templates/configs/st/g4/g431/Kconfig"
endif

if MODEL_STM32G441
    source "$OS_ROOT/templates/configs/st/g4/g441/Kconfig"
endif

if MODEL_STM32G473
    source "$OS_ROOT/templates/configs/st/g4/g473/Kconfig"
endif

if MODEL_STM32G474
    source "$OS_ROOT/templates/configs/st/g4/g474/Kconfig"
endif

if MODEL_STM32G483
    source "$OS_ROOT/templates/configs/st/g4/g483/Kconfig"
endif

if MODEL_STM32G484
    source "$OS_ROOT/templates/configs/st/g4/g484/Kconfig"
endif
```

## templates/configs/st/g4/g431/Kconfig
```kconfig
choice
    prompt "|------SUB MODEL"
        default TEMP_STM32G431CB
    help
        Select the device in STM32G431xx

    config TEMP_STM32G431C8
        bool "STM32G431C8"

    config TEMP_STM32G431CB
        bool "STM32G431CB"
    
    config TEMP_STM32G431M8
        bool "STM32G431M8"

    config TEMP_STM32G431MB
        bool "STM32G431MB"

    config TEMP_STM32G431R8
        bool "STM32G431R8"

    config TEMP_STM32G431RB
        bool "STM32G431RB"

    config TEMP_STM32G431V8
        bool "STM32G431V8"

    config TEMP_STM32G431VB
        bool "STM32G431VB"

endchoice
```

## templates/configs/st/g4/g441/Kconfig
```kconfig
choice
    prompt "|------SUB MODEL"
        default TEMP_STM32G441CB
    help
        Select the device in STM32G441xx

    config TEMP_STM32G441CB
        bool "STM32G441CB"
    
    config TEMP_STM32G441MB
        bool "STM32G441MB"

    config TEMP_STM32G441RB
        bool "STM32G441RB"

    config TEMP_STM32G441VB
        bool "STM32G441VB"

endchoice
```

## templates/configs/st/g4/g473/Kconfig
```kconfig
choice
    prompt "|------SUB MODEL"
        default TEMP_STM32G473CB
    help
        Select the device in STM32G473xx

    config TEMP_STM32G473CB
        bool "STM32G473CB"
    
    config TEMP_STM32G473CC
        bool "STM32G473CC"

    config TEMP_STM32G473CE
        bool "STM32G473CE"

    config TEMP_STM32G473MB
        bool "STM32G473MB"

    config TEMP_STM32G473MC
        bool "STM32G473MC"

    config TEMP_STM32G473ME
        bool "STM32G473ME"
        
    config TEMP_STM32G473QB
        bool "STM32G473QB"

    config TEMP_STM32G473QC
        bool "STM32G473QC"

    config TEMP_STM32G473QE
        bool "STM32G473QE"

    config TEMP_STM32G473RB
        bool "STM32G473RB"

    config TEMP_STM32G473RC
        bool "STM32G473RC"

    config TEMP_STM32G473RE
        bool "STM32G473RE"

    config TEMP_STM32G473VB
        bool "STM32G473VB"

    config TEMP_STM32G473VC
        bool "STM32G473VC"

    config TEMP_STM32G473VE
        bool "STM32G473VE"

endchoice
```

## templates/configs/st/g4/g474/Kconfig
```kconfig
choice
    prompt "|------SUB MODEL"
        default TEMP_STM32G474CB
    help
        Select the device in STM32G474xx

    config TEMP_STM32G474CB
        bool "STM32G474CB"
    
    config TEMP_STM32G474CC
        bool "STM32G474CC"

    config TEMP_STM32G474CE
        bool "STM32G474CE"

    config TEMP_STM32G474MB
        bool "STM32G474MB"

    config TEMP_STM32G474MC
        bool "STM32G474MC"

    config TEMP_STM32G474ME
        bool "STM32G474ME"
        
    config TEMP_STM32G474QB
        bool "STM32G474QB"

    config TEMP_STM32G474QC
        bool "STM32G474QC"

    config TEMP_STM32G474QE
        bool "STM32G474QE"

    config TEMP_STM32G474RB
        bool "STM32G474RB"

    config TEMP_STM32G474RC
        bool "STM32G474RC"

    config TEMP_STM32G474RE
        bool "STM32G474RE"

    config TEMP_STM32G474VB
        bool "STM32G474VB"

    config TEMP_STM32G474VC
        bool "STM32G474VC"

    config TEMP_STM32G474VE
        bool "STM32G474VE"

endchoice
```

## templates/configs/st/g4/g483/Kconfig
```kconfig
choice
    prompt "|------SUB MODEL"
        default TEMP_STM32G483CE
    help
        Select the device in STM32G483xx

    config TEMP_STM32G483CE
        bool "STM32G483CE"

    config TEMP_STM32G483ME
        bool "STM32G483ME"
    
    config TEMP_STM32G483PE
        bool "STM32G483PE"

    config TEMP_STM32G483QE
        bool "STM32G483QE"

    config TEMP_STM32G483RE
        bool "STM32G483RE"

    config TEMP_STM32G483VE
        bool "STM32G483VE"

endchoice
```

## templates/configs/st/g4/g484/Kconfig
```kconfig
choice
    prompt "|------SUB MODEL"
        default TEMP_STM32G484CE
    help
        Select the device in STM32G484xx

    config TEMP_STM32G484CE
        bool "STM32G484CE"

    config TEMP_STM32G484ME
        bool "STM32G484ME"
    
    config TEMP_STM32G484QE
        bool "STM32G484QE"

    config TEMP_STM32G484RE
        bool "STM32G484RE"

    config TEMP_STM32G484VE
        bool "STM32G484VE"

endchoice
```

## templates/configs/st/h7/Kconfig
```kconfig
choice
    prompt "|----MODEL"
        default MODEL_STM32H747
    help
        Select the device in STM32H7xx

    config MODEL_STM32H747
        bool "STM32H747"
    
    config MODEL_STM32H742
        bool "STM32H742"
        
    config MODEL_STM32H743
        bool "STM32H743"

    config MODEL_STM32H745
        bool "STM32H745"
 
    config MODEL_STM32H750
        bool "STM32H750"
        
    config MODEL_STM32H753
        bool "STM32H753"
 
    config MODEL_STM32H755
        bool "STM32H755"
        
    config MODEL_STM32H757
        bool "STM32H757"
endchoice

if MODEL_STM32H747
    source "$OS_ROOT/templates/configs/st/h7/h747/Kconfig"
endif

if MODEL_STM32H743
    source "$OS_ROOT/templates/configs/st/h7/h743/Kconfig"
endif

if MODEL_STM32H745
    source "$OS_ROOT/templates/configs/st/h7/h745/Kconfig"
endif

if MODEL_STM32H742
    source "$OS_ROOT/templates/configs/st/h7/h742/Kconfig"
endif

if MODEL_STM32H750
    source "$OS_ROOT/templates/configs/st/h7/h750/Kconfig"
endif

if MODEL_STM32H753
    source "$OS_ROOT/templates/configs/st/h7/h753/Kconfig"
endif

if MODEL_STM32H755
    source "$OS_ROOT/templates/configs/st/h7/h755/Kconfig"
endif

if MODEL_STM32H757
    source "$OS_ROOT/templates/configs/st/h7/h757/Kconfig"
endif
```
