## templates/configs/st/h7/h743/Kconfig
```kconfig
choice
    prompt "|------SUB MODEL"
        default TEMP_stm32h743-atk-apollo
    help
        Select the device in STM32H743xx

    config TEMP_STM32H743VI
        bool "STM32H743VI"
        
    config TEMP_STM32H743ZI
        bool "STM32H743ZI"
        
     config TEMP_STM32H743AI
        bool "STM32H743AI"  

    config TEMP_STM32H743II
        bool "STM32H743II"
        
    config TEMP_STM32H743BI
        bool "STM32H743BI"
        
     config TEMP_STM32H743XI
        bool "STM32H743XI" 

    config TEMP_STM32H743VG
        bool "STM32H743VG"
        
    config TEMP_STM32H743ZG
        bool "STM32H743ZG"
        
     config TEMP_STM32H743AG
        bool "STM32H743AG" 
 
    config TEMP_STM32H743IG
        bool "STM32H743IG"
        
    config TEMP_STM32H743BG
        bool "STM32H743BG"
        
     config TEMP_STM32H743XG
        bool "STM32H743XG" 
        
    config TEMP_stm32h743-atk-apollo
        bool "stm32h743-atk-apollo"
endchoice
```

## templates/configs/st/h7/h745/Kconfig
```kconfig
choice
    prompt "|------SUB MODEL"
        default TEMP_STM32H745ZI
    help
        Select the device in STM32H745xx

    config TEMP_STM32H745ZI
        bool "STM32H745ZI"
    
    config TEMP_STM32H745II
        bool "STM32H745II"
   
    config TEMP_STM32H745BI
        bool "STM32H745BI"
        
    config TEMP_STM32H745XI
        bool "STM32H745XI"
        
    config TEMP_STM32H745ZG
        bool "STM32H745ZG"  		
 
    config TEMP_STM32H745IG
        bool "STM32H745IG"
        
    config TEMP_STM32H745BG
        bool "STM32H745BG"
        
    config TEMP_STM32H745XG
        bool "STM32H745XG"
        
endchoice
```

## templates/configs/st/h7/h747/Kconfig
```kconfig
choice
    prompt "|------SUB MODEL"
        default TEMP_STM32H747XI
    help
        Select the device in STM32H747xx

    config TEMP_STM32H747AG
        bool "STM32H747AG"
    
    config TEMP_STM32H747AI
        bool "STM32H747AI"
   
    config TEMP_STM32H747XG
        bool "STM32H747XG"
        
    config TEMP_STM32H747XI
        bool "STM32H747XI"
        
    config TEMP_STM32H747ZI
        bool "STM32H747ZI"  		
     
    config TEMP_STM32H747II
        bool "STM32H747II" 

    config TEMP_STM32H747BI
        bool "STM32H747BI" 
 
    config TEMP_STM32H747IG
        bool "STM32H747IG" 

    config TEMP_STM32H747BG
        bool "STM32H747BG" 
        
    config TEMP_stm32h747-st-disco
        bool "stm32h747-st-disco"
endchoice
```

## templates/configs/st/h7/h750/Kconfig
```kconfig
choice
    prompt "|------SUB MODEL"
        default TEMP_STM32H750VB
    help
        Select the device in STM32H750xx

    config TEMP_STM32H750VB
        bool "STM32H750VB"
        
    config TEMP_STM32H750ZB
        bool "STM32H750ZB"
        
     config TEMP_STM32H750IB
        bool "STM32H750IB"  

    config TEMP_STM32H750XB
        bool "STM32H750XB"     
endchoice
```

## templates/configs/st/h7/h753/Kconfig
```kconfig
choice
    prompt "|------SUB MODEL"
        default TEMP_STM32H753VI
    help
        Select the device in STM32H753xx

    config TEMP_STM32H753VI
        bool "STM32H753VI"
        
    config TEMP_STM32H753ZI
        bool "STM32H753ZI"
        
     config TEMP_STM32H753AI
        bool "STM32H753AI"  

    config TEMP_STM32H753II
        bool "STM32H753II"
        
    config TEMP_STM32H753BI
        bool "STM32H753BI"
        
     config TEMP_STM32H753XI
        bool "STM32H753XI" 

endchoice
```

## templates/configs/st/h7/h755/Kconfig
```kconfig
choice
    prompt "|------SUB MODEL"
        default TEMP_STM32H755ZI
    help
        Select the device in STM32H755xx

    config TEMP_STM32H755ZI
        bool "STM32H755ZI"
    
    config TEMP_STM32H755II
        bool "STM32H755II"
   
    config TEMP_STM32H755BI
        bool "STM32H755BI"
        
    config TEMP_STM32H755XI
        bool "STM32H755XI"     
endchoice
```

## templates/configs/st/h7/h757/Kconfig
```kconfig
choice
    prompt "|------SUB MODEL"
        default TEMP_STM32H757XI
    help
        Select the device in STM32H757xx

    config TEMP_STM32H757ZI
        bool "STM32H757ZI"
    
    config TEMP_STM32H757AI
        bool "STM32H757AI"
   
    config TEMP_STM32H757II
        bool "STM32H757II"
        
    config TEMP_STM32H757BI
        bool "STM32H757BI"
        
    config TEMP_STM32H757XI
        bool "STM32H757XI"  		
        
endchoice
```

## templates/configs/st/l0/Kconfig
```kconfig
choice
    prompt "|----MODEL"
        default MODEL_STM32L053
    help
        Select the device in STM32L0xx

    config MODEL_STM32L053
        bool "STM32L053"
        
    config MODEL_STM32L010
        bool "STM32L010"

    config MODEL_STM32L071
        bool "STM32L071"

    config MODEL_STM32L072
        bool "STM32L072"
        
    config MODEL_STM32L073
        bool "STM32L073"

    config MODEL_STM32L081
        bool "STM32L081" 

    config MODEL_STM32L082
        bool "STM32L082"
        
    config MODEL_STM32L083
        bool "STM32L083"        
endchoice

if MODEL_STM32L053
    source "$OS_ROOT/templates/configs/st/l0/l053/Kconfig"
endif

if MODEL_STM32L010
    source "$OS_ROOT/templates/configs/st/l0/l010/Kconfig"
endif

if MODEL_STM32L071
    source "$OS_ROOT/templates/configs/st/l0/l071/Kconfig"
endif

if MODEL_STM32L072
    source "$OS_ROOT/templates/configs/st/l0/l072/Kconfig"
endif

if MODEL_STM32L073
    source "$OS_ROOT/templates/configs/st/l0/l073/Kconfig"
endif

if MODEL_STM32L081
    source "$OS_ROOT/templates/configs/st/l0/l081/Kconfig"
endif

if MODEL_STM32L082
    source "$OS_ROOT/templates/configs/st/l0/l082/Kconfig"
endif

if MODEL_STM32L083
    source "$OS_ROOT/templates/configs/st/l0/l083/Kconfig"
endif    
```

## templates/configs/st/l0/l010/Kconfig
```kconfig
choice
    prompt "|------SUB MODEL"
        default TEMP_STM32L010RB
    help
        Select the device in STM32L010xx

    config TEMP_STM32L010RB
        bool "STM32L010RB"
    
endchoice
```

## templates/configs/st/l0/l053/Kconfig
```kconfig
choice
    prompt "|------SUB MODEL"
        default TEMP_stm32l053-nucleo-64
    help
        Select the device in STM32L053xx

    config TEMP_stm32l053-nucleo-64
        bool "stm32l053-nucleo-64"

endchoice
```

## templates/configs/st/l0/l071/Kconfig
```kconfig
choice
    prompt "|------SUB MODEL"
        default TEMP_STM32L071CB
    help
        Select the device in STM32L071xx
    config TEMP_STM32L071CB
        bool "STM32L071CB"

    config TEMP_STM32L071C8
        bool "STM32L071C8"

    config TEMP_STM32L071CZ
        bool "STM32L071CZ"

    config TEMP_STM32L071RB
        bool "STM32L071RB"

    config TEMP_STM32L071RZ
        bool "STM32L071RZ"

    config TEMP_STM32L071V8
        bool "STM32L071V8"

    config TEMP_STM32L071VB
        bool "STM32L071VB"

    config TEMP_STM32L071VZ
        bool "STM32L071VZ"

endchoice
```

## templates/configs/st/l0/l072/Kconfig
```kconfig
choice
    prompt "|------SUB MODEL"
        default TEMP_STM32L072CB
    help
        Select the device in STM32L072xx
    config TEMP_STM32L072CB
        bool "STM32L072CB"

    config TEMP_STM32L072CZ
        bool "STM32L072CZ"

    config TEMP_STM32L072RB
        bool "STM32L072RB"

    config TEMP_STM32L072RZ
        bool "STM32L072RZ"

    config TEMP_STM32L072V8
        bool "STM32L072V8"

    config TEMP_STM32L072VB
        bool "STM32L072VB"

    config TEMP_STM32L072VZ
        bool "STM32L072VZ"

endchoice
```

## templates/configs/st/l0/l073/Kconfig
```kconfig
choice
    prompt "|------SUB MODEL"
        default TEMP_STM32L073CB
    help
        Select the device in STM32L073xx
    config TEMP_STM32L073CB
        bool "STM32L073CB"

    config TEMP_STM32L073CZ
        bool "STM32L073CZ"

    config TEMP_STM32L073RB
        bool "STM32L073RB"

    config TEMP_STM32L073RZ
        bool "STM32L073RZ"

    config TEMP_STM32L073V8
        bool "STM32L073V8"

    config TEMP_STM32L073VB
        bool "STM32L073VB"

    config TEMP_STM32L073VZ
        bool "STM32L073VZ"

endchoice
```

## templates/configs/st/l0/l081/Kconfig
```kconfig
choice
    prompt "|------SUB MODEL"
        default TEMP_STM32L081CB
    help
        Select the device in STM32L081xx
    config TEMP_STM32L081CB
        bool "STM32L081CB"

    config TEMP_STM32L081CZ
        bool "STM32L081CZ"

endchoice
```

## templates/configs/st/l0/l082/Kconfig
```kconfig
choice
    prompt "|------SUB MODEL"
        default TEMP_STM32L082CZ
    help
        Select the device in STM32L082xx
    config TEMP_STM32L082CZ
        bool "STM32L082CZ"

endchoice
```

## templates/configs/st/l0/l083/Kconfig
```kconfig
choice
    prompt "|------SUB MODEL"
        default TEMP_STM32L083CB
    help
        Select the device in STM32L083xx
    config TEMP_STM32L083CB
        bool "STM32L083CB"

    config TEMP_STM32L083CZ
        bool "STM32L083CZ"

    config TEMP_STM32L083RB
        bool "STM32L083RB"

    config TEMP_STM32L083RZ
        bool "STM32L083RZ"

    config TEMP_STM32L083V8
        bool "STM32L083V8"

    config TEMP_STM32L083VB
        bool "STM32L083VB"

    config TEMP_STM32L083VZ
        bool "STM32L083VZ"

endchoice
```

## templates/configs/st/l1/Kconfig
```kconfig
choice
    prompt "|----MODEL"
        default MODEL_STM32L152
    help
        Select the device in STM32L0xx

    config MODEL_STM32L151
        bool "STM32L151"

    config MODEL_STM32L152
        bool "STM32L152"

    config MODEL_STM32L162
        bool "STM32L162"

endchoice

if MODEL_STM32L151
    source "$OS_ROOT/templates/configs/st/l1/l151/Kconfig"
endif

if MODEL_STM32L152
    source "$OS_ROOT/templates/configs/st/l1/l152/Kconfig"
endif

if MODEL_STM32L162
    source "$OS_ROOT/templates/configs/st/l1/l162/Kconfig"
endif
```

## templates/configs/st/l1/l151/Kconfig
```kconfig
choice
    prompt "|------SUB MODEL"
        default TEMP_STM32L151RC
    help
        Select the device in STM32L151xx

    config TEMP_STM32L151RC
        bool "STM32L151RC"

endchoice
```

## templates/configs/st/l1/l152/Kconfig
```kconfig
choice
    prompt "|------SUB MODEL"
        default TEMP_stm32l152-nucleo-64
    help
        Select the device in STM32L152xx

    config TEMP_stm32l152-nucleo-64
        bool "stm32l152-nucleo-64"

endchoice
```

## templates/configs/st/l1/l162/Kconfig
```kconfig
choice
    prompt "|------SUB MODEL"
        default TEMP_STM32L162RC
    help
        Select the device in STM32L162xx

    config TEMP_STM32L162RC
        bool "STM32L162RC"

    config TEMP_STM32L162RE
        bool "STM32L162RE"

    config TEMP_STM32L162VC
        bool "STM32L162VC"

endchoice
```

## templates/configs/st/l4/Kconfig
```kconfig
choice
    prompt "|----MODEL"
        default MODEL_STM32L496
    help
        Select the device in STM32L4xx

    config MODEL_STM32L475
        bool "STM32L475"

    config MODEL_STM32L4R5
        bool "STM32L4R5"

    config MODEL_STM32L422
        bool "STM32L422"

    config MODEL_STM32L432
        bool "STM32L432"
        
    config MODEL_STM32L433
        bool "STM32L433"

    config MODEL_STM32L443
        bool "STM32L443"

    config MODEL_STM32L462
        bool "STM32L462"

    config MODEL_STM32L4r9
        bool "STM32L4r9"

    config MODEL_STM32L496
        bool "STM32L496"
endchoice

if MODEL_STM32L475
    source "$OS_ROOT/templates/configs/st/l4/l475/Kconfig"
endif

if MODEL_STM32L4R5
    source "$OS_ROOT/templates/configs/st/l4/l4r5/Kconfig"
endif

if MODEL_STM32L422
    source "$OS_ROOT/templates/configs/st/l4/l422/Kconfig"
endif

if MODEL_STM32L432
    source "$OS_ROOT/templates/configs/st/l4/l432/Kconfig"
endif

if MODEL_STM32L433
    source "$OS_ROOT/templates/configs/st/l4/l433/Kconfig"
endif

if MODEL_STM32L443
    source "$OS_ROOT/templates/configs/st/l4/l443/Kconfig"
endif

if MODEL_STM32L462
    source "$OS_ROOT/templates/configs/st/l4/l462/Kconfig"
endif

if MODEL_STM32L4r9
    source "$OS_ROOT/templates/configs/st/l4/l4r9/Kconfig"
endif

if MODEL_STM32L496
    source "$OS_ROOT/templates/configs/st/l4/l496/Kconfig"
endif
```

## templates/configs/st/l4/l422/Kconfig
```kconfig
choice
    prompt "|------SUB MODEL"
        default TEMP_STM32L422CB
    help
        Select the device in STM32L422xx
        
    config TEMP_STM32L422CB
        bool "STM32L422CB"
        
endchoice
```

## templates/configs/st/l4/l432/Kconfig
```kconfig
choice
    prompt "|------SUB MODEL"
        default TEMP_stm32l432-nucleo-32
    help
        Select the device in STM32L432xx

    config TEMP_stm32l432-nucleo-32
        bool "stm32l432-nucleo-32"
        
        
endchoice
```

## templates/configs/st/l4/l433/Kconfig
```kconfig
choice
    prompt "|------SUB MODEL"
        default TEMP_stm32l433-nucleo-64
    help
        Select the device in STM32L433xx

    config TEMP_stm32l433-nucleo-64
        bool "stm32l433-nucleo-64"
        
        
endchoice
```

## templates/configs/st/l4/l443/Kconfig
```kconfig
choice
    prompt "|------SUB MODEL"
        default TEMP_STM32L443CC
    help
        Select the device in STM32L443xx
        
    config TEMP_STM32L443CC
        bool "STM32L443CC"

    config TEMP_STM32L443VC
        bool "STM32L443VC"
endchoice
```
