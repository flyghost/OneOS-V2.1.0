## templates/configs/st/l4/l462/Kconfig
```kconfig
choice
    prompt "|------SUB MODEL"
        default TEMP_STM32L462CE
    help
        Select the device in STM32L462xx
  
    config TEMP_STM32L462CE
        bool "STM32L462RC"

    config TEMP_STM32L462RE
        bool "STM32L462RE"
endchoice
```

## templates/configs/st/l4/l475/Kconfig
```kconfig
choice
    prompt "|------SUB MODEL"
        default TEMP_stm32l475-atk-pandora
    help
        Select the device in STM32L475xx
        
    config TEMP_stm32l475-atk-pandora
        bool "stm32l475-atk-pandora"
        
    config TEMP_stm32l475-cmcc-oneos
        bool "stm32l475-cmcc-oneos"

    config TEMP_stm32l475-cmcc-oneos-demo
        bool "stm32l475-cmcc-oneos-demo"
        
endchoice
```

## templates/configs/st/l4/l496/Kconfig
```kconfig
choice
    prompt "|------SUB MODEL"
        default TEMP_stm32l496-ali-developerkit
    help
        Select the device in STM32L496xx

    config TEMP_stm32l496-ali-developerkit
        bool "stm32l496-ali-developerkit"
        
endchoice
```

## templates/configs/st/l4/l4r5/Kconfig
```kconfig
choice
    prompt "|------SUB MODEL"
        default TEMP_stm32l4r5-nucleo-144
    help
        Select the device in STM32L4R5xx
        
    config TEMP_stm32l4r5-nucleo-144
        bool "stm32l4r5-nucleo-144"
        
endchoice
```

## templates/configs/st/l4/l4r9/Kconfig
```kconfig
choice
    prompt "|------SUB MODEL"
        default TEMP_stm32l4r9-st-disco
    help
        Select the device in stm32l4r9xx

    config TEMP_stm32l4r9-st-disco
        bool "stm32l4r9-st-disco"
endchoice
```

## templates/configs/st/l5/Kconfig
```kconfig
choice
    prompt "|----MODEL"
        default MODEL_STM32L562
    help
        Select the device in STM32L5xx

    config MODEL_STM32L562
        bool "STM32L562"

endchoice

if MODEL_STM32L562
    source "$OS_ROOT/templates/configs/st/l5/l562/Kconfig"
endif
```

## templates/configs/st/l5/l562/Kconfig
```kconfig
choice
    prompt "|------SUB MODEL"
        default TEMP_stm32l562e-dk
    help
        Select the device in STM32L562xx

    config TEMP_stm32l562e-dk
        bool "stm32l562e-dk"
		
    config TEMP_STM32L562RE
        bool "STM32L562RE"
endchoice
```

## templates/configs/st/mp1/Kconfig
```kconfig
choice
    prompt "|----MODEL"
        default MODEL_STM32MP157
    help
        Select the device in STM32MP1xx

    config MODEL_STM32MP157
        bool "STM32MP157"

endchoice

if MODEL_STM32MP157
    source "$OS_ROOT/templates/configs/st/mp1/mp157/Kconfig"
endif
```

## templates/configs/st/mp1/mp157/Kconfig
```kconfig
choice
    prompt "|------SUB MODEL"
        default TEMP_stm32mp157-atk-base
    help
        Select the device in STM32MP157xx

    config TEMP_STM32MP157DAAx
        bool "STM32MP157DAAx"
        
    config TEMP_stm32mp157-atk-base
        bool "stm32mp157-atk-base"
endchoice
```

## templates/fm33-common/replace/FM33LC0/Kconfig
```kconfig
mainmenu "One-Os Configuration"

#Define the relative path to root directory of os code
OS_ROOT=../..
SRC_HAL=fm

config BOARD_FM33LC0XX
    bool
    select SOC_FM33LC0XX
    default y
    
source "$OS_ROOT/Kconfig"
```

## templates/gd32-common/Kconfig
```kconfig
mainmenu "OneOS Configuration"

#Define the relative path to root directory of os code
OS_ROOT=../..
SRC_HAL=gd

config BOARD_ATK_PANDORA
    bool
    select SOC_GD32F30X_CL
    default y
    
source "$OS_ROOT/Kconfig"
```

## templates/gd32vf103-longan-nano/Kconfig
```kconfig
mainmenu "OneOS Configuration"

#Define the relative path to root directory of os code
OS_ROOT=../..
SRC_HAL=gd32v

config BOARD_LONGAN_NANO
    bool
    select SOC_GD32VF103CBT6
    default y
    
source "$OS_ROOT/Kconfig"
```

## templates/hc32-common/replace/HC32F1/replace/HC32F17/Kconfig
```kconfig
mainmenu "One-Os Configuration"

#Define the relative path to root directory of os code
OS_ROOT=../..
SRC_HAL=hdsc

config BOARD_HC32F1
    bool
	select SOC_HC32F17X
    default y

source "$OS_ROOT/Kconfig"
```

## templates/hc32-common/replace/HC32F4/replace/HC32F46/Kconfig
```kconfig
mainmenu "One-Os Configuration"

#Define the relative path to root directory of os code
OS_ROOT=../..
SRC_HAL=hdsc

config BOARD_HC32F4
    bool
	select SOC_HC32F46X
    default y

source "$OS_ROOT/Kconfig"
```

## templates/hc32-common/replace/HC32L0/Kconfig
```kconfig
mainmenu "One-Os Configuration"

#Define the relative path to root directory of os code
OS_ROOT=../..
SRC_HAL=hdsc

config BOARD_HC32L0
    bool
	select SOC_HC32L07X
    default y

source "$OS_ROOT/Kconfig"
```

## templates/hc32l196pcta-stk/Kconfig
```kconfig
mainmenu "One-Os Configuration"

#Define the relative path to root directory of os code
OS_ROOT=../..
SRC_HAL=hdsc

config BOARD_HC32L1
    bool
	select SOC_HC32L19X
    default y

source "$OS_ROOT/Kconfig"
```

## templates/hk32-common/replace/HC32F3/replace/TEMP_HK32F39ARET6/Kconfig
```kconfig
mainmenu "OneOS Configuration"

#Define the relative path to root directory of os code
OS_ROOT=../..
SRC_HAL=hk32

config BOARD_HK32F3xx
    bool
    select SOC_HK32F39ARET6
    default y
    
config SOC_MODEL
    string
    default "HK32F39ARET6"
    
source "$OS_ROOT/Kconfig"
```

## templates/hk32-common/replace/HK32F0/replace/HK32F031/replace/TEMP_HK32F031KBU6/Kconfig
```kconfig
mainmenu "OneOS Configuration"

#Define the relative path to root directory of os code
OS_ROOT=../..
SRC_HAL=hk32

config BOARD_HK32F0xx
    bool
    select SOC_HK32F031KBU6
    default y
    
config SOC_MODEL
    string
    default "HK32F031KBU6"
    
source "$OS_ROOT/Kconfig"
```

## templates/hk32-common/replace/HK32F1/replace/TEMP_HK32F103RBT6A/Kconfig
```kconfig
mainmenu "OneOS Configuration"

#Define the relative path to root directory of os code
OS_ROOT=../..
SRC_HAL=hk32

config BOARD_HK32F1xx
    bool
    select SOC_HK32F103RBT6A
    default y
    
config SOC_MODEL
    string
    default "HK32F103RBT6A"
    
source "$OS_ROOT/Kconfig"
```

## templates/hk32f103-hk-mini/Kconfig
```kconfig
mainmenu "OneOS Configuration"

#Define the relative path to root directory of os code
OS_ROOT=../..
SRC_HAL=hk32

config BOARD_HK32F103_MINI
    bool
    select SOC_HK32F103VET6
    default y
    
source "$OS_ROOT/Kconfig"
```

## templates/lpc55s69-nxp-evk/Kconfig
```kconfig
mainmenu "OneOS Configuration"

#Define the relative path to root directory of os code
OS_ROOT=../..
SRC_HAL=nxp
    
config BOARD_LPC55S69_EVK
    bool
    select SOC_LPC55S69
    default y
    
source "$OS_ROOT/Kconfig"
```

## templates/mm32-common/replace/MM32F013XX/replace/MM32F013XCXX/replace/TEMP_MM32F0132C4P/Kconfig
```kconfig
mainmenu "OneOS Configuration"

#Define the relative path to root directory of os code
OS_ROOT=../..
SRC_HAL=mm32

config SOC_MM32F0132C4P
    bool
    select SERIES_MM32F013XX
    default y
    
    if SOC_MM32F0132C4P
        config SOC_MODEL
        string
        default "MM32F0132C4P"
    endif
    
source "$OS_ROOT/Kconfig"
```

## templates/mm32-common/replace/MM32F013XX/replace/MM32F013XCXX/replace/TEMP_MM32F0133C6P/Kconfig
```kconfig
mainmenu "OneOS Configuration"

#Define the relative path to root directory of os code
OS_ROOT=../..
SRC_HAL=mm32

config SOC_MM32F0133C6P
    bool
    select SERIES_MM32F013XX
    default y
    
    if SOC_MM32F0133C6P
        config SOC_MODEL
        string
        default "MM32F0133C6P"
    endif
    
source "$OS_ROOT/Kconfig"
```

## templates/mm32-common/replace/MM32F027XX/replace/MM32F027XDXX/replace/TEMP_MM32F0272D6P/Kconfig
```kconfig
mainmenu "OneOS Configuration"

#Define the relative path to root directory of os code
OS_ROOT=../..
SRC_HAL=mm32

config SOC_MM32F0272D6P
    bool
    select SERIES_MM32F027XX
    default y
    
    if SOC_MM32F0272D6P
        config SOC_MODEL
        string
        default "MM32F0272D6P"
    endif
    
source "$OS_ROOT/Kconfig"
```

## templates/mm32-common/replace/MM32F027XX/replace/MM32F027XDXX/replace/TEMP_MM32F0272D7P/Kconfig
```kconfig
mainmenu "OneOS Configuration"

#Define the relative path to root directory of os code
OS_ROOT=../..
SRC_HAL=mm32

config SOC_MM32F0272D7P
    bool
    select SERIES_MM32F027XX
    default y
    
    if SOC_MM32F0272D7P
        config SOC_MODEL
        string
        default "MM32F0272D7P"
    endif
    
source "$OS_ROOT/Kconfig"
```
