## templates/mm32-common/replace/MM32F027XX/replace/MM32F027XDXX/replace/TEMP_MM32F0272D8P/Kconfig
```kconfig
mainmenu "OneOS Configuration"

#Define the relative path to root directory of os code
OS_ROOT=../..
SRC_HAL=mm32

config SOC_MM32F0272D8P
    bool
    select SERIES_MM32F027XX
    default y
    
    if SOC_MM32F0272D8P
        config SOC_MODEL
        string
        default "MM32F0272D8P"
    endif
    
source "$OS_ROOT/Kconfig"
```

## templates/mm32-common/replace/MM32F103XX/replace/MM32F103XBXX/replace/TEMP_MM32F103RBT6/Kconfig
```kconfig
mainmenu "OneOS Configuration"

#Define the relative path to root directory of os code
OS_ROOT=../..
SRC_HAL=mm32

config SOC_MM32F103RBT6
    bool
    select SERIES_MM32F103XX
    default y
    
    if SOC_MM32F103RBT6
        config SOC_MODEL
        string
        default "MM32F103RBT6"
    endif
    
source "$OS_ROOT/Kconfig"
```

## templates/mm32-common/replace/MM32F327XX/replace/MM32F327XGXX/replace/TEMP_MM32F3273G7P/Kconfig
```kconfig
mainmenu "OneOS Configuration"

#Define the relative path to root directory of os code
OS_ROOT=../..
SRC_HAL=mm32

config SOC_MM32F3273G7P
    bool
    select SERIES_MM32F327XX
    default y
    
    if SOC_MM32F3273G7P
        config SOC_MODEL
        string
        default "MM32F3273G7P"
    endif
    
source "$OS_ROOT/Kconfig"
```

## templates/mm32-common/replace/MM32L3XX/replace/MM32L362XX/replace/TEMP_MM32L362NT/Kconfig
```kconfig
mainmenu "OneOS Configuration"

#Define the relative path to root directory of os code
OS_ROOT=../..
SRC_HAL=mm32

config SOC_MM32L362NT
    bool
    select SERIES_MM32L3XX
    default y
    
    if SOC_MM32L362NT
        config SOC_MODEL
        string
        default "MM32L362NT"
    endif
    
source "$OS_ROOT/Kconfig"
```

## templates/mm32-common/replace/MM32L3XX/replace/MM32L362XX/replace/TEMP_MM32L362PF/Kconfig
```kconfig
mainmenu "OneOS Configuration"

#Define the relative path to root directory of os code
OS_ROOT=../..
SRC_HAL=mm32

config SOC_MM32L362PF
    bool
    select SERIES_MM32L3XX
    default y
    
    if SOC_MM32L362PF
        config SOC_MODEL
        string
        default "MM32L362PF"
    endif
    
source "$OS_ROOT/Kconfig"
```

## templates/mm32-common/replace/MM32L3XX/replace/MM32L373XX/replace/TEMP_MM32L373NT/Kconfig
```kconfig
mainmenu "OneOS Configuration"

#Define the relative path to root directory of os code
OS_ROOT=../..
SRC_HAL=mm32

config SOC_MM32L373NT
    bool
    select SERIES_MM32L3XX
    default y
    
    if SOC_MM32L373NT
        config SOC_MODEL
        string
        default "MM32L373NT"
    endif
    
source "$OS_ROOT/Kconfig"
```

## templates/mm32-common/replace/MM32L3XX/replace/MM32L373XX/replace/TEMP_MM32L373PS/Kconfig
```kconfig
mainmenu "OneOS Configuration"

#Define the relative path to root directory of os code
OS_ROOT=../..
SRC_HAL=mm32

config SOC_MM32L373PS
    bool
    select SERIES_MM32L3XX
    default y
    
    if SOC_MM32L373PS
        config SOC_MODEL
        string
        default "MM32L373PS"
    endif
source "$OS_ROOT/Kconfig"
```

## templates/mm32-common/replace/MM32SPIN2XX/replace/MM32SPIN2XX/replace/TEMP_MM32SPIN27PS/Kconfig
```kconfig
mainmenu "OneOS Configuration"

#Define the relative path to root directory of os code
OS_ROOT=../..
SRC_HAL=mm32

config SOC_MM32SPIN27PS
    bool
    select SERIES_MM32SPIN2XX
    default y
    
    if SOC_MM32SPIN27PS
        config SOC_MODEL
        string
        default "MM32SPIN27PS"
    endif
    
source "$OS_ROOT/Kconfig"
```

## templates/mm32-common/replace/MM32SPIN2XX/replace/MM32SPIN2XX/replace/TEMP_MM32SPIN360C/Kconfig
```kconfig
mainmenu "OneOS Configuration"

#Define the relative path to root directory of os code
OS_ROOT=../..
SRC_HAL=mm32

#MM32SPIN360C->MM32SPIN27PS
config SOC_MM32SPIN360C
    bool
    select SERIES_MM32SPIN2XX
    default y
    
    if SOC_MM32SPIN360C
        config SOC_MODEL
        string
        default "MM32SPIN360C"
    endif
    
source "$OS_ROOT/Kconfig"
```

## templates/mm32-common/replace/MM32SPIN2XX/replace/MM32SPIN2XX/replace/TEMP_MM32SPIN423C/Kconfig
```kconfig
mainmenu "OneOS Configuration"

#Define the relative path to root directory of os code
OS_ROOT=../..
SRC_HAL=mm32

#MM32SPIN320B->MM32SPIN27PS
config SOC_MM32SPIN423C
    bool
    select SERIES_MM32SPIN2XX
    default y
    
    if SOC_MM32SPIN423C
        config SOC_MODEL
        string
        default "MM32SPIN423C"
    endif
    
source "$OS_ROOT/Kconfig"
```

## templates/mm32-common/replace/MM32WXX/replace/MM32W362XX/replace/TEMP_MM32W362PSB/Kconfig
```kconfig
mainmenu "OneOS Configuration"

#Define the relative path to root directory of os code
OS_ROOT=../..
SRC_HAL=mm32

config SOC_MM32W362PSB
    bool
    select SERIES_MM32W3XX
    default y
    
    if SOC_MM32W362PSB
        config SOC_MODEL
        string
        default "MM32W362PSB"
    endif
    
source "$OS_ROOT/Kconfig"
```

## templates/mm32-common/replace/MM32WXX/replace/MM32W373XX/replace/TEMP_MM32W373PFB/Kconfig
```kconfig
mainmenu "OneOS Configuration"

#Define the relative path to root directory of os code
OS_ROOT=../..
SRC_HAL=mm32

#MM32W373PFB->MM32L373PF
config SOC_MM32W373PFB
    bool
    select SERIES_MM32W3XX
    default y
    
    if SOC_MM32W373PFB
        config SOC_MODEL
        string
        default "MM32W373PFB"
    endif
    
source "$OS_ROOT/Kconfig"
```

## templates/mm32-common/replace/MM32WXX/replace/MM32W373XX/replace/TEMP_MM32W373PSB/Kconfig
```kconfig
mainmenu "OneOS Configuration"

#Define the relative path to root directory of os code
OS_ROOT=../..
SRC_HAL=mm32

#MM32W373PSB->MM32L373PS
config SOC_MM32W373PSB
    bool
    select SERIES_MM32W3XX
    default y
    
    if SOC_MM32W373PSB
        config SOC_MODEL
        string
        default "MM32W373PSB"
    endif
    
source "$OS_ROOT/Kconfig"
```

## templates/mm32f3277g8p-cmcc-oneos/Kconfig
```kconfig
mainmenu "OneOS Configuration"

#Define the relative path to root directory of os code
OS_ROOT=../..
SRC_HAL=mm32

config BOARD_MM32F3277G8P
    bool
    select SERIES_MM32F327XX
    default y

    if BOARD_MM32F3277G8P
        config SOC_MODEL
        string
        default "MM32F3277G8P"
    endif
    
source "$OS_ROOT/Kconfig"
```

## templates/nrf52832-pca10040/Kconfig
```kconfig
mainmenu "OneOS Configuration"

#Define the relative path to root directory of os code
OS_ROOT=../..
SRC_HAL=nrf

config BOARD_PCA10040
    bool
    select SOC_NRF52832
    default y
	
# config BLE_APP_BEACON
#     bool 
#     default y
config BLE_APP_HRS
    bool 
    default y
# config BLE_APP_BAS
#     bool 
#     default y

source "$OS_ROOT/Kconfig"
```

## templates/nxp-common/replace/lpc5500/replace/lpc550x_s0x/replace/lpc5504/replace/TEMP_LPC5504JHI48/Kconfig
```kconfig
mainmenu "OneOS Configuration"

#Define the relative path to root directory of os code
OS_ROOT=../..
SRC_HAL=nxp
    
config TEMP_LPC5504JHI48
    bool
    select SOC_LPC5504
    default y
    
    if TEMP_LPC5504JHI48
        config SOC_MODEL
        string
        default "LPC5504JHI48"
    endif
source "$OS_ROOT/Kconfig"
```

## templates/nxp-common/replace/lpc5500/replace/lpc550x_s0x/replace/lpc5506/replace/TEMP_LPC5506JBD64/Kconfig
```kconfig
mainmenu "OneOS Configuration"

#Define the relative path to root directory of os code
OS_ROOT=../..
SRC_HAL=nxp
    
config TEMP_LPC5506JBD64
    bool
    select SOC_LPC5506
    default y
    
    if TEMP_LPC5506JBD64
        config SOC_MODEL
        string
        default "LPC5506JBD64"
    endif
source "$OS_ROOT/Kconfig"
```

## templates/nxp-common/replace/lpc5500/replace/lpc550x_s0x/replace/lpc55S04/replace/TEMP_LPC55S04JBD64/Kconfig
```kconfig
mainmenu "OneOS Configuration"

#Define the relative path to root directory of os code
OS_ROOT=../..
SRC_HAL=nxp
    
config TEMP_LPC55S04JBD64
    bool
    select SOC_LPC55S04
    default y
    
    if TEMP_LPC55S04JBD64
        config SOC_MODEL
        string
        default "LPC55S04JBD64"
    endif
source "$OS_ROOT/Kconfig"
```

## templates/nxp-common/replace/lpc5500/replace/lpc550x_s0x/replace/lpc55S04/replace/TEMP_LPC55S04JHI48/Kconfig
```kconfig
mainmenu "OneOS Configuration"

#Define the relative path to root directory of os code
OS_ROOT=../..
SRC_HAL=nxp
    
config TEMP_LPC55S04JHI48
    bool
    select SOC_LPC55S04
    default y
    
    if TEMP_LPC55S04JHI48
        config SOC_MODEL
        string
        default "LPC55S04JHI48"
    endif
source "$OS_ROOT/Kconfig"
```

## templates/nxp-common/replace/lpc5500/replace/lpc551x_s1x/replace/lpc5514/replace/TEMP_LPC5514JBD100/Kconfig
```kconfig
mainmenu "OneOS Configuration"

#Define the relative path to root directory of os code
OS_ROOT=../..
SRC_HAL=nxp
    
config TEMP_LPC5514JBD100
    bool
    select SOC_LPC5514
    default y
    
    if TEMP_LPC5514JBD100
        config SOC_MODEL
        string
        default "LPC5514JBD100"
    endif
source "$OS_ROOT/Kconfig"
```

## templates/nxp-common/replace/lpc5500/replace/lpc551x_s1x/replace/lpc5514/replace/TEMP_LPC5514JBD64/Kconfig
```kconfig
mainmenu "OneOS Configuration"

#Define the relative path to root directory of os code
OS_ROOT=../..
SRC_HAL=nxp
    
config TEMP_LPC5514JBD64
    bool
    select SOC_LPC5514
    default y
    
    if TEMP_LPC5514JBD64
        config SOC_MODEL
        string
        default "LPC5514JBD64"
    endif
source "$OS_ROOT/Kconfig"
```

## templates/nxp-common/replace/lpc5500/replace/lpc551x_s1x/replace/lpc5516/replace/TEMP_LPC5516JBD64/Kconfig
```kconfig
mainmenu "OneOS Configuration"

#Define the relative path to root directory of os code
OS_ROOT=../..
SRC_HAL=nxp
    
config TEMP_LPC5516JBD64
    bool
    select SOC_LPC5516
    default y
    
    if TEMP_LPC5516JBD64
        config SOC_MODEL
        string
        default "LPC5516JBD64"
    endif
source "$OS_ROOT/Kconfig"
```

## templates/nxp-common/replace/lpc5500/replace/lpc551x_s1x/replace/lpc5516/replace/TEMP_LPC5516JEV98/Kconfig
```kconfig
mainmenu "OneOS Configuration"

#Define the relative path to root directory of os code
OS_ROOT=../..
SRC_HAL=nxp
    
config TEMP_LPC5516JEV98
    bool
    select SOC_LPC5516
    default y
    
    if TEMP_LPC5516JEV98
        config SOC_MODEL
        string
        default "LPC5516JEV98"
    endif
source "$OS_ROOT/Kconfig"
```

## templates/nxp-common/replace/lpc5500/replace/lpc551x_s1x/replace/lpc55S16/replace/TEMP_LPC55S16JBD100/Kconfig
```kconfig
mainmenu "OneOS Configuration"

#Define the relative path to root directory of os code
OS_ROOT=../..
SRC_HAL=nxp
    
config TEMP_LPC55S16JBD100
    bool
    select SOC_LPC55S16
    default y
    
    if TEMP_LPC55S16JBD100
        config SOC_MODEL
        string
        default "LPC55S16JBD100"
    endif
source "$OS_ROOT/Kconfig"
```

## templates/nxp-common/replace/lpc5500/replace/lpc551x_s1x/replace/lpc55S16/replace/TEMP_LPC55S16JEV98/Kconfig
```kconfig
mainmenu "OneOS Configuration"

#Define the relative path to root directory of os code
OS_ROOT=../..
SRC_HAL=nxp
    
config TEMP_LPC55S16JEV98
    bool
    select SOC_LPC55S16
    default y
    
    if TEMP_LPC55S16JEV98
        config SOC_MODEL
        string
        default "LPC55S16JEV98"
    endif
source "$OS_ROOT/Kconfig"
```
