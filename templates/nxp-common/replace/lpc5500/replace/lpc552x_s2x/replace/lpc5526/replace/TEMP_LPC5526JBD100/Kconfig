## templates/nxp-common/replace/lpc5500/replace/lpc552x_s2x/replace/lpc5526/replace/TEMP_LPC5526JBD100/Kconfig
```kconfig
mainmenu "OneOS Configuration"

#Define the relative path to root directory of os code
OS_ROOT=../..
SRC_HAL=nxp
    
config TEMP_LPC5526JBD100
    bool
    select SOC_LPC5526
    default y
    
    if TEMP_LPC5526JBD100
        config SOC_MODEL
        string
        default "LPC5526JBD100"
    endif
source "$OS_ROOT/Kconfig"
```

## templates/nxp-common/replace/lpc5500/replace/lpc552x_s2x/replace/lpc5526/replace/TEMP_LPC5526JEV98/Kconfig
```kconfig
mainmenu "OneOS Configuration"

#Define the relative path to root directory of os code
OS_ROOT=../..
SRC_HAL=nxp
    
config TEMP_LPC5526JEV98
    bool
    select SOC_LPC5526
    default y
    
    if TEMP_LPC5526JEV98
        config SOC_MODEL
        string
        default "LPC5526JEV98"
    endif
source "$OS_ROOT/Kconfig"
```

## templates/nxp-common/replace/lpc5500/replace/lpc552x_s2x/replace/lpc5528/replace/TEMP_LPC5528JBD64/Kconfig
```kconfig
mainmenu "OneOS Configuration"

#Define the relative path to root directory of os code
OS_ROOT=../..
SRC_HAL=nxp
    
config TEMP_LPC5528JBD64
    bool
    select SOC_LPC5528
    default y
    
    if TEMP_LPC5528JBD64
        config SOC_MODEL
        string
        default "LPC5528JBD64"
    endif
source "$OS_ROOT/Kconfig"
```

## templates/nxp-common/replace/lpc5500/replace/lpc552x_s2x/replace/lpc5528/replace/TEMP_LPC5528JEV98/Kconfig
```kconfig
mainmenu "OneOS Configuration"

#Define the relative path to root directory of os code
OS_ROOT=../..
SRC_HAL=nxp
    
config TEMP_LPC5528JEV98
    bool
    select SOC_LPC5528
    default y
    
    if TEMP_LPC5528JEV98
        config SOC_MODEL
        string
        default "LPC5528JEV98"
    endif
source "$OS_ROOT/Kconfig"
```

## templates/nxp-common/replace/lpc5500/replace/lpc552x_s2x/replace/lpc55S26/replace/TEMP_LPC55S26JEV98/Kconfig
```kconfig
mainmenu "OneOS Configuration"

#Define the relative path to root directory of os code
OS_ROOT=../..
SRC_HAL=nxp
    
config TEMP_LPC55S26JEV98
    bool
    select SOC_LPC55S26
    default y
    
    if TEMP_LPC55S26JEV98
        config SOC_MODEL
        string
        default "LPC55S26JEV98"
    endif
source "$OS_ROOT/Kconfig"
```

## templates/nxp-common/replace/lpc5500/replace/lpc552x_s2x/replace/lpc55S28/replace/TEMP_LPC55S28JEV98/Kconfig
```kconfig
mainmenu "OneOS Configuration"

#Define the relative path to root directory of os code
OS_ROOT=../..
SRC_HAL=nxp
    
config TEMP_LPC55S28JEV98
    bool
    select SOC_LPC55S28
    default y
    
    if TEMP_LPC55S28JEV98
        config SOC_MODEL
        string
        default "LPC55S28JEV98"
    endif
source "$OS_ROOT/Kconfig"
```

## templates/nxp-common/replace/lpc5500/replace/lpc55s6x/replace/lpc55s66/replace/TEMP_LPC55S66JBD64/Kconfig
```kconfig
mainmenu "OneOS Configuration"

#Define the relative path to root directory of os code
OS_ROOT=../..
SRC_HAL=nxp
    
config TEMP_LPC55S66JBD64
    bool
    select SOC_LPC55S66
    default y
    
    if TEMP_LPC55S66JBD64
        config SOC_MODEL
        string
        default "LPC55S66JBD64"
    endif
source "$OS_ROOT/Kconfig"
```

## templates/simulator-posix/Kconfig
```kconfig
mainmenu "OneOS Configuration"

#Define the relative path to root directory of os code
OS_ROOT=../..
SRC_HAL=st

config BOARD_SIM_LINUX_SIM
    bool
    select ARCH_SIM_POSIX
	select OS_ARCH_CPU_64BIT
    default y

config OS_ARCH_CPU_64BIT
    bool
    default n	
    
source "$OS_ROOT/Kconfig"
```

## templates/stm32f0-common/replace/STM32F030/Kconfig
```kconfig
mainmenu "OneOS Configuration"

#Define the relative path to root directory of os code
OS_ROOT=../..
SRC_HAL=st

config BOARD_STM32F030
    bool
    select SOC_STM32F030xx
    default y

source "$OS_ROOT/Kconfig"
```

## templates/stm32f0-common/replace/STM32F072/Kconfig
```kconfig
mainmenu "OneOS Configuration"

#Define the relative path to root directory of os code
OS_ROOT=../..
SRC_HAL=st

config BOARD_STM32F072
    bool
    select SOC_STM32F072xx
    default y
    
source "$OS_ROOT/Kconfig"
```

## templates/stm32f0-common/replace/STM32F091/Kconfig
```kconfig
mainmenu "OneOS Configuration"

#Define the relative path to root directory of os code
OS_ROOT=../..
SRC_HAL=st

config BOARD_STM32F091
    bool
    select SOC_STM32F091xx
    default y
    
source "$OS_ROOT/Kconfig"
```

## templates/stm32f030-cct6/Kconfig
```kconfig
mainmenu "OneOS Configuration"

#Define the relative path to root directory of os code
OS_ROOT=../..
SRC_HAL=st

config BOARD_VANVIOT_S5
    bool
    select SOC_STM32F030xC
    default y
    
source "$OS_ROOT/Kconfig"
```

## templates/stm32f091-nucleo-64/Kconfig
```kconfig
mainmenu "OneOS Configuration"

#Define the relative path to root directory of os code
OS_ROOT=../..
SRC_HAL=st

config BOARD_NUCLEO_64
    bool
    select SOC_STM32F091xC
    default y
    
source "$OS_ROOT/Kconfig"
```

## templates/stm32f1-common/replace/STM32F105/Kconfig
```kconfig
mainmenu "OneOS Configuration"

#Define the relative path to root directory of os code
OS_ROOT=../..
SRC_HAL=st

config BSP_USING_GPIO
    bool

config BSP_USING_UART
    bool

config BSP_USING_UART1
    bool

config OS_USING_PIN
    bool
    
config OS_USING_SERIAL
    bool

config BOARD_ATK_ELITE
    bool
    select SOC_STM32F103xE
    select BSP_USING_GPIO
    select BSP_USING_UART
    select BSP_USING_UART1
    select OS_USING_PIN
    select OS_USING_SERIAL
    default y
    
source "$OS_ROOT/Kconfig"
```

## templates/stm32f107-vct6-100/Kconfig
```kconfig
mainmenu "OneOS Configuration"

#Define the relative path to root directory of os code
OS_ROOT=../..
SRC_HAL=st

config BOARD_STM32F107VCT6
    bool
    select SOC_STM32F1XX
    default y
    
source "$OS_ROOT/Kconfig"
```

## templates/stm32f302-nucleo/Kconfig
```kconfig
mainmenu "OneOS Configuration"

#Define the relative path to root directory of os code
OS_ROOT=../..
SRC_HAL=st

config BOARD_STM32F302R8
    bool
    select SOC_STM32F3XX
    default y
    
source "$OS_ROOT/Kconfig"
```

## templates/stm32f4-common/replace/STM32F40/replace/STM32F407/Kconfig
```kconfig
mainmenu "OneOS Configuration"

#Define the relative path to root directory of os code
OS_ROOT=../..
SRC_HAL=st

config BOARD_STM32F407XX
    bool
    select SOC_STM32F4XX
    default y
    
source "$OS_ROOT/Kconfig"
```

## templates/stm32f4-common/replace/STM32F42/replace/STM32F423/Kconfig
```kconfig
mainmenu "OneOS Configuration"

#Define the relative path to root directory of os code
OS_ROOT=../..
SRC_HAL=st



config ONEOS_STM32F423_EVK
    bool
    select SOC_STM32F423xx
    default y
    
source "$OS_ROOT/Kconfig"
```

## templates/stm32f4-common/replace/STM32F42/replace/STM32F427/Kconfig
```kconfig
mainmenu "OneOS Configuration"

#Define the relative path to root directory of os code
OS_ROOT=../..
SRC_HAL=st

config ONEOS_STM32F427_EVK
    bool
    select SOC_STM32F427xx

    default y
    
source "$OS_ROOT/Kconfig"
```

## templates/stm32f4-common/replace/STM32F42/replace/STM32F429/Kconfig
```kconfig
mainmenu "OneOS Configuration"

#Define the relative path to root directory of os code
OS_ROOT=../..
SRC_HAL=st

config ONEOS_STM32F429_EVK
    bool
    select SOC_STM32F429xx

    default y
    
source "$OS_ROOT/Kconfig"
```

## templates/stm32f4-common/replace/STM32F446/Kconfig
```kconfig
mainmenu "OneOS Configuration"

#Define the relative path to root directory of os code
OS_ROOT=../..
SRC_HAL=st

config ONEOS_STM32F446_EVK
    bool
    select SOC_STM32F4XX
    default y
    
source "$OS_ROOT/Kconfig"
```

## templates/stm32f401-ret6-nucleo/Kconfig
```kconfig
mainmenu "OneOS Configuration"

#Define the relative path to root directory of os code
OS_ROOT=../..
SRC_HAL=st

config BOARD_STM32F401RE
    bool
    select SOC_STM32F4XX
    default y
    
source "$OS_ROOT/Kconfig"
```

## templates/stm32f407-atk-explorer/Kconfig
```kconfig
mainmenu "OneOS Configuration"

#Define the relative path to root directory of os code
OS_ROOT=../..
SRC_HAL=st

config BOARD_ATK_EXPLORER
    bool
    select SOC_STM32F407xx
    default y
    
source "$OS_ROOT/Kconfig"
```

## templates/stm32f469-st-disco/Kconfig
```kconfig
mainmenu "OneOS Configuration"

#Define the relative path to root directory of os code
OS_ROOT=../..
SRC_HAL=st

config BOARD_F469_DISCO
    bool
    select SOC_STM32F469xx
    default y
    
source "$OS_ROOT/Kconfig"
```

## templates/stm32f7-common/replace/STM32F75/Kconfig
```kconfig
mainmenu "OneOS Configuration"

#Define the relative path to root directory of os code
OS_ROOT=../..
SRC_HAL=st



config ONEOS_STM32F75X_EVK
    bool
    select SOC_STM32F7XX
    default y
    
source "$OS_ROOT/Kconfig"
```
