## templates/stm32f722-st-nucleo/Kconfig
```kconfig
mainmenu "OneOS Configuration"

#Define the relative path to root directory of os code
OS_ROOT=../..
SRC_HAL=st

config BOARD_ST_NUCLEO
    bool
    select SOC_STM32F722xx
    default y
    
source "$OS_ROOT/Kconfig"
```

## templates/stm32f769-st-disco/Kconfig
```kconfig
mainmenu "OneOS Configuration"

#Define the relative path to root directory of os code
OS_ROOT=../..
SRC_HAL=st

config BOARD_ST_DISCO
    bool
    select SOC_STM32F769xx
    default y
    
source "$OS_ROOT/Kconfig"
```

## templates/stm32g0-common/replace/STM32G07/replace/STM32G070/Kconfig
```kconfig
mainmenu "OneOS Configuration"

#Define the relative path to root directory of os code
OS_ROOT=../..
SRC_HAL=st

config BOARD_STM32G070XX
    bool
    select SOC_STM32G0XX
    default y
    
source "$OS_ROOT/Kconfig"
```

## templates/stm32g070rb-nucleo-64/Kconfig
```kconfig
mainmenu "OneOS Configuration"

#Define the relative path to root directory of os code
OS_ROOT=../..
SRC_HAL=st

config BOARD_NUCLEO_64
    bool
    select SOC_STM32G071RB
    default y
    
source "$OS_ROOT/Kconfig"
```

## templates/stm32h7-common/replace/STM32H745/cm4/Kconfig
```kconfig
mainmenu "OneOS Configuration"

#Define the relative path to root directory of os code
OS_ROOT=../../..
SRC_HAL=st

config BOARD_ATK_PANDORA
    bool
    select SOC_STM32H745xx_CM4
    default y
    
source "$OS_ROOT/Kconfig"
```

## templates/stm32h7-common/replace/STM32H757/cm7/Kconfig
```kconfig
mainmenu "OneOS Configuration"

#Define the relative path to root directory of os code
OS_ROOT=../../..
SRC_HAL=st

config BOARD_ATK_PANDORA
    bool
    select SOC_STM32H757xx_CM7
    default y
    
source "$OS_ROOT/Kconfig"
```

## templates/stm32l0-common/replace/STM32L073/Kconfig
```kconfig
mainmenu "OneOS Configuration"

#Define the relative path to root directory of os code
OS_ROOT=../..
SRC_HAL=st



config ONEOS_STM32L073_EVK
    bool
    select SOC_STM32L073xx
    default y
    
source "$OS_ROOT/Kconfig"
```

## templates/stm32l0-common/replace/STM32L082/Kconfig
```kconfig
mainmenu "OneOS Configuration"

#Define the relative path to root directory of os code
OS_ROOT=../..
SRC_HAL=st



config ONEOS_STM32L082_EVK
    bool
    select SOC_STM32L082xx
    default y
    
source "$OS_ROOT/Kconfig"
```

## templates/stm32l053-nucleo-64/Kconfig
```kconfig
mainmenu "OneOS Configuration"

#Define the relative path to root directory of os code
OS_ROOT=../..
SRC_HAL=st

config BOARD_NUCLEO_64
    bool
    select SOC_STM32L053R8
    select OS_USING_COMPONENTS_INIT
    select OS_USING_USER_MAIN
    default y
    
source "$OS_ROOT/Kconfig"
```

## templates/stm32l1-common/replace/STM32L151/Kconfig
```kconfig
mainmenu "OneOS Configuration"

#Define the relative path to root directory of os code
OS_ROOT=../..
SRC_HAL=st



config BOARD_STM32L151
    bool
    select SOC_STM32L1XX
    default y
    
source "$OS_ROOT/Kconfig"
```

## templates/stm32l152-nucleo-64/Kconfig
```kconfig
mainmenu "OneOS Configuration"

#Define the relative path to root directory of os code
OS_ROOT=../..
SRC_HAL=st

config BOARD_NUCLEO_64
    bool
    select SOC_STM32L152RE
    default y
    
source "$OS_ROOT/Kconfig"
```

## templates/stm32l4-common/replace/STM32L462/Kconfig
```kconfig
mainmenu "OneOS Configuration"

#Define the relative path to root directory of os code
OS_ROOT=../..
SRC_HAL=st



config BOARD_STM32L462
    bool
    select SOC_STM32L462xx
    default y
    
source "$OS_ROOT/Kconfig"
```

## templates/stm32l433-nucleo-64/Kconfig
```kconfig
mainmenu "OneOS Configuration"

#Define the relative path to root directory of os code
OS_ROOT=../..
SRC_HAL=st

config BOARD_NUCLEO_64
    bool
    select SOC_STM32L433RC
    default y
    
source "$OS_ROOT/Kconfig"
```

## templates/stm32l475-cmcc-oneos-demo/Kconfig
```kconfig
mainmenu "OneOS Configuration"

#Define the relative path to root directory of os code
OS_ROOT=../..
SRC_HAL=st

config BOARD_CMCC_ONEOS
    bool
    select SOC_STM32L475VG
    default y
    
source "$OS_ROOT/Kconfig"
```

## templates/stm32l496-ali-developerkit/Kconfig
```kconfig
mainmenu "OneOS Configuration"

#Define the relative path to root directory of os code
OS_ROOT=../..
SRC_HAL=st

config BOARD_ATK_PANDORA
    bool
    select SOC_STM32L496VG
    default y
    
source "$OS_ROOT/Kconfig"
```

## templates/stm32l4r9-st-disco/Kconfig
```kconfig
mainmenu "OneOS Configuration"

#Define the relative path to root directory of os code
OS_ROOT=../..
SRC_HAL=st

config BOARD_NUCLEO_169
    bool
    select SOC_STM32L4R9AI
    default y
    
source "$OS_ROOT/Kconfig"
```

## templates/stm32l562e-dk/normal/Kconfig
```kconfig
mainmenu "OneOS Configuration"

#Define the relative path to root directory of os code
OS_ROOT=../../..
SRC_HAL=st

config ST_STM32L562E_BOARD
    bool
    select SOC_STM32L562E_DK
    default y
    
source "$OS_ROOT/Kconfig"
```

## templates/x1000e-common/Kconfig
```kconfig
mainmenu "OneOS Configuration"

#Define the relative path to root directory of os code
OS_ROOT=../..
SRC_HAL=ingenic

config BOARD_HALLEY2_BASEBOARD
    bool
    select SOC_INGENIC_X1000E
    default y
    
source "$OS_ROOT/Kconfig"
```
