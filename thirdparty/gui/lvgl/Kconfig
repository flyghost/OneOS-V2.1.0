## thirdparty/gui/lvgl/Kconfig
```kconfig
menuconfig OS_USING_GUI_LVGL_EXAMPLES
    bool "Enable LVGL examples"
    default n

    if OS_USING_GUI_LVGL_EXAMPLES
    source "$OS_ROOT/thirdparty/gui/lvgl/lv_examples/Kconfig"
    endif

menuconfig OS_USING_ONEOS_LVGL_DEMO
    bool "Enable OneOS LVGL Demo"
    default n

config OS_USING_GUI_LVGL_GIF
    bool "Enable LVGL gif"
    default n
```

## thirdparty/gui/lvgl/lv_examples/Kconfig
```kconfig
if OS_USING_GUI_LVGL_EXAMPLES
    config OS_USING_GUI_LV_EX_GETSTARTED
        bool "GUI lvgl example: get started"
        default n
    config OS_USING_GUI_LV_EX_MUSIC
        bool "GUI lvgl example: music"
        default n

    config OS_USING_GUI_LV_EX_PRINTER
        bool "GUI lvgl example: printer"
        default n

endif
```

## thirdparty/iotjs/Kconfig
```kconfig
menu "iotjs"

    config USING_IOTJS
    bool "enable iotjs"
    select USING_JERRYSCRIPT
    select OS_USING_PTHREADS
    select NET_USING_LWIP_IPV6
    select NET_USING_BSD
    select OS_USING_IO_MULTIPLEXING
    default n

endmenu
```

## thirdparty/jerryscript/Kconfig
```kconfig
menu "jerryscript"

    config USING_JERRYSCRIPT
    bool "enable jerryscript"
    default n

endmenu
```

## thirdparty/ocf/Kconfig
```kconfig
menu "Iotivity"

    config PKG_USING_IOTIVITY
        bool "Iotivity: OCF Iotivity library"
        default n

    if PKG_USING_IOTIVITY
        choice
            prompt "ocf device type"
            config OCF_AIRCONDITIONER
                bool "ocf air conditioner"
            config OCF_AIRPURIFIER
                bool "ocf airpurifier"
            config OCF_CAMERA
                bool "ocf camera"
            config OCF_LIGHT
                bool "ocf light"
            config OCF_SMARTLOCK
                bool "ocf smartlock"
            config OCF_WATERHEATER
                bool "ocf waterheater"
            config OCF_WASHER
                bool "ocf washer"
        endchoice
        config OCF_IPV4
            bool "Iotivity: OCF ipv4 support"
            default y
        config OCF_DEBUG
            bool "Iotivity: OCF debug"
            default y
        config OCF_SERVER
            bool "Iotivity: OCF server"
            default y
        config OCF_CLIENT
            bool "Iotivity: OCF client"
            default n
        config OCF_SECURITY
            bool "Iotivity: OCF security"
            default y
        config OCF_DYNAMIC_ALLOCATION
            bool "Iotivity: OCF dynamic allocation"
            default y
        config OCF_PKI
            bool "Iotivity: OCF PKI"
            default y
        config OCF_ONEOS_2_0
            bool "Iotivity: OCF use oneos 2.0"
            default y
        config OCF_CUSTOM_RAM
            bool "Iotivity: OCF use custom ram"
            default n
        config OCF_USE_GUI
            bool "Iotivity: OCF use gui"
            default n
    endif

endmenu
   

   

    

 
```

## thirdparty/optparse/Kconfig
```kconfig
menu "Optparse"

    config TP_USING_OPTPARSE
        bool "Optparse: portable, reentrant, embeddable, getopt-like option parser"
        default false

    if TP_USING_OPTPARSE
        config OPTPARSE_TEST_DEMO
        bool "Enable Optparse test demo"
        default false
    endif

endmenu
```

## thirdparty/telnetd/Kconfig
```kconfig
# Kconfig file for telnetd
if OS_USING_SHELL

menu "telnetd"
    config TELNET_SERVER
    bool "enable telnet server"
    select NET_USING_BSD
    default n

endmenu

endif
```
